## buildroot/configs/roseapplepi_defconfig
```kconfig
BR2_arm=y
BR2_cortex_a9=y
BR2_ARM_ENABLE_NEON=y
BR2_ARM_ENABLE_VFP=y
BR2_GLOBAL_PATCH_DIR="board/roseapplepi/patches"
# Linux headers same as kernel, a 5.10 series
BR2_PACKAGE_HOST_LINUX_HEADERS_CUSTOM_5_10=y
BR2_ROOTFS_POST_BUILD_SCRIPT="board/roseapplepi/post-build.sh"
BR2_ROOTFS_POST_IMAGE_SCRIPT="support/scripts/genimage.sh"
BR2_ROOTFS_POST_SCRIPT_ARGS="-c board/roseapplepi/genimage.cfg"

BR2_LINUX_KERNEL=y
BR2_LINUX_KERNEL_CUSTOM_VERSION=y
BR2_LINUX_KERNEL_CUSTOM_VERSION_VALUE="5.10.1"
BR2_LINUX_KERNEL_USE_CUSTOM_CONFIG=y
BR2_LINUX_KERNEL_CUSTOM_CONFIG_FILE="board/roseapplepi/linux.config"
BR2_LINUX_KERNEL_UIMAGE=y
BR2_LINUX_KERNEL_UIMAGE_LOADADDR="0x8000"
BR2_LINUX_KERNEL_DTS_SUPPORT=y
BR2_LINUX_KERNEL_INTREE_DTS_NAME="owl-s500-roseapplepi"

# Filesystem / image
BR2_TARGET_ROOTFS_INITRAMFS=y
# BR2_TARGET_ROOTFS_TAR is not set

# Bootloaders
BR2_TARGET_S500_BOOTLOADER=y
BR2_TARGET_S500_BOOTLOADER_BOARD="linux/bubble_gum_sd"
BR2_TARGET_UBOOT=y
BR2_TARGET_UBOOT_BUILD_SYSTEM_KCONFIG=y
BR2_TARGET_UBOOT_CUSTOM_GIT=y
BR2_TARGET_UBOOT_CUSTOM_REPO_URL="https://github.com/xapp-le/u-boot.git"
BR2_TARGET_UBOOT_CUSTOM_REPO_VERSION="a035d2673a90143a1a74557503b2e137b1447ae6"
BR2_TARGET_UBOOT_BOARD_DEFCONFIG="actduino_bubble_gum_v10"
BR2_TARGET_UBOOT_NEEDS_DTC=y
BR2_TARGET_UBOOT_FORMAT_DTB_IMG=y

# Required tools to create the SD image
BR2_PACKAGE_HOST_DOSFSTOOLS=y
BR2_PACKAGE_HOST_GENIMAGE=y
BR2_PACKAGE_HOST_MTOOLS=y
```

## buildroot/configs/solidrun_clearfog_gt_8k_defconfig
```kconfig
BR2_aarch64=y
BR2_PACKAGE_HOST_LINUX_HEADERS_CUSTOM_5_10=y
BR2_TARGET_GENERIC_HOSTNAME="clearfog-gt-8k"
BR2_TARGET_GENERIC_ISSUE="Welcome to Buildroot for SolidRun Clearfog GT-8K"

# Firmware
BR2_TARGET_ARM_TRUSTED_FIRMWARE=y
BR2_TARGET_ARM_TRUSTED_FIRMWARE_CUSTOM_VERSION=y
BR2_TARGET_ARM_TRUSTED_FIRMWARE_CUSTOM_VERSION_VALUE="v2.4"
BR2_TARGET_ARM_TRUSTED_FIRMWARE_PLATFORM="a80x0_mcbin"
BR2_TARGET_ARM_TRUSTED_FIRMWARE_FIP=y
BR2_TARGET_ARM_TRUSTED_FIRMWARE_UBOOT_AS_BL33=y
BR2_TARGET_ARM_TRUSTED_FIRMWARE_ADDITIONAL_TARGETS="mrvl_flash"
BR2_TARGET_ARM_TRUSTED_FIRMWARE_ADDITIONAL_VARIABLES="USE_COHERENT_MEM=0"
BR2_TARGET_BINARIES_MARVELL=y
BR2_TARGET_MV_DDR_MARVELL=y

# U-Boot
BR2_TARGET_UBOOT=y
BR2_TARGET_UBOOT_CUSTOM_VERSION=y
BR2_TARGET_UBOOT_CUSTOM_VERSION_VALUE="2020.10"
BR2_TARGET_UBOOT_BUILD_SYSTEM_KCONFIG=y
BR2_TARGET_UBOOT_BOARD_DEFCONFIG="clearfog_gt_8k"
BR2_TARGET_UBOOT_CONFIG_FRAGMENT_FILES="board/solidrun/clearfog_gt_8k/uboot-fragment.config"

# Kernel
BR2_LINUX_KERNEL=y
BR2_LINUX_KERNEL_CUSTOM_VERSION=y
BR2_LINUX_KERNEL_CUSTOM_VERSION_VALUE="5.10.5"
BR2_LINUX_KERNEL_USE_ARCH_DEFAULT_CONFIG=y
BR2_LINUX_KERNEL_DTS_SUPPORT=y
BR2_LINUX_KERNEL_CONFIG_FRAGMENT_FILES="board/solidrun/clearfog_gt_8k/linux-extras.config"
BR2_LINUX_KERNEL_INTREE_DTS_NAME="marvell/armada-8040-clearfog-gt-8k"
BR2_LINUX_KERNEL_INSTALL_TARGET=y
BR2_LINUX_KERNEL_NEEDS_HOST_OPENSSL=y

# rootfs
BR2_TARGET_ROOTFS_EXT2=y
BR2_TARGET_ROOTFS_EXT2_4=y
BR2_TARGET_ROOTFS_EXT2_SIZE="120M"
BR2_PACKAGE_HOST_GENIMAGE=y
BR2_ROOTFS_DEVICE_CREATION_DYNAMIC_MDEV=y
BR2_ROOTFS_POST_IMAGE_SCRIPT="support/scripts/genimage.sh"
BR2_ROOTFS_POST_BUILD_SCRIPT="board/solidrun/clearfog_gt_8k/post-build-mainline.sh"
BR2_ROOTFS_POST_SCRIPT_ARGS="-c board/solidrun/clearfog_gt_8k/genimage.cfg"
```

## buildroot/configs/stm32f469_disco_defconfig
```kconfig
BR2_arm=y
BR2_cortex_m4=y
BR2_PACKAGE_HOST_LINUX_HEADERS_CUSTOM_5_12=y
BR2_ROOTFS_POST_BUILD_SCRIPT="board/stmicroelectronics/common/stm32f4xx/stm32-post-build.sh board/stmicroelectronics/stm32f469-disco/post-build.sh"
BR2_ROOTFS_POST_IMAGE_SCRIPT="support/scripts/genimage.sh"
BR2_ROOTFS_POST_SCRIPT_ARGS="-c board/stmicroelectronics/stm32f469-disco/genimage.cfg"
BR2_LINUX_KERNEL=y
BR2_LINUX_KERNEL_CUSTOM_VERSION=y
BR2_LINUX_KERNEL_CUSTOM_VERSION_VALUE="5.12.11"
BR2_LINUX_KERNEL_DEFCONFIG="stm32"
BR2_LINUX_KERNEL_CONFIG_FRAGMENT_FILES="$(LINUX_DIR)/arch/arm/configs/dram_0x00000000.config board/stmicroelectronics/stm32f469-disco/linux.fragment"
BR2_LINUX_KERNEL_IMAGE_TARGET_CUSTOM=y
BR2_LINUX_KERNEL_IMAGE_TARGET_NAME="zImage"
BR2_LINUX_KERNEL_DTS_SUPPORT=y
BR2_LINUX_KERNEL_INTREE_DTS_NAME="stm32f469-disco"
BR2_PACKAGE_BUSYBOX_CONFIG="package/busybox/busybox-minimal.config"
BR2_TARGET_ROOTFS_EXT2=y
BR2_TARGET_ROOTFS_EXT2_SIZE="32M"
# BR2_TARGET_ROOTFS_TAR is not set
BR2_TARGET_UBOOT=y
BR2_TARGET_UBOOT_BOARD_DEFCONFIG="stm32f469-discovery"
BR2_PACKAGE_HOST_DOSFSTOOLS=y
BR2_PACKAGE_HOST_GENIMAGE=y
BR2_PACKAGE_HOST_MTOOLS=y
BR2_PACKAGE_HOST_OPENOCD=y
```

## buildroot/configs/stm32mp157a_dk1_defconfig
```kconfig
BR2_arm=y
BR2_cortex_a7=y
BR2_PACKAGE_HOST_LINUX_HEADERS_CUSTOM_5_8=y
BR2_ROOTFS_OVERLAY="board/stmicroelectronics/stm32mp157a-dk1/overlay/"
BR2_ROOTFS_POST_IMAGE_SCRIPT="board/stmicroelectronics/common/stm32mp157/post-image.sh"
BR2_LINUX_KERNEL=y
BR2_LINUX_KERNEL_CUSTOM_VERSION=y
BR2_LINUX_KERNEL_CUSTOM_VERSION_VALUE="5.8.13"
BR2_LINUX_KERNEL_USE_CUSTOM_CONFIG=y
BR2_LINUX_KERNEL_CUSTOM_CONFIG_FILE="board/stmicroelectronics/stm32mp157a-dk1/linux.config"
BR2_LINUX_KERNEL_DTS_SUPPORT=y
BR2_LINUX_KERNEL_INTREE_DTS_NAME="stm32mp157a-dk1"
BR2_LINUX_KERNEL_INSTALL_TARGET=y
BR2_TARGET_ROOTFS_EXT2=y
BR2_TARGET_ROOTFS_EXT2_4=y
BR2_TARGET_ROOTFS_EXT2_SIZE="120M"
# BR2_TARGET_ROOTFS_TAR is not set
BR2_TARGET_ARM_TRUSTED_FIRMWARE=y
BR2_TARGET_ARM_TRUSTED_FIRMWARE_CUSTOM_VERSION=y
BR2_TARGET_ARM_TRUSTED_FIRMWARE_CUSTOM_VERSION_VALUE="v2.2"
BR2_TARGET_ARM_TRUSTED_FIRMWARE_PLATFORM="stm32mp1"
BR2_TARGET_ARM_TRUSTED_FIRMWARE_ADDITIONAL_VARIABLES="STM32MP_SDMMC=1 AARCH32_SP=sp_min DTB_FILE_NAME=stm32mp157a-dk1.dtb"
BR2_TARGET_ARM_TRUSTED_FIRMWARE_IMAGES="*.stm32"
BR2_TARGET_ARM_TRUSTED_FIRMWARE_NEEDS_DTC=y
BR2_TARGET_UBOOT=y
BR2_TARGET_UBOOT_BUILD_SYSTEM_KCONFIG=y
BR2_TARGET_UBOOT_CUSTOM_VERSION=y
BR2_TARGET_UBOOT_CUSTOM_VERSION_VALUE="2020.07"
BR2_TARGET_UBOOT_BOARD_DEFCONFIG="stm32mp15_trusted"
BR2_TARGET_UBOOT_CONFIG_FRAGMENT_FILES="board/stmicroelectronics/stm32mp157a-dk1/uboot-fragment.config"
# BR2_TARGET_UBOOT_FORMAT_BIN is not set
BR2_TARGET_UBOOT_FORMAT_STM32=y
BR2_TARGET_UBOOT_CUSTOM_MAKEOPTS="DEVICE_TREE=stm32mp157a-dk1"
BR2_PACKAGE_HOST_GENIMAGE=y
```

## buildroot/package/abootimg/Config.in.host
```kconfig
config BR2_PACKAGE_HOST_ABOOTIMG
	bool "host abootimg"
	select BR2_PACKAGE_HOST_UTIL_LINUX
	help
	  Tool to manipulate Android Boot Images, either on files
	  or directly on /dev block devices.

	  https://github.com/ggrandou/abootimg
```

## buildroot/package/altera-stapl/Config.in
```kconfig
config BR2_PACKAGE_ALTERA_STAPL
	bool "altera-stapl"
	depends on BR2_TOOLCHAIN_HEADERS_AT_LEAST_4_8 # libgpiod
	select BR2_PACKAGE_LIBGPIOD
	help
	  Altera Jam STAPL Bytecode Player.

	  https://github.com/kontron/altera-stapl
```

## buildroot/package/asn1c/Config.in.host
```kconfig
config BR2_PACKAGE_HOST_ASN1C
	bool "host asn1c"
	help
	  ASN.1 stands for Abstract Syntax Notation One and allows
	  to describe complex data structures independently of any
	  particular programming language.

	  The asn1c is a free, open source compiler of ASN.1
	  specifications into C source code.

	  http://lionet.info/asn1c
```

## buildroot/package/babeltrace2/Config.in
```kconfig
config BR2_PACKAGE_BABELTRACE2
	bool "babeltrace2"
	depends on BR2_USE_WCHAR # libglib2
	depends on BR2_TOOLCHAIN_HAS_THREADS # libglib2
	depends on BR2_USE_MMU # libglib2
	select BR2_PACKAGE_LIBGLIB2
	help
	  Babeltrace 2 is an open-source trace manipulation toolkit.

	  The Babeltrace 2 project offers a library with a C API,
	  Python 3 bindings, and a command-line tool which makes it
	  very easy for mere mortals to view, convert, transform, and
	  analyze traces.

	  Babeltrace 2 is also the reference parser implementation of
	  the Common Trace Format (CTF), a very versatile trace format
	  followed by various tracers and tools such as LTTng and
	  barectf. The Babeltrace 2 library and its Python bindings
	  can read and write CTF traces.

	  To get support for the debugging information filter
	  component class, enable the elfutils package
	  (BR2_PACKAGE_ELFUTILS).

	  https://babeltrace.org/

comment "babeltrace2 needs a toolchain w/ wchar, threads"
	depends on BR2_USE_MMU
	depends on !BR2_USE_WCHAR || !BR2_TOOLCHAIN_HAS_THREADS
```

## buildroot/package/babeltrace2/Config.in.host
```kconfig
config BR2_PACKAGE_HOST_BABELTRACE2
	bool "host babeltrace2"
	help
	  Babeltrace 2 is an open-source trace manipulation toolkit.

	  The Babeltrace 2 project offers a library with a C API,
	  Python 3 bindings, and a command-line tool which makes it
	  very easy for mere mortals to view, convert, transform, and
	  analyze traces.

	  Babeltrace 2 is also the reference parser implementation of
	  the Common Trace Format (CTF), a very versatile trace format
	  followed by various tracers and tools such as LTTng and
	  barectf. The Babeltrace 2 library and its Python bindings
	  can read and write CTF traces.

	  https://babeltrace.org/
```

## buildroot/package/balena-engine/Config.in
```kconfig
config BR2_PACKAGE_BALENA_ENGINE
	bool "balena-engine"
	depends on BR2_PACKAGE_HOST_GO_TARGET_ARCH_SUPPORTS
	depends on BR2_PACKAGE_HOST_GO_TARGET_CGO_LINKING_SUPPORTS
	depends on !BR2_TOOLCHAIN_USES_UCLIBC # no fexecve
	depends on BR2_USE_MMU # util-linux
	select BR2_PACKAGE_CGROUPFS_MOUNT if !BR2_PACKAGE_SYSTEMD # runtime
	select BR2_PACKAGE_IPTABLES # runtime
	select BR2_PACKAGE_SQLITE # runtime
	select BR2_PACKAGE_UTIL_LINUX # runtime
	select BR2_PACKAGE_UTIL_LINUX_BINARIES # runtime
	select BR2_PACKAGE_UTIL_LINUX_MOUNT # runtime
	select BR2_PACKAGE_UTIL_LINUX_MOUNTPOINT # runtime
	select BR2_PACKAGE_UTIL_LINUX_PIVOT_ROOT # runtime
	help
	  balenaEngine is a new container engine purpose-built for
	  embedded and IoT use cases and compatible with Docker
	  containers.

	  https://github.com/balena-os/balena-engine

comment "balena-engine needs a glibc or musl toolchain w/ threads"
	depends on BR2_PACKAGE_HOST_GO_TARGET_ARCH_SUPPORTS
	depends on BR2_PACKAGE_HOST_GO_TARGET_CGO_LINKING_SUPPORTS
	depends on !BR2_TOOLCHAIN_HAS_THREADS || BR2_TOOLCHAIN_USES_UCLIBC
	depends on BR2_USE_MMU
```

## buildroot/package/bitwise/Config.in
```kconfig
config BR2_PACKAGE_BITWISE
	bool "bitwise"
	select BR2_PACKAGE_NCURSES
	select BR2_PACKAGE_READLINE
	help
	  Bitwise is multi base interactive calculator
	  supporting dynamic base conversion and bit manipulation.
	  It's a handy tool for low level hackers,
	  kernel developers and device drivers developers.

	  https://github.com/mellowcandle/bitwise
```

## buildroot/package/bluez5_utils/Config.in
```kconfig
config BR2_PACKAGE_BLUEZ5_UTILS
	bool "bluez-utils"
	depends on BR2_USE_WCHAR # libglib2
	depends on BR2_TOOLCHAIN_HAS_THREADS # dbus, libglib2
	depends on BR2_USE_MMU # dbus
	depends on !BR2_STATIC_LIBS # uses dlfcn
	depends on BR2_TOOLCHAIN_HEADERS_AT_LEAST_3_4
	depends on BR2_TOOLCHAIN_HAS_SYNC_4
	select BR2_PACKAGE_DBUS
	select BR2_PACKAGE_LIBGLIB2
	help
	  BlueZ utils

	  Provides Stack, Library and Tooling for Bluetooth Classic
	  and Bluetooth LE.

	  BlueZ utils will use systemd and/or udev if enabled.

	  http://www.bluez.org
	  http://www.kernel.org/pub/linux/bluetooth

if BR2_PACKAGE_BLUEZ5_UTILS

config BR2_PACKAGE_BLUEZ5_UTILS_OBEX
	bool "build OBEX support"
	depends on BR2_INSTALL_LIBSTDCPP
	select BR2_PACKAGE_LIBICAL
	help
	  Enable OBEX support.

comment "OBEX support needs a toolchain w/ C++"
	depends on !BR2_INSTALL_LIBSTDCPP

config BR2_PACKAGE_BLUEZ5_UTILS_CLIENT
	bool "build CLI client"
	select BR2_PACKAGE_READLINE
	help
	  Build the command line client "bluetoothctl".

config BR2_PACKAGE_BLUEZ5_UTILS_DEPRECATED
	bool "install deprecated tools"
	depends on BR2_PACKAGE_BLUEZ5_UTILS_CLIENT
	help
	  Build deprecated tools. These currently include:
	  hciattach, hciconfig, hcitool, hcidump, rfcomm, sdptool,
	  ciptool, gatttool.

config BR2_PACKAGE_BLUEZ5_UTILS_EXPERIMENTAL
	bool "build experimental tools"
	help
	  Build experimental tools. This is currently only the
	  "Nokia OBEX PC Suite tool". So, only if OBEX support is
	  enabled this option has an effect.

config BR2_PACKAGE_BLUEZ5_UTILS_PLUGINS_HEALTH
	bool "build health plugin"
	help
	  Build plugin for health profiles.

config BR2_PACKAGE_BLUEZ5_UTILS_PLUGINS_MESH
	bool "build mesh plugin"
	depends on BR2_TOOLCHAIN_HEADERS_AT_LEAST_4_12 # ell
	select BR2_PACKAGE_ELL
	select BR2_PACKAGE_JSON_C
	select BR2_PACKAGE_READLINE
	help
	  Build plugin for Mesh support.

comment "mesh profile needs a toolchain w/ headers >= 4.12"
	depends on !BR2_TOOLCHAIN_HEADERS_AT_LEAST_4_12

config BR2_PACKAGE_BLUEZ5_UTILS_PLUGINS_MIDI
	bool "build midi plugin"
	select BR2_PACKAGE_ALSA_LIB
	select BR2_PACKAGE_ALSA_LIB_SEQ
	help
	  Build MIDI support via ALSA sequencer.

config BR2_PACKAGE_BLUEZ5_UTILS_PLUGINS_NFC
	bool "build nfc plugin"
	help
	  Build plugin for NFC pairing.

config BR2_PACKAGE_BLUEZ5_UTILS_PLUGINS_SAP
	bool "build sap plugin"
	help
	  Build plugin for SAP profile.

config BR2_PACKAGE_BLUEZ5_UTILS_PLUGINS_SIXAXIS
	bool "build sixaxis plugin"
	depends on BR2_PACKAGE_HAS_UDEV
	help
	  Build sixaxis plugin (support Sony Dualshock
	  controller)

comment "sixaxis plugin needs udev /dev management"
	depends on !BR2_PACKAGE_HAS_UDEV

config BR2_PACKAGE_BLUEZ5_UTILS_TEST
	bool "install test scripts"
	help
	  Install the python test scripts from the "test" directory.

config BR2_PACKAGE_BLUEZ5_UTILS_TOOLS_HID2HCI
	bool "build hid2hci tool"
	depends on BR2_PACKAGE_HAS_UDEV
	help
	  Build hid2hci tool

comment "hid2hci tool needs udev /dev management"
	depends on !BR2_PACKAGE_HAS_UDEV

endif

comment "bluez5-utils needs a toolchain w/ wchar, threads, headers >= 3.4, dynamic library"
	depends on !BR2_USE_WCHAR || !BR2_TOOLCHAIN_HAS_THREADS || \
		!BR2_TOOLCHAIN_HEADERS_AT_LEAST_3_4 || BR2_STATIC_LIBS
	depends on BR2_TOOLCHAIN_HAS_SYNC_4
	depends on BR2_USE_MMU
```

## buildroot/package/bridge-utils/Config.in
```kconfig
config BR2_PACKAGE_BRIDGE_UTILS
	bool "bridge-utils"
	help
	  Manage ethernet bridging; a way to connect networks together
	  to form a larger network.

	  This utility is DEPRECATED. No new features will ever be
	  added. Instead use the bridge command from the iproute2
	  package which supports more features.

	  https://git.kernel.org/cgit/linux/kernel/git/shemminger/bridge-utils.git/
```

## buildroot/package/casync/Config.in
```kconfig
config BR2_PACKAGE_CASYNC
	bool "casync"
	depends on BR2_TOOLCHAIN_USES_GLIBC # scandirat() is not implemented by musl and uclibc-ng
	select BR2_PACKAGE_ACL
	select BR2_PACKAGE_LIBCURL
	select BR2_PACKAGE_OPENSSL
	help
	  Content-Addressable Data Synchronization Tool

	  https://github.com/systemd/casync

comment "casync needs a glibc toolchain"
	depends on !BR2_TOOLCHAIN_USES_GLIBC
```
