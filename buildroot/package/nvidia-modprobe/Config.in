## buildroot/package/nvidia-modprobe/Config.in
```kconfig
config BR2_PACKAGE_NVIDIA_MODPROBE
	bool "nvidia-modprobe"
	depends on BR2_USE_MMU # fork()
	help
	  nvidia-modprobe package adds a utility and headers for
	  probing the NVIDIA hardware at runtime.

	  https://github.com/NVIDIA/nvidia-modprobe
```

## buildroot/package/oathtoolkit/Config.in
```kconfig
config BR2_PACKAGE_OATHTOOLKIT
        bool "oathtoolkit"
        help
          Generate and validate OATH one−time passwords.

          http://www.nongnu.org/oath-toolkit/
```

## buildroot/package/oathtoolkit/Config.in.host
```kconfig
config BR2_PACKAGE_HOST_OATHTOOLKIT
        bool "host oathtoolkit"
        help
          Generate and validate OATH one−time passwords. 

          http://www.nongnu.org/oath-toolkit/
```

## buildroot/package/odb/Config.in.host
```kconfig
config BR2_PACKAGE_HOST_ODB
	bool "host-odb"
	select BR2_NEEDS_HOST_GCC_PLUGIN_SUPPORT
	help
	  This is a compiler that takes a specially crafted c++ header
	  file and auto-generates a schema that works with libodb and
	  the subsequent libodb-database library.

	  https://www.codesynthesis.com/products/odb/
```

## buildroot/package/odroidc2-firmware/Config.in
```kconfig
config BR2_PACKAGE_ODROIDC2_FIRMWARE
	bool "odroidc2-firmware"
	help
	  This package extracts from
	  https://github.com/hardkernel/u-boot/tree/odroidc2-v2015.01
	  the pre-built firmware files, as well as the host tool
	  fip_create that are needed to create bootable images for the
	  Odroid C2 platform. See doc/board/amlogic/odroid-c2.rst in
	  upstream U-Boot for more details.

	  https://github.com/hardkernel/u-boot/tree/odroidc2-v2015.01
```

## buildroot/package/open62541/Config.in
```kconfig
config BR2_PACKAGE_OPEN62541
	bool "open62541"
	help
	  open62541 is an open source and free implementation of OPC UA.

	  http://open62541.org

if BR2_PACKAGE_OPEN62541

choice
	prompt "namespace zero nodes"
	help
	  Namespace zero contains the standard-defined nodes. The full
	  namespace zero may not be required for all applications.

config BR2_PACKAGE_OPEN62541_UA_NAMESPACE_ZERO_DEFAULT
	bool "default"
	help
	  Use the default namespace zero contents.

config BR2_PACKAGE_OPEN62541_UA_NAMESPACE_ZERO_MINIMAL
	bool "minimal"
	help
	  A barebones namespace zero that is compatible with most
	  clients.  But this namespace 0 is so small that it does not
	  pass the CTT (Conformance Testing Tools of the OPC
	  Foundation).

config BR2_PACKAGE_OPEN62541_UA_NAMESPACE_ZERO_REDUCED
	bool "reduced"
	help
	  Small namespace zero that passes the CTT.

config BR2_PACKAGE_OPEN62541_UA_NAMESPACE_ZERO_FULL
	bool "full"
	help
	  Full namespace zero generated from the official XML
	  definitions.

endchoice

config BR2_PACKAGE_OPEN62541_JSON_ENCODING
	bool "json encoding"

config BR2_PACKAGE_OPEN62541_PUBSUB
	bool "publish/subscribe"
	help
	  Enable the experimental OPC UA PubSub support. The option
	  will include the PubSub UDP multicast plugin.

if BR2_PACKAGE_OPEN62541_PUBSUB

config BR2_PACKAGE_OPEN62541_PUBSUB_DELTAFRAMES
	bool "publish/subscribe deltaframes"
	help
	  The PubSub messages differentiate between keyframe (all
	  published values contained) and deltaframe (only changed
	  values contained) messages. Deltaframe messages creation
	  consumes some additional ressources.

config BR2_PACKAGE_OPEN62541_PUBSUB_INFORMATIONMODEL
	bool "publish/subscribe information model"
	depends on BR2_PACKAGE_OPEN62541_UA_NAMESPACE_ZERO_REDUCED || \
		BR2_PACKAGE_OPEN62541_UA_NAMESPACE_ZERO_FULL
	help
	  Enable the information model representation of the PubSub
	  configuration.

endif # BR2_PACKAGE_OPEN62541_PUBSUB

endif
```

## buildroot/package/openfpgaloader/Config.in
```kconfig
config BR2_PACKAGE_OPENFPGALOADER
	bool "openfpgaloader"
	depends on BR2_TOOLCHAIN_HAS_THREADS # libftdi1
	depends on BR2_TOOLCHAIN_GCC_AT_LEAST_4_9 # libftdi1 -> libusb
	depends on BR2_INSTALL_LIBSTDCPP
	select BR2_PACKAGE_LIBFTDI1
	help
	  Universal utility for programming FPGA

	  https://github.com/trabucayre/openFPGALoader/

comment "openfpgaloader needs a toolchain w/ threads, C++, gcc >= 4.9"
	depends on !BR2_TOOLCHAIN_HAS_THREADS || \
		!BR2_INSTALL_LIBSTDCPP || \
		!BR2_TOOLCHAIN_GCC_AT_LEAST_4_9
```

## buildroot/package/openocd/Config.in.host
```kconfig
config BR2_PACKAGE_HOST_OPENOCD
	bool "host openocd"
	depends on BR2_HOST_GCC_AT_LEAST_4_9 # host-libusb
	help
	  OpenOCD - Open On-Chip Debugger

	  http://openocd.org/

comment "host openocd needs a toolchain w/ host gcc >= 4.9"
	depends on !BR2_HOST_GCC_AT_LEAST_4_9
```

## buildroot/package/openssh/Config.in
```kconfig
config BR2_PACKAGE_OPENSSH
	bool "openssh"
	depends on BR2_USE_MMU # fork()
	select BR2_PACKAGE_OPENSSL
	select BR2_PACKAGE_ZLIB
	help
	  A free version of the SSH protocol suite of network
	  connectivity tools. The standard 'ssh', 'sshd', 'scp', and
	  friends.

	  http://www.openssh.com/

if BR2_PACKAGE_OPENSSH

config BR2_PACKAGE_OPENSSH_CLIENT
	bool "client"
	default y
	help
	  Client programs: ssh, scp, sftp, ssh-agent, ssh-add,
	  ssh-copy-id.

config BR2_PACKAGE_OPENSSH_SERVER
	bool "server"
	default y
	help
	  Server programs: sshd, sftp-server

config BR2_PACKAGE_OPENSSH_KEY_UTILS
	bool "key utilities"
	default y
	help
	  Key utilities: ssh-keygen, ssh-keyscan.

endif
```

## buildroot/package/paho-mqtt-c/Config.in
```kconfig
config BR2_PACKAGE_PAHO_MQTT_C
	bool "paho-mqtt-c"
	depends on BR2_TOOLCHAIN_HAS_THREADS
	help
	  MQTT client C library

	  https://eclipse.org/paho/clients/c/

comment "paho-mqtt-c needs a toolchain w/ threads"
	depends on !BR2_TOOLCHAIN_HAS_THREADS
```

## buildroot/package/parprouted/Config.in
```kconfig
config BR2_PACKAGE_PARPROUTED
	bool "parprouted"
	depends on BR2_USE_MMU # fork()
	depends on BR2_TOOLCHAIN_HAS_THREADS
	help
	  parprouted is a daemon for transparent IP (Layer 3) proxy ARP
	  bridging. This is useful for creation of transparent firewalls
	  and bridging networks with different MAC protocols. Also,
	  unlike standard bridging, proxy ARP bridging allows to bridge
	  Ethernet networks behind wireless nodes without using WDS or
	  layer 2 bridging.

	  https://www.hazard.maks.net/parprouted

comment "parprouted needs a toolchain w/ threads"
	depends on BR2_USE_MMU
	depends on !BR2_TOOLCHAIN_HAS_THREADS
```

## buildroot/package/pax-utils/Config.in
```kconfig
config BR2_PACKAGE_PAX_UTILS
	bool "pax-utils"
	depends on BR2_USE_WCHAR
	help
	  ELF related utils for ELF 32/64 binaries that can check files
	  for security relevant properties.

	  http://www.gentoo.org/proj/en/hardened/pax-utils.xml

comment "pax-utils needs a toolchain w/ wchar"
	depends on !BR2_USE_WCHAR
```

## buildroot/package/perl-devel-cycle/Config.in
```kconfig
config BR2_PACKAGE_PERL_DEVEL_CYCLE
	bool "perl-devel-cycle"
	help
	  Find memory cycles in objects.

	  https://metacpan.org/release/Devel-Cycle
```

## buildroot/package/perl-devel-size/Config.in
```kconfig
config BR2_PACKAGE_PERL_DEVEL_SIZE
	bool "perl-devel-size"
	depends on !BR2_STATIC_LIBS
	help
	  Perl extension for finding the memory usage of Perl
	  variables.

	  https://metacpan.org/release/Devel-Size

comment "perl-devel-size needs a toolchain w/ dynamic library"
	depends on BR2_STATIC_LIBS
```

## buildroot/package/perl-math-int64/Config.in
```kconfig
config BR2_PACKAGE_PERL_MATH_INT64
	bool "perl-math-int64"
	depends on !BR2_STATIC_LIBS
	help
	  Manipulate 64 bits integers in Perl.

	  http://metacpan.org/release/Math-Int64

comment "perl-math-int64 needs a toolchain w/ dynamic library"
	depends on BR2_STATIC_LIBS
```

## buildroot/package/perl-parse-yapp/Config.in
```kconfig
config BR2_PACKAGE_PERL_PARSE_YAPP
	bool "perl-parse-yapp"
	help
	  A perl frontend to the Parse::Yapp module.

	  https://metacpan.org/release/Parse-Yapp
```

## buildroot/package/perl/Config.in
```kconfig
config BR2_PACKAGE_PERL
	bool "perl"
	depends on BR2_USE_MMU # fork()
	help
	  Larry Wall's Practical Extraction and Report Language
	  An interpreted scripting language, known among some as
	  "Unix's Swiss Army Chainsaw".

	  http://www.perl.org/

if BR2_PACKAGE_PERL

config BR2_PACKAGE_PERL_MODULES
	string "custom module selection"
	help
	  List of space-separated perl modules (without .pm) to copy
	  to the rootfs.

	  Examples: constant Getopt/Std Time/Local

	  Module dependencies on external libraries are not automatic so
	  check your needs.

	  Leave empty for all modules (as far as the external libraries
	  are available).

config BR2_PACKAGE_PERL_THREADS
	bool "thread support"
	depends on BR2_TOOLCHAIN_HAS_THREADS
	help
	  Enable use of threads in Perl scripts

	  WARNING: The use of interpreter-based threads in Perl
	  is officially discouraged.
	  See https://perldoc.perl.org/threads.html#WARNING

endif
```

## buildroot/package/php-xdebug/Config.in
```kconfig
config BR2_PACKAGE_PHP_XDEBUG
	bool "php-xdebug"
	help
	  Extension for PHP to assist with debugging and development.

	  http://xdebug.org
```

## buildroot/package/ply/Config.in
```kconfig
config BR2_PACKAGE_PLY_ARCH_SUPPORTS
	bool
	default y if BR2_aarch64
	default y if BR2_arm
	default y if BR2_powerpc
	default y if BR2_x86_64

comment "ply needs a toolchain w/ dynamic library, headers >= 4.14"
	depends on BR2_PACKAGE_PLY_ARCH_SUPPORTS
	depends on BR2_USE_MMU
	depends on !BR2_TOOLCHAIN_HEADERS_AT_LEAST_4_14 || BR2_STATIC_LIBS

config BR2_PACKAGE_PLY
	bool "ply"
	depends on BR2_PACKAGE_PLY_ARCH_SUPPORTS
	depends on BR2_USE_MMU # fork()
	depends on BR2_TOOLCHAIN_HEADERS_AT_LEAST_4_14 # BPF_JLT
	depends on !BR2_STATIC_LIBS
	help
	  ply is a light-weight dynamic tracer for Linux. By means of
	  using the BPF it can attach probes to the linux kernel
	  (e. g. kprobes).

	  It's a small alternative to LLVM based tracers for embedded
	  systems.

	  When using debugfs needs to be mounted on /sys/kernel/debug.

	  https://wkz.github.io/ply/
```

## buildroot/package/popperjs/Config.in
```kconfig
config BR2_PACKAGE_POPPERJS
	bool "popperjs"
	help
	  Popper.js, a JavaScript Tooltip & Popover Positioning Engine.

	  https://popper.js.org
```

## buildroot/package/popt/Config.in
```kconfig
config BR2_PACKAGE_POPT
	bool "popt"
	help
	  Popt is a C library for parsing command line parameters.

	  https://github.com/rpm-software-management/popt
```

## buildroot/package/python-aiofiles/Config.in
```kconfig
config BR2_PACKAGE_PYTHON_AIOFILES
	bool "python-aiofiles"
	depends on BR2_PACKAGE_PYTHON3
	help
	  aiofiles aims to  handle local disk files in
	  asyncio applications.

	  https://pypi.org/project/aiofiles
```

## buildroot/package/python-ansicolors/Config.in
```kconfig
config BR2_PACKAGE_PYTHON_ANSICOLORS
	bool "python-ansicolors"
	help
	  ANSI colors for Python.

	  http://github.com/jonathaneunice/colors/
```

## buildroot/package/python-argon2-cffi/Config.in
```kconfig
config BR2_PACKAGE_PYTHON_ARGON2_CFFI
	bool "python-argon2-cffi"
	depends on BR2_USE_MMU # libargon2
	depends on !BR2_STATIC_LIBS # libargon2
	select BR2_PACKAGE_PYTHON_CFFI # runtime
	select BR2_PACKAGE_PYTHON_ENUM34 if BR2_PACKAGE_PYTHON # runtime
	select BR2_PACKAGE_PYTHON_SIX # runtime
	select BR2_PACKAGE_LIBARGON2
	help
	  The secure Argon2 password hashing algorithm.

	  https://argon2-cffi.readthedocs.io/
```

## buildroot/package/python-bleak/Config.in
```kconfig
config BR2_PACKAGE_PYTHON_BLEAK
	bool "python-bleak"
	depends on BR2_PACKAGE_PYTHON3
	select BR2_PACKAGE_PYTHON_TXDBUS # runtime
	help
	  Bluetooth Low Energy platform Agnostic Klient.

	  https://github.com/hbldh/bleak
```
