## buildroot/package/sunxi-tools/Config.in.host
```kconfig
config BR2_PACKAGE_HOST_SUNXI_TOOLS
	bool "host sunxi-tools"
	depends on BR2_arm
	depends on BR2_HOST_GCC_AT_LEAST_4_9 # host-libusb
	help
	  Tools for Allwinner A10 (aka sun4i) and A13 (aka sun5i)
	  based devices. This includes fex2bin which can be used to
	  compile .fex board definition files to the binary script.bin
	  format required by the linux-sunxi kernel. These tools are
	  specific for linux-sunxi kernel and do not apply to the
	  mainline Linux kernel version.

	  http://linux-sunxi.org/Sunxi-tools

comment "host sunxi-tools needs a toolchain w/ host gcc >= 4.9"
	depends on BR2_arm
	depends on !BR2_HOST_GCC_AT_LEAST_4_9
```

## buildroot/package/sysklogd/Config.in
```kconfig
config BR2_PACKAGE_SYSKLOGD
	bool "sysklogd"
	depends on BR2_USE_MMU # fork()
	depends on BR2_TOOLCHAIN_HAS_THREADS
	depends on BR2_PACKAGE_BUSYBOX_SHOW_OTHERS
	help
	  The continuation of the original sysklogd package, based on
	  the original Berkeley syslog daemon. Now with kernel
	  logging, and log rotation built-in. It can both receive from
	  and send to remote syslog servers. The v2.x series include
	  extended support for RFC5424 with an alt. syslogp() API for
	  clients.

	  https://github.com/troglobit/sysklogd/

if BR2_PACKAGE_SYSKLOGD

config BR2_PACKAGE_SYSKLOGD_REMOTE_DELAY
	int "Retry delay (sec)"
	default "180"
	help
	  Retry delay (seconds) for sending to remote syslog servers.

	  When set up to forward logs to a remote syslog server, the
	  network may not always be available. E.g., default interface
	  down, or no route to the remote server. This setting controls
	  the back-off time before retrying.

	  Default: 180 seconds

config BR2_PACKAGE_SYSKLOGD_LOGGER
	bool "logger tool"
	help
	  Generate log messages from scripts or from the command line.

	  This version of logger is receommended for use with sysklogd.
	  It makes use of the new syslogp() API for RFC5424 style logs,
	  e.g. MSGID, strucutred data (SD), etc.

	  The BusyBox, or util-linux, logger tools can also be used, but
	  are limited to RFC3164 style messages.

endif

comment "sysklogd needs a toolchain w/ threads"
	depends on BR2_USE_MMU
	depends on !BR2_TOOLCHAIN_HAS_THREADS
	depends on BR2_PACKAGE_BUSYBOX_SHOW_OTHERS
```

## buildroot/package/taglib/Config.in
```kconfig
config BR2_PACKAGE_TAGLIB
	bool "taglib"
	depends on BR2_INSTALL_LIBSTDCPP
	depends on BR2_USE_WCHAR
	help
	  TagLib is a library for reading and editing the meta-data of
	  several popular audio formats. Currently it supports both
	  ID3v1 and ID3v2 for MP3 files, Ogg Vorbis comments and ID3
	  tags and Vorbis comments in FLAC, MPC, Speex, WavPack and
	  TrueAudio files.

	  http://taglib.org/

comment "taglib needs a toolchain w/ C++, wchar"
	depends on !BR2_INSTALL_LIBSTDCPP || !BR2_USE_WCHAR
```

## buildroot/package/tegrarcm/Config.in.host
```kconfig
config BR2_PACKAGE_HOST_TEGRARCM
	bool "host tegrarcm"
	depends on BR2_arm || BR2_armeb
	depends on BR2_HOST_GCC_AT_LEAST_4_9 # host-libusb
	help
	  This program is used to send code to a Tegra device in
	  recovery mode.

	  https://github.com/NVIDIA/tegrarcm

comment "host tegrarcm needs a toolchain w/ host gcc >= 4.9"
	depends on BR2_arm || BR2_armeb
	depends on !BR2_HOST_GCC_AT_LEAST_4_9
```

## buildroot/package/timescaledb/Config.in
```kconfig
config BR2_PACKAGE_TIMESCALEDB
	bool "timescaledb"
	depends on BR2_PACKAGE_POSTGRESQL
	help
	  TimescaleDB is an open-source database designed
	  to make SQL scalable for time-series data.
	  It is engineered up from PostgreSQL and packaged
	  as a PostgreSQL extension, providing automatic
	  partitioning across time and space (partitioning key),
	  as well as full SQL support.

	  https://www.timescale.com/
```

## buildroot/package/tio/Config.in
```kconfig
config BR2_PACKAGE_TIO
	bool "tio"
	depends on !BR2_sparc64 && !BR2_sparc
	help
	  "tio" is a simple TTY terminal application which features a
	  straightforward commandline interface to easily connect to
	  TTY devices for basic input/output.

	  https://tio.github.io/

# tio is disabled for sparc and sparc64 architectures because it fails
# to build with a redefinition of 'struct termio' error, with no proper
# fix or workaround for now
comment "tio is disabled for sparc and sparc64 architectures"
	depends on BR2_sparc64 || BR2_sparc
```

## buildroot/package/tpm2-pkcs11/Config.in
```kconfig
config BR2_PACKAGE_TPM2_PKCS11
	bool "tpm2-pkcs11"
	depends on BR2_PACKAGE_LIBOPENSSL_ARCH_SUPPORTS # tpm2-tss
	depends on !BR2_STATIC_LIBS # tpm2-tss
	depends on BR2_TOOLCHAIN_HAS_THREADS
	select BR2_PACKAGE_LIBYAML
	select BR2_PACKAGE_OPENSSL
	select BR2_PACKAGE_SQLITE
	select BR2_PACKAGE_TPM2_TSS
	help
	  A PKCS#11 interface for TPM2 hardware

	  https://github.com/tpm2-software/tpm2-pkcs11

comment "tpm2-pkcs11 needs a toolchain w/ dynamic library, threads"
	depends on BR2_PACKAGE_LIBOPENSSL_ARCH_SUPPORTS
	depends on BR2_STATIC_LIBS || !BR2_TOOLCHAIN_HAS_THREADS
```

## buildroot/package/tpm2-tss/Config.in
```kconfig
config BR2_PACKAGE_TPM2_TSS
	bool "tpm2-tss"
	depends on !BR2_STATIC_LIBS # dlfcn.h
	depends on BR2_PACKAGE_LIBOPENSSL_ARCH_SUPPORTS
	select BR2_PACKAGE_LIBURIPARSER
	select BR2_PACKAGE_OPENSSL
	select BR2_PACKAGE_OPENSSL_FORCE_LIBOPENSSL
	help
	  OSS implementation of the Trusted Computing Group's (TCG) TPM2
	  Software Stack (TSS). This stack consists of the following
	  layers from top to bottom:

	  * System API (SAPI) as described in the system level API and
	    TPM command transmission interface specification. This API
	    is a 1-to-1 mapping of the TPM2 commands documented in Part
	    3 of the TPM2 specification. Additionally there are
	    asynchronous versions of each command. These asynchronous
	    variants may be useful for integration into event-driven
	    programming environments. Both the synchronous and
	    asynchronous API are exposed through a single library:
	    libtss2-sys.

	  * TPM Command Transmission Interface (TCTI) that is described
	    in the same specification. This API provides a standard
	    interface to transmit / receive TPM command / response
	    buffers. It is expected that any number of libraries
	    implementing the TCTI API will be implemented as a way to
	    abstract various platform specific IPC mechanisms. Currently
	    this repository provides two TCTI implementations:
	    libtss2-tcti-device and libtss2-tcti-mssim. The prior should
	    be used for direct access to the TPM through the Linux
	    kernel driver. The later implements the protocol exposed by
	    the Microsoft software TPM2 simulator.

	  https://github.com/tpm2-software/tpm2-tss

if BR2_PACKAGE_TPM2_TSS

config BR2_PACKAGE_TPM2_TSS_FAPI
	bool "fapi support"
	depends on BR2_TOOLCHAIN_HAS_SYNC_4 # json-c
	select BR2_PACKAGE_JSON_C
	select BR2_PACKAGE_LIBCURL
	help
	  This option allows to enable Feature API (FAPI).  Feature
	  API (FAPI) as described in the "TSS 2.0 Feature API
	  Specification" along with "TSS 2.0 JSON Data Types and
	  Policy Language Specification" This API is designed to be
	  very high-level API, intended to make programming with the
	  TPM as simple as possible. The API functions are exposed
	  through a single library: libtss2-fapi.

	  https://trustedcomputinggroup.org/wp-content/uploads/TSS_FAPI_v0.94_r04_pubrev.pdf
	  https://trustedcomputinggroup.org/wp-content/uploads/TSS_JSON_Policy_v0.7_r04_pubrev.pdf

endif

comment "tpm2-tss needs a toolchain w/ dynamic library"
	depends on BR2_PACKAGE_LIBOPENSSL_ARCH_SUPPORTS
	depends on BR2_STATIC_LIBS
```

## buildroot/package/ttyd/Config.in
```kconfig
config BR2_PACKAGE_TTYD
	bool "ttyd"
	depends on !BR2_STATIC_LIBS # libuv
	depends on BR2_TOOLCHAIN_HAS_THREADS_NPTL # libuv
	depends on BR2_TOOLCHAIN_HAS_SYNC_4 # libuv, json-c
	depends on BR2_USE_MMU # libuv
	select BR2_PACKAGE_JSON_C
	select BR2_PACKAGE_LIBUV
	select BR2_PACKAGE_LIBWEBSOCKETS
	select BR2_PACKAGE_OPENSSL
	select BR2_PACKAGE_ZLIB
	help
	  ttyd is a simple command-line tool for sharing terminal
	  over the web.

	  https://github.com/tsl0922/ttyd

comment "ttyd needs a toolchain w/ NPTL, dynamic library"
	depends on !BR2_TOOLCHAIN_HAS_THREADS_NPTL || BR2_STATIC_LIBS
	depends on BR2_USE_MMU
	depends on BR2_TOOLCHAIN_HAS_SYNC_4
```

## buildroot/package/uboot-tools/Config.in.host
```kconfig
config BR2_PACKAGE_HOST_UBOOT_TOOLS
	bool "host u-boot tools"
	help
	  Companion tools for Das U-Boot bootloader.

	  http://www.denx.de/wiki/U-Boot/WebHome

if BR2_PACKAGE_HOST_UBOOT_TOOLS

config BR2_PACKAGE_HOST_UBOOT_TOOLS_FIT_SUPPORT
	bool "Flattened Image Tree (FIT) support"
	select BR2_PACKAGE_HOST_DTC
	help
	  Enables support for Flattened Image Tree (FIT).

	  This option allows to boot the new uImage structure,
	  Flattened Image Tree. FIT is formally a FDT, which can include
	  images of various types (kernel, FDT blob, ramdisk, etc.)
	  in a single blob. To boot this new uImage structure,
	  pass the address of the blob to the "bootm" command.

if BR2_PACKAGE_HOST_UBOOT_TOOLS_FIT_SUPPORT

config BR2_PACKAGE_HOST_UBOOT_TOOLS_FIT_SIGNATURE_SUPPORT
	bool "FIT signature verification support"
	help
	  Enables support for FIT Signature Verification.

	  Flat Image Trees (FIT) supports hashing of images so that
	  these hashes can be checked on loading. This protects
	  against corruption of the image. However it does not prevent
	  the substitution of one image for another.

	  The signature feature allows the hash to be signed with a
	  private key such that it can be verified using a public key
	  later. Provided that the private key is kept secret and the
	  public key is stored in a non-volatile place, any image can
	  be verified in this way.

endif # BR2_PACKAGE_HOST_UBOOT_TOOLS_FIT_SUPPORT

config BR2_PACKAGE_HOST_UBOOT_TOOLS_ENVIMAGE
	bool "Environment image"
	help
	  Generate a valid binary environment image from a text file
	  describing the key=value pairs of the environment.

	  This option can be useful to build enviornment configurations
	  as part of a Linux / rootfs only defconfig instead of using
	  post scripts. This supports a hardware use case of a single
	  bootloader only defconfig but multiple Linux / rootfs
	  defconfigs with different boot environments.

	  The environment image will be called uboot-env.bin.

if BR2_PACKAGE_HOST_UBOOT_TOOLS_ENVIMAGE

config BR2_PACKAGE_HOST_UBOOT_TOOLS_ENVIMAGE_SOURCE
	string "Source files for environment"
	default BR2_TARGET_UBOOT_ENVIMAGE_SOURCE if BR2_TARGET_UBOOT_ENVIMAGE_SOURCE != "" # legacy
	help
	  Text files describing the environment. Files should have
	  lines of the form var=value, one per line. Blank lines and
	  lines starting with a # are ignored.

	  Multiple source files are concatenated in the order listed.

	  Leave empty to generate image from compiled-in env if a U-boot
	  target build is configured (BR2_TARGET_UBOOT)

config BR2_PACKAGE_HOST_UBOOT_TOOLS_ENVIMAGE_SIZE
	string "Size of environment"
	default BR2_TARGET_UBOOT_ENVIMAGE_SIZE if BR2_TARGET_UBOOT_ENVIMAGE_SIZE != "" # legacy
	help
	  Size of envronment, can be prefixed with 0x for hexadecimal
	  values.

config BR2_PACKAGE_HOST_UBOOT_TOOLS_ENVIMAGE_REDUNDANT
	bool "Environment has two copies"
	help
	  Some platforms define in their U-Boot configuration that the
	  U-Boot environment should be duplicated in two locations (for
	  extra safety). Check your U-Boot configuration for the
	  CONFIG_ENV_ADDR_REDUND and CONFIG_ENV_SIZE_REDUND settings to
	  see if this is the case for your platform.

	  If it is the case, then you should enable this option to
	  ensure that the U-Boot environment image generated by
	  Buildroot is compatible with the "redundant environment"
	  mechanism of U-Boot.

endif # BR2_PACKAGE_HOST_UBOOT_TOOLS_ENVIMAGE

config BR2_PACKAGE_HOST_UBOOT_TOOLS_BOOT_SCRIPT
	bool "Generate a U-Boot boot script"
	help
	  Generate a U-Boot boot script, given a file listing U-Boot
	  commands to be executed at boot time. The generated boot
	  script will be called 'boot.scr'.

if BR2_PACKAGE_HOST_UBOOT_TOOLS_BOOT_SCRIPT

config BR2_PACKAGE_HOST_UBOOT_TOOLS_BOOT_SCRIPT_SOURCE
	string "U-Boot boot script source"
	default BR2_TARGET_UBOOT_BOOT_SCRIPT_SOURCE if BR2_TARGET_UBOOT_BOOT_SCRIPT_SOURCE != "" # legacy
	help
	  Source file to generate the U-Boot boot script.

endif # BR2_PACKAGE_HOST_UBOOT_TOOLS_BOOT_SCRIPT

endif # BR2_PACKAGE_HOST_UBOOT_TOOLS
```
