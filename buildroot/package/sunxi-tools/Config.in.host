## buildroot/package/uhd/Config.in
```kconfig
comment "uhd needs a toolchain w/ C++, NPTL, wchar, dynamic library"
	depends on BR2_USE_MMU
	depends on BR2_TOOLCHAIN_SUPPORTS_ALWAYS_LOCKFREE_ATOMIC_INTS
	depends on !BR2_INSTALL_LIBSTDCPP || !BR2_USE_WCHAR || \
		!BR2_TOOLCHAIN_HAS_THREADS_NPTL || BR2_STATIC_LIBS

comment "uhd needs a toolchain not affected by GCC bug 64735"
	depends on BR2_TOOLCHAIN_HAS_GCC_BUG_64735

config BR2_PACKAGE_UHD
	bool "uhd"
	depends on BR2_INSTALL_LIBSTDCPP
	depends on !BR2_STATIC_LIBS
	depends on BR2_TOOLCHAIN_SUPPORTS_ALWAYS_LOCKFREE_ATOMIC_INTS # boost-atomic
	depends on !BR2_TOOLCHAIN_HAS_GCC_BUG_64735 # boost-thread
	depends on BR2_TOOLCHAIN_HAS_THREADS_NPTL
	depends on BR2_USE_MMU # use fork()
	depends on BR2_USE_WCHAR # boost
	select BR2_PACKAGE_BOOST
	select BR2_PACKAGE_BOOST_ATOMIC
	select BR2_PACKAGE_BOOST_CHRONO
	select BR2_PACKAGE_BOOST_DATE_TIME
	select BR2_PACKAGE_BOOST_FILESYSTEM
	select BR2_PACKAGE_BOOST_PROGRAM_OPTIONS
	select BR2_PACKAGE_BOOST_REGEX
	select BR2_PACKAGE_BOOST_SERIALIZATION
	select BR2_PACKAGE_BOOST_SYSTEM
	select BR2_PACKAGE_BOOST_THREAD
	help
	  Universal Software Radio Peripheral (USRP) Hardware Driver

	  https://kb.etthus.com

if BR2_PACKAGE_UHD

config BR2_PACKAGE_UHD_B100
	bool "b100 support"
	depends on BR2_TOOLCHAIN_GCC_AT_LEAST_4_9 # libusb
	select BR2_PACKAGE_UHD_USB
	help
	  enable B100 support

comment "B100 support needs a toolchain w/ gcc >= 4.9"
	depends on !BR2_TOOLCHAIN_GCC_AT_LEAST_4_9

config BR2_PACKAGE_UHD_B200
	bool "b200 support"
	depends on BR2_TOOLCHAIN_GCC_AT_LEAST_4_9 # libusb
	select BR2_PACKAGE_UHD_USB
	help
	  enable B200 support

comment "B200 support needs a toolchain w/ gcc >= 4.9"
	depends on !BR2_TOOLCHAIN_GCC_AT_LEAST_4_9

config BR2_PACKAGE_UHD_E300
	bool "E300 support"
	select BR2_PACKAGE_UHD_MPMD
	help
	  enable E300 support

config BR2_PACKAGE_UHD_E320
	bool "E320 support"
	select BR2_PACKAGE_UHD_MPMD
	help
	  enable E320 support

config BR2_PACKAGE_UHD_EXAMPLES
	bool "uhd-examples"
	help
	  Examples

config BR2_PACKAGE_UHD_MPMD
	bool "MPMD support"
	help
	  enable MPMD support

config BR2_PACKAGE_UHD_N230
	bool "N230 support"
	help
	  enable N230 support

config BR2_PACKAGE_UHD_N300
	bool "N300 support"
	select BR2_PACKAGE_UHD_MPMD
	help
	  enable N300 support

config BR2_PACKAGE_UHD_N320
	bool "N320 support"
	select BR2_PACKAGE_UHD_MPMD
	help
	  enable N320 support

config BR2_PACKAGE_UHD_OCTOCLOCK
	bool "OctoClock support"
	help
	  enable OctoClock support

comment "uhd python API needs python3 and a toolchain w/ glibc or musl"
	depends on !BR2_PACKAGE_PYTHON3
	depends on !BR2_PACKAGE_PYTHON_NUMPY_ARCH_SUPPORTS
	depends on !(BR2_TOOLCHAIN_USES_GLIBC && BR2_TOOLCHAIN_USES_MUSL) # python-numpy

config BR2_PACKAGE_UHD_PYTHON
	bool "python API support"
	depends on BR2_PACKAGE_PYTHON3
	depends on BR2_PACKAGE_PYTHON_NUMPY_ARCH_SUPPORTS
	depends on BR2_TOOLCHAIN_USES_GLIBC || BR2_TOOLCHAIN_USES_MUSL # python-numpy
	select BR2_PACKAGE_PYTHON_NUMPY
	select BR2_PACKAGE_PYTHON_REQUESTS
	help
	  enable python API support

config BR2_PACKAGE_UHD_RFNOC
	bool "RFNoC support"
	help
	  enable RFNoC support

config BR2_PACKAGE_UHD_USB
	bool "USB support"
	depends on BR2_TOOLCHAIN_GCC_AT_LEAST_4_9 # libusb
	select BR2_PACKAGE_LIBUSB
	help
	  enable UHD USB support

comment "USB support needs a toolchain w/ gcc >= 4.9"
	depends on !BR2_TOOLCHAIN_GCC_AT_LEAST_4_9

config BR2_PACKAGE_UHD_USRP1
	bool "USRP1 support"
	select BR2_PACKAGE_UHD_USB
	help
	  enable USRP1 support

config BR2_PACKAGE_UHD_USRP2
	bool "USRP2 support"
	help
	  enable USRP2 support

comment "uhd utils depends on python API support"
	depends on !BR2_PACKAGE_UHD_PYTHON

config BR2_PACKAGE_UHD_UTILS
	bool "uhd-utils"
	depends on BR2_PACKAGE_UHD_PYTHON
	select BR2_PACKAGE_PYTHON_SIX
	help
	  uhd-utils

config BR2_PACKAGE_UHD_X300
	bool "X300 support"
	help
	  enable X300 support

endif
```

## buildroot/package/uhubctl/Config.in
```kconfig
config BR2_PACKAGE_UHUBCTL
	bool "uhubctl"
	depends on BR2_TOOLCHAIN_HAS_THREADS # libusb
	depends on BR2_TOOLCHAIN_GCC_AT_LEAST_4_9 # libusb
	select BR2_PACKAGE_LIBUSB
	help
	  Control USB power per-port on smart USB hubs.

	  https://github.com/mvp/uhubctl

comment "uhubctl needs a toolchain w/ threads, gcc >= 4.9"
	depends on !BR2_TOOLCHAIN_HAS_THREADS || \
		!BR2_TOOLCHAIN_GCC_AT_LEAST_4_9
```

## buildroot/package/unclutter-xfixes/Config.in
```kconfig
config BR2_PACKAGE_UNCLUTTER_XFIXES
	bool "unclutter-xfixes"
	depends on BR2_PACKAGE_XORG7
	select BR2_PACKAGE_LIBEV
	select BR2_PACKAGE_XLIB_LIBX11
	select BR2_PACKAGE_XLIB_LIBXFIXES
	select BR2_PACKAGE_XLIB_LIBXI
	help
	  Remove idle cursor image from screen.

	  A rewrite of unclutter using the x11-xfixes extension.

	  https://github.com/Airblader/unclutter-xfixes
```

## buildroot/package/urandom-scripts/Config.in
```kconfig
config BR2_PACKAGE_URANDOM_SCRIPTS
	bool "urandom-initscripts"
	default y if BR2_PACKAGE_INITSCRIPTS
	depends on !BR2_PACKAGE_SYSTEMD
	help
	  Initscript to preserve the random seed between reboots.

	  WARNING: this is a poor fit to try and get high-quality
	  entropy at boot. There are better ways, like haveged, or
	  rng-tools.
```

## buildroot/package/uredir/Config.in
```kconfig
config BR2_PACKAGE_UREDIR
	bool "uredir"
	select BR2_PACKAGE_LIBUEV
	help
	  A small Linux daemon to redirect UDP connections. It can be
	  used to forward connections on small and embedded systems that
	  do not have (or want to use) iptables.

	  https://github.com/troglobit/uredir
```

## buildroot/package/usb_modeswitch_data/Config.in
```kconfig
config BR2_PACKAGE_USB_MODESWITCH_DATA
	bool "usb_modeswitch_data"
	depends on BR2_TOOLCHAIN_HAS_THREADS # usb_modeswitch -> libusb
	depends on BR2_TOOLCHAIN_GCC_AT_LEAST_4_9 # usb_modeswitch -> libusb
	select BR2_PACKAGE_USB_MODESWITCH
	help
	  USB mode switch data
	  Contains udev rules and events to allow usb_modeswitch to
	  function automatically

	  http://www.draisberghof.de/usb_modeswitch/

comment "usb_modeswitch_data needs a toolchain w/ threads, gcc >= 4.9"
	depends on !BR2_TOOLCHAIN_HAS_THREADS || \
		!BR2_TOOLCHAIN_GCC_AT_LEAST_4_9
```

## buildroot/package/usbutils/Config.in
```kconfig
config BR2_PACKAGE_USBUTILS
	bool "usbutils"
	depends on BR2_TOOLCHAIN_HAS_THREADS # libusb
	depends on BR2_TOOLCHAIN_GCC_AT_LEAST_4_9 # libusb
	depends on BR2_PACKAGE_HAS_UDEV # needs hwdb
	select BR2_PACKAGE_LIBUSB
	help
	  USB enumeration utilities

	  http://linux-usb.sourceforge.net/

comment "usbutils needs udev /dev management and toolchain w/ threads, gcc >= 4.9"
	depends on !BR2_TOOLCHAIN_HAS_THREADS || \
		!BR2_PACKAGE_HAS_UDEV || \
		!BR2_TOOLCHAIN_GCC_AT_LEAST_4_9
```

## buildroot/package/watchdog/Config.in
```kconfig
config BR2_PACKAGE_WATCHDOG
	bool "watchdog"
	depends on BR2_USE_MMU
	help
	  Watchdog is a daemon that periodically pets a watchdog device
	  if the configured system status checks pass. If they do not,
	  the daemon may execute repair commands, shutdown the system or
	  reboot it.

	  https://sourceforge.net/projects/watchdog/
```

## buildroot/package/wayland-utils/Config.in
```kconfig
config BR2_PACKAGE_WAYLAND_UTILS
	bool "wayland-utils"
	depends on BR2_PACKAGE_WAYLAND # wayland-client, wayland-server
	select BR2_PACKAGE_WAYLAND_PROTOCOLS
	help
	  Wayland utils (wayland-info).

	  https://gitlab.freedesktop.org/ofourdan/wayland-utils
```

## buildroot/package/wqy-zenhei/Config.in
```kconfig
config BR2_PACKAGE_WQY_ZENHEI
	bool "wqy-zenhei"
	help
	  "WenQuanYi Zen Hei" is a Hei-Ti Style (sans-serif) Chinese
	  font capable of text formatting and on-screen display of
	  both simplified and traditional forms of Chinese Hanzi
	  glyphs (among many other languages). Both the proportional
	  "WenQuanYi Zen Hei", as well as the monospaced typeface
	  "WenQuanYi Zen Hei Mono" provides over 35,000 glyphs,
	  including over 21,000 Chinese Hanzi. This font provides full
	  coverage of GBK (CP936) charset, CJK Unified Ideographs, as
	  well as the code-points needed for zh_CN, zh_SG, zh_TW,
	  zh_HK, zh_MO, ja (Japanese) and ko (Korean) locales for
	  fontconfig.

	  https://sourceforge.net/projects/wqy/
```

## buildroot/package/x11r7/xlib_libxshmfence/Config.in
```kconfig
config BR2_PACKAGE_XLIB_LIBXSHMFENCE
	bool "libxshmfence"
	# Due to use of SYS_futex - can be enabled again when upstream
	# adds SYS_futex64 as an alternative
	depends on !BR2_RISCV_32
	depends on BR2_TOOLCHAIN_HAS_SYNC_4
	select BR2_PACKAGE_XORGPROTO
	help
	  X.Org shmfence library
```

## buildroot/package/x11r7/xserver_xorg-server/Config.in
```kconfig
comment "xorg-server needs a glibc or uClibc toolchain"
	depends on BR2_arm && BR2_TOOLCHAIN_USES_MUSL

config BR2_PACKAGE_XSERVER_XORG_SERVER
	bool "xorg-server"
	depends on BR2_USE_MMU # fork()
	# xserver uses inb/outb on arm, which aren't available with musl
	depends on !(BR2_arm && BR2_TOOLCHAIN_USES_MUSL)
	# We need a SHA1 implementation. If either openssl or
	# libgcrypt are already part of the build, we'll use one of
	# them, otherwise, use the small libsha1 library.
	select BR2_PACKAGE_LIBSHA1 if (!BR2_PACKAGE_OPENSSL && !BR2_PACKAGE_LIBGCRYPT)
	select BR2_PACKAGE_MCOOKIE
	select BR2_PACKAGE_PIXMAN
	select BR2_PACKAGE_XFONT_FONT_ALIAS if !BR2_PACKAGE_XSERVER_XORG_SERVER_BUILTIN_FONTS
	select BR2_PACKAGE_XFONT_FONT_MISC_MISC if !BR2_PACKAGE_XSERVER_XORG_SERVER_BUILTIN_FONTS
	select BR2_PACKAGE_XFONT_FONT_CURSOR_MISC if !BR2_PACKAGE_XSERVER_XORG_SERVER_BUILTIN_FONTS
	select BR2_PACKAGE_XLIB_LIBX11
	select BR2_PACKAGE_XLIB_LIBXAU
	select BR2_PACKAGE_XLIB_LIBXCURSOR
	select BR2_PACKAGE_XLIB_LIBXDAMAGE
	select BR2_PACKAGE_XLIB_LIBXDMCP
	select BR2_PACKAGE_XLIB_LIBXEXT
	select BR2_PACKAGE_XLIB_LIBXFIXES
	select BR2_PACKAGE_XLIB_LIBXFONT2
	select BR2_PACKAGE_XLIB_LIBXFT
	select BR2_PACKAGE_XLIB_LIBXI
	select BR2_PACKAGE_XLIB_LIBXINERAMA
	select BR2_PACKAGE_XLIB_LIBXRANDR
	select BR2_PACKAGE_XLIB_LIBXRENDER
	select BR2_PACKAGE_XLIB_LIBXRES
	select BR2_PACKAGE_XLIB_LIBXXF86VM
	select BR2_PACKAGE_XLIB_LIBXKBFILE
	select BR2_PACKAGE_XLIB_XTRANS
	select BR2_PACKAGE_XDATA_XBITMAPS
	select BR2_PACKAGE_XORGPROTO
	select BR2_PACKAGE_XUTIL_UTIL_MACROS
	select BR2_PACKAGE_XKEYBOARD_CONFIG
	help
	  X.Org X server

	  http://xorg.freedesktop.org

if BR2_PACKAGE_XSERVER_XORG_SERVER

choice
	prompt "X Window System server type"
	help
	  Select the X Window System server to use

config BR2_PACKAGE_XSERVER_XORG_SERVER_MODULAR
	bool "Modular X.org"
	depends on BR2_INSTALL_LIBSTDCPP
	select BR2_PACKAGE_LIBDRM
	select BR2_PACKAGE_LIBPCIACCESS
	select BR2_PACKAGE_XLIB_LIBXSHMFENCE if \
		(BR2_TOOLCHAIN_HAS_SYNC_4 && !BR2_RISCV_32)
	help
	  This variant of the X.org server is the full-blown variant,
	  as used by desktop GNU/Linux distributions. The drivers (for
	  input and graphics) are built separately from the X.org
	  server (see the xdriver* packages).

comment "Modular X.org needs a toolchain w/ C++"
	depends on !BR2_INSTALL_LIBSTDCPP

config BR2_PACKAGE_XSERVER_XORG_SERVER_KDRIVE
	bool "KDrive / TinyX"
	help
	  This variant of the X.org server is a lightweight version
	  intended for embedded systems. The drivers (for input and
	  graphics) are built into the server. It is generally used
	  directly on top of the Linux framebuffer without DRM or
	  video card specific drivers.

endchoice

comment "Optional Servers"

config BR2_PACKAGE_XSERVER_XORG_SERVER_XVFB
	bool "Xvfb server"
	help
	  Virtual frame buffer X server.

endif
```

## buildroot/package/xerces/Config.in
```kconfig
config BR2_PACKAGE_XERCES
	bool "xerces-c++"
	depends on BR2_INSTALL_LIBSTDCPP
	depends on BR2_USE_WCHAR
	help
	  Xerces-C++ is a validating XML parser written in portable C++.

	  http://xerces.apache.org/xerces-c/

if BR2_PACKAGE_XERCES

config BR2_PACKAGE_XERCES_ENABLE_NETWORK
	bool "Enable network support"
	default y
	help
	  Enable network support in xerces

endif

comment "xerces-c++ needs a toolchain w/ C++, wchar"
	depends on !(BR2_INSTALL_LIBSTDCPP && BR2_USE_WCHAR)
```

## buildroot/package/xorcurses/Config.in
```kconfig
config BR2_PACKAGE_XORCURSES
	bool "xorcurses"
	select BR2_PACKAGE_NCURSES
	help
	  XorCurses is a game remake of the 8-bit game 'Xor'. Your task
	  is to roam around a series of mazes where you have to collect
	  all blue masks before finding the exit. Note that the game
	  needs a terminal with colors, i.e. make sure that the TERM
	  environment variable is set to "linux" ("vt100" won't work).

	  https://github.com/jwm-art-net/XorCurses/
```
