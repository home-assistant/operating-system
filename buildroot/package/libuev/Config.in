## buildroot/package/libuev/Config.in
```kconfig
config BR2_PACKAGE_LIBUEV
	bool "libuev"
	help
	  Simple event loop for Linux.

	  https://github.com/troglobit/libuev
```

## buildroot/package/libusb/Config.in
```kconfig
config BR2_PACKAGE_LIBUSB
	bool "libusb"
	depends on BR2_TOOLCHAIN_HAS_THREADS
	depends on BR2_TOOLCHAIN_GCC_AT_LEAST_4_9 # _Thread_local
	help
	  Userspace library for accessing USB devices

	  http://libusb.info/

if BR2_PACKAGE_LIBUSB

config BR2_PACKAGE_LIBUSB_EXAMPLES
	bool "build libusb examples"

endif

comment "libusb needs a toolchain w/ threads, gcc >= 4.9"
	depends on !BR2_TOOLCHAIN_HAS_THREADS || \
		!BR2_TOOLCHAIN_GCC_AT_LEAST_4_9
```

## buildroot/package/libwebsockets/Config.in
```kconfig
config BR2_PACKAGE_LIBWEBSOCKETS
	bool "libwebsockets"
	depends on !BR2_STATIC_LIBS
	select BR2_PACKAGE_ZLIB
	help
	  Libwebsockets is a lightweight pure C library built to use
	  minimal CPU and memory resources, and provide fast throughput
	  in both directions.

	  https://libwebsockets.org/

comment "libwebsockets needs a toolchain w/ dynamic library"
	depends on BR2_STATIC_LIBS
```

## buildroot/package/lua-sdl2/Config.in
```kconfig
config BR2_PACKAGE_LUA_SDL2
	bool "lua-sdl2"
	depends on !BR2_STATIC_LIBS
	depends on !BR2_PACKAGE_LUA_5_4
	select BR2_PACKAGE_SDL2
	help
	  Lua-SDL2 is a pure C binding of SDL2 to Lua 5.1, Lua 5.2,
	  Lua 5.3, and LuaJIT.

	  https://github.com/Tangent128/luasdl2

comment "lua-sdl2 needs a toolchain w/ dynamic library, Lua <= 5.3"
	depends on BR2_STATIC_LIBS || BR2_PACKAGE_LUA_5_4
```

## buildroot/package/lua/Config.in
```kconfig
config BR2_PACKAGE_LUA
	bool "lua"
	select BR2_PACKAGE_HAS_LUAINTERPRETER
	help
	  Lua is a powerful, fast, light-weight, embeddable scripting
	  language.

	  http://www.lua.org/

if BR2_PACKAGE_LUA

config BR2_PACKAGE_PROVIDES_LUAINTERPRETER
	default "lua"

choice
	prompt "Lua Version"
	default BR2_PACKAGE_LUA_5_3
	help
	  Select the version of Lua API/ABI you wish to use.

config BR2_PACKAGE_LUA_5_1
	bool "Lua 5.1.x"
	select BR2_PACKAGE_LUAINTERPRETER_ABI_VERSION_5_1

config BR2_PACKAGE_LUA_5_3
	bool "Lua 5.3.x"
	select BR2_PACKAGE_LUAINTERPRETER_ABI_VERSION_5_3

config BR2_PACKAGE_LUA_5_4
	bool "Lua 5.4.x"
	select BR2_PACKAGE_LUAINTERPRETER_ABI_VERSION_5_4

endchoice

if BR2_PACKAGE_LUA_5_3 || BR2_PACKAGE_LUA_5_4
config BR2_PACKAGE_LUA_32BITS
	bool "Use 32 bit numbers"
	default y if !BR2_ARCH_IS_64
	help
	  Use a 32 bit data type for numbers / integers instead of the
	  default 64 bit type. This option is particularly attractive
	  for small machines and embedded systems.

endif

choice
	prompt "Lua command-line editing"
	default BR2_PACKAGE_LUA_EDITING_NONE

config BR2_PACKAGE_LUA_EDITING_NONE
	bool "none"
	help
	  None.

config BR2_PACKAGE_LUA_READLINE
	bool "readline support"
	select BR2_PACKAGE_READLINE
	select BR2_PACKAGE_NCURSES
	help
	  Enables command-line editing in the Lua interpreter.

config BR2_PACKAGE_LUA_LINENOISE
	bool "linenoise support"
	select BR2_PACKAGE_LINENOISE
	help
	  Enables command-line editing in the Lua interpreter.

endchoice

endif
```

## buildroot/package/luabitop/Config.in
```kconfig
config BR2_PACKAGE_LUABITOP
	bool "luabitop"
	depends on BR2_PACKAGE_LUA_5_1
	help
	  Lua BitOp is a C extension module for Lua 5.1/5.2 which adds
	  bitwise operations on numbers.

	  http://bitop.luajit.org

comment "luabitop needs Lua 5.1"
	depends on !BR2_PACKAGE_LUA_5_1
```

## buildroot/package/luainterpreter/Config.in
```kconfig
config BR2_PACKAGE_HAS_LUAINTERPRETER
	bool

config BR2_PACKAGE_PROVIDES_LUAINTERPRETER
	string
	depends on BR2_PACKAGE_HAS_LUAINTERPRETER

config BR2_PACKAGE_LUAINTERPRETER_ABI_VERSION
	string
	default "5.1" if BR2_PACKAGE_LUAINTERPRETER_ABI_VERSION_5_1
	default "5.3" if BR2_PACKAGE_LUAINTERPRETER_ABI_VERSION_5_3
	default "5.4" if BR2_PACKAGE_LUAINTERPRETER_ABI_VERSION_5_4

config BR2_PACKAGE_LUAINTERPRETER_ABI_VERSION_5_1
	bool

config BR2_PACKAGE_LUAINTERPRETER_ABI_VERSION_5_3
	bool

config BR2_PACKAGE_LUAINTERPRETER_ABI_VERSION_5_4
	bool

config BR2_PACKAGE_PROVIDES_HOST_LUAINTERPRETER
	string
	default "host-lua"
```

## buildroot/package/lualdap/Config.in
```kconfig
config BR2_PACKAGE_LUALDAP
	bool "lualdap"
	depends on !BR2_STATIC_LIBS
	depends on !BR2_PACKAGE_LUA_5_4
	depends on BR2_USE_WCHAR # openldap
	depends on BR2_USE_MMU # openldap
	select BR2_PACKAGE_OPENLDAP
	help
	  LuaLDAP is a simple interface from Lua to an LDAP client,
	  in fact it is a bind to OpenLDAP client.

	  https://github.com/lualdap/lualdap

comment "lualdap needs a toolchain w/ wchar, dynamic library, Lua <= 5.3"
	depends on BR2_USE_MMU
	depends on !BR2_USE_WCHAR || BR2_STATIC_LIBS || BR2_PACKAGE_LUA_5_4
```

## buildroot/package/luasyslog/Config.in
```kconfig
config BR2_PACKAGE_LUASYSLOG
	bool "luasyslog"
	select BR2_PACKAGE_LUALOGGING # runtime
	help
	  syslog appender for LuaLogging.

	  https://github.com/ntd/luasyslog
```

## buildroot/package/luv/Config.in
```kconfig
config BR2_PACKAGE_LUV
	bool "luv"
	depends on BR2_TOOLCHAIN_HAS_THREADS_NPTL # libuv
	depends on BR2_USE_MMU # libuv
	depends on !BR2_STATIC_LIBS # libuv
	depends on BR2_TOOLCHAIN_HAS_SYNC_4 # libuv
	depends on !BR2_PACKAGE_LUA_5_4
	select BR2_PACKAGE_LIBUV
	help
	  libuv bindings for LuaJIT and Lua.

	  https://github.com/luvit/luv

comment "luv needs a toolchain w/ NPTL, dynamic library, Lua <= 5.3"
	depends on !BR2_TOOLCHAIN_HAS_THREADS_NPTL || BR2_STATIC_LIBS || BR2_PACKAGE_LUA_5_4
	depends on BR2_USE_MMU
	depends on BR2_TOOLCHAIN_HAS_SYNC_4
```

## buildroot/package/lz4/Config.in
```kconfig
config BR2_PACKAGE_LZ4
	bool "lz4"
	help
	  LZ4 is a very fast lossless compression algorithm, providing
	  compression speed at 400 MB/s per core, scalable with
	  multi-cores CPU. It also features an extremely fast decoder,
	  with speed in multiple GB/s per core, typically reaching RAM
	  speed limits on multi-core systems.

	  http://www.lz4.org/

if BR2_PACKAGE_LZ4

config BR2_PACKAGE_LZ4_PROGS
	bool "install programs"
	help
	  lz4, lz4c, unlz4 and lz4cat binaries

endif
```

## buildroot/package/makedumpfile/Config.in
```kconfig
config BR2_PACKAGE_MAKEDUMPFILE_ARCH_SUPPORTS
	bool
	default y if BR2_aarch64 || BR2_aarch64_be
	default y if BR2_arm || BR2_armeb
	default y if BR2_i386 || BR2_x86_64
	default y if BR2_powerpc || BR2_powerpc64 || BR2_powerpc64le
	default y if BR2_s390x
	default y if BR2_sparc64

comment "makedumpfile needs a uClibc or glibc toolchain w/ wchar, dynamic library, threads"
	depends on BR2_PACKAGE_MAKEDUMPFILE_ARCH_SUPPORTS
	depends on !BR2_USE_WCHAR || BR2_STATIC_LIBS \
		|| !BR2_TOOLCHAIN_HAS_THREADS \
		|| !(BR2_TOOLCHAIN_USES_UCLIBC || BR2_TOOLCHAIN_USES_GLIBC)

config BR2_PACKAGE_MAKEDUMPFILE
	bool "makedumpfile"
	depends on BR2_PACKAGE_MAKEDUMPFILE_ARCH_SUPPORTS
	depends on BR2_TOOLCHAIN_HAS_THREADS
	depends on !BR2_STATIC_LIBS # dlopen
	depends on BR2_USE_WCHAR
	depends on BR2_TOOLCHAIN_USES_UCLIBC || BR2_TOOLCHAIN_USES_GLIBC
	select BR2_PACKAGE_BZIP2
	select BR2_PACKAGE_ELFUTILS
	select BR2_PACKAGE_XZ
	select BR2_PACKAGE_ZLIB
	help
	  Makes a small dumpfile of kdump.

	  https://github.com/makedumpfile/makedumpfile
```

## buildroot/package/mbpfan/Config.in
```kconfig
config BR2_PACKAGE_MBPFAN
	bool "mbpfan"
	depends on BR2_USE_MMU
	help
	  Mbpfan is a daemon for MacBook laptops which monitors the
	  CPU temperature with the coretemp module, and sets the fan
	  speeds with the applesmc module.

	  https://github.com/linux-on-mac/mbpfan
```

## buildroot/package/meson-tools/Config.in.host
```kconfig
config BR2_PACKAGE_HOST_MESON_TOOLS
	bool "host meson-tools"
	help
	  meson-tools is a collection of tools for use with the
	  Amlogic Meson family of ARM based SoCs. It allows management
	  of signatures which are required for booting amlogic based
	  boards with u-boot.

	  https://github.com/afaerber/meson-tools
```

## buildroot/package/mfgtools/Config.in.host
```kconfig
config BR2_PACKAGE_HOST_MFGTOOLS
	bool "host mfgtools"
	depends on BR2_arm
	depends on BR2_HOST_GCC_AT_LEAST_4_9 # host-libusb
	help
	  This package contains the Freescale manufacturing tool.
	  It is designed to program firmware to i.MX boards during
	  production. The communication is done over USB using the
	  Freescale UTP protocol.

	  https://github.com/codeauroraforum/mfgtools

comment "host mfgtools needs a toolchain w/ host gcc >= 4.9"
	depends on BR2_arm
	depends on !BR2_HOST_GCC_AT_LEAST_4_9
```

## buildroot/package/mg/Config.in
```kconfig
config BR2_PACKAGE_MG
	bool "mg"
	depends on BR2_USE_MMU # fork()
	help
	  Emacs-like text editor (130 kiB)

	  Mg is a MicroEMACS clone with the goal of being compatible
	  with GNU Emacs, because there should never be any reason to
	  learn more than one Emacs flavor.

	  Unlike many other editors it does not require ncurses, only a
	  standard C library, making it suitable for really small and
	  embedded systems.

	  This version is based on mg2a from OpenBSD, with more features
	  and, in particular, no requirement on ncurses or termcap.

	  https://github.com/troglobit/mg/
```

## buildroot/package/mraa/Config.in
```kconfig
config BR2_PACKAGE_MRAA_ARCH_SUPPORTS
	bool
	default y if BR2_aarch64 || BR2_aarch64_be
	default y if BR2_arm || BR2_armeb
	default y if BR2_i386 || BR2_x86_64
	default y if BR2_mips || BR2_mipsel || BR2_mips64 || BR2_mips64el

config BR2_PACKAGE_MRAA
	bool "mraa"
	depends on BR2_PACKAGE_MRAA_ARCH_SUPPORTS
	depends on !BR2_STATIC_LIBS
	depends on BR2_TOOLCHAIN_HAS_THREADS
	help
	  mraa is a C/C++ library with bindings to javascript & python
	  to interface with the IO on Galileo, Edison & other
	  platforms, with a structured and sane API where port
	  names/numbering matches the board that you are on.

	  http://iotdk.intel.com/docs/master/mraa

comment "mraa needs a toolchain w/ threads, dynamic library"
	depends on BR2_PACKAGE_MRAA_ARCH_SUPPORTS
	depends on !BR2_TOOLCHAIN_HAS_THREADS || BR2_STATIC_LIBS
```

## buildroot/package/mrouted/Config.in
```kconfig
config BR2_PACKAGE_MROUTED
	bool "mrouted"
	depends on BR2_USE_MMU # fork()
	help
	  An implementation of the DVMRP multicast routing protocol.
	  Unlike PIM a DVMRP router has a distance vector protocol (like
	  RIP) built-in to figure out the reverse-path to the multicast
	  source. This package comes with mrouted and mroutectl.  Where
	  the latter is used to query status and control operation.

	  Note: at least two interfaces with MULTICAST flag is requried.

	  http://github.com/troglobit/mrouted

if BR2_PACKAGE_MROUTED

config BR2_PACKAGE_MROUTED_RSRR
	bool "enable RSRR for RSVP"
	help
	  Routing Support for Resource Reservation, currently used by
	  RSVP. This is an EXPERIMENTAL feature.

	  For details, see:
	    http://tools.ietf.org/html/draft-ietf-rsvp-routing-02

endif
```

## buildroot/package/mrp/Config.in
```kconfig
config BR2_PACKAGE_MRP
	bool "mrp"
	depends on BR2_TOOLCHAIN_HAS_THREADS
	depends on BR2_TOOLCHAIN_HEADERS_AT_LEAST_5_0
	select BR2_PACKAGE_LIBEV
	select BR2_PACKAGE_LIBMNL
	select BR2_PACKAGE_LIBNL
	help
	  This is the userspace application that configures the kernel
	  to run MRP protocol. The userspace application is made of 2
	  applications, one daemon and a client.

	  https://github.com/microchip-ung/mrp

comment "mrp needs a toolchain w/ threads, kernel headers >= 5.0"
	depends on !BR2_TOOLCHAIN_HAS_THREADS \
		|| !BR2_TOOLCHAIN_HEADERS_AT_LEAST_5_0
```

## buildroot/package/multipath-tools/Config.in
```kconfig
comment "multipath-tools needs udev and a uClibc or glibc toolchain w/ threads, dynamic library"
	depends on BR2_USE_MMU
	depends on BR2_TOOLCHAIN_HAS_SYNC_4
	depends on !BR2_TOOLCHAIN_USES_MUSL
	depends on BR2_PACKAGE_LIBURCU_ARCH_SUPPORTS
	depends on !BR2_TOOLCHAIN_HAS_THREADS || BR2_STATIC_LIBS || !BR2_PACKAGE_HAS_UDEV

config BR2_PACKAGE_MULTIPATH_TOOLS
	bool "multipath-tools"
	depends on !BR2_STATIC_LIBS
	depends on !BR2_TOOLCHAIN_USES_MUSL
	depends on BR2_USE_MMU
	depends on BR2_TOOLCHAIN_HAS_THREADS
	depends on BR2_TOOLCHAIN_HAS_SYNC_4
	depends on BR2_PACKAGE_LIBURCU_ARCH_SUPPORTS
	depends on BR2_PACKAGE_HAS_UDEV
	select BR2_PACKAGE_JSON_C
	select BR2_PACKAGE_LIBURCU
	select BR2_PACKAGE_LIBAIO
	select BR2_PACKAGE_LVM2
	select BR2_PACKAGE_LVM2_STANDARD_INSTALL
	select BR2_PACKAGE_READLINE
	help
	  This package provides the following binaries to drive
	  the Device Mapper multipathing driver:
	    * multipath - Device mapper target autoconfig.
	    * multipathd - Multipath daemon.
	    * mpathpersist - Manages SCSI persistent reservations on
	      dm multipath devices.
	    * kpartx - Create device maps from partition tables.

	  https://github.com/openSUSE/multipath-tools
```

## buildroot/package/mxsldr/Config.in.host
```kconfig
config BR2_PACKAGE_HOST_MXSLDR
	bool "host mxsldr"
	depends on BR2_arm || BR2_armeb
	depends on BR2_HOST_GCC_AT_LEAST_4_9 # host-libusb
	help
	  This package contains tools to download and execute code on
	  Freescale i.MX23 and i.MX28 SoC's through the Serial
	  Download Protocol.

	  https://gitlab.denx.de/denx/mxsldr

comment "host mxsldr needs a toolchain w/ host gcc >= 4.9"
	depends on BR2_arm || BR2_armeb
	depends on !BR2_HOST_GCC_AT_LEAST_4_9
```

## buildroot/package/neofetch/Config.in
```kconfig
config BR2_PACKAGE_NEOFETCH
	bool "neofetch"
	depends on BR2_USE_MMU # bash
	depends on BR2_PACKAGE_BUSYBOX_SHOW_OTHERS # bash
	select BR2_PACKAGE_BASH # runtime dependency
	help
	  Neofetch is a bash script to display system information,
	  including hardware, in a visually pleasing way.

	  https://github.com/dylanaraps/neofetch
```

## buildroot/package/netcalc/Config.in
```kconfig
config BR2_PACKAGE_NETCALC
	bool "netcalc"
	help
	  netcalc (40 kiB) is a slimmed down version of sipcalc
	  using the popular output format of ipcalc.  Both IPv4
	  and IPv6 are supported.

	  https://github.com/troglobit/netcalc/
```

## buildroot/package/netopeer2/Config.in
```kconfig
comment "netopeer2 needs a toolchain w/ gcc >= 4.8, C++, threads, dynamic library"
	depends on BR2_USE_MMU
	depends on BR2_STATIC_LIBS || !BR2_INSTALL_LIBSTDCPP \
		|| !BR2_TOOLCHAIN_HAS_THREADS_NPTL || !BR2_TOOLCHAIN_GCC_AT_LEAST_4_8

config BR2_PACKAGE_NETOPEER2
	bool "netopeer2"
	depends on BR2_USE_MMU # libnetconf2, libssh, sysrepo
	depends on !BR2_STATIC_LIBS # libnetconf2, libssh, libyang, sysrepo
	depends on BR2_INSTALL_LIBSTDCPP # sysrepo
	depends on BR2_TOOLCHAIN_HAS_THREADS_NPTL
	depends on BR2_TOOLCHAIN_GCC_AT_LEAST_4_8 # sysrepo
	select BR2_PACKAGE_LIBNETCONF2
	select BR2_PACKAGE_LIBSSH
	select BR2_PACKAGE_LIBSSH_SERVER # For libnetconf2 to have SSH
	select BR2_PACKAGE_LIBYANG
	select BR2_PACKAGE_OPENSSL # For libnetconf2 to have TLS
	select BR2_PACKAGE_SYSREPO
	help
	  Netopeer2 is a set of tools implementing network configuration
	  tools based on the NETCONF Protocol.

	  This is the server part.

	  https://github.com/CESNET/Netopeer2

if BR2_PACKAGE_NETOPEER2

config BR2_PACKAGE_NETOPEER2_CLI
	bool "cli"
	help
	  Enable netopeer2 CLI.

endif
```

## buildroot/package/numactl/Config.in
```kconfig
config BR2_PACKAGE_NUMACTL
	bool "numactl"
	depends on BR2_USE_MMU # madvise()
	help
	  numactl allows you to run your application on specific cpus
	  and memory nodes. It does this by supplying a NUMA memory
	  policy to the operating system before running your program.

	  https://github.com/numactl/numactl
```
