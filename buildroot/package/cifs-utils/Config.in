## buildroot/package/cifs-utils/Config.in
```kconfig
config BR2_PACKAGE_CIFS_UTILS
	bool "cifs-utils"
	# uses fork()
	depends on BR2_USE_MMU
	help
	  The in-kernel CIFS filesystem is generally the preferred
	  method for mounting SMB/CIFS shares on Linux. The in-kernel
	  CIFS filesystem relies on a set of user-space tools. That
	  package of tools is called cifs-utils. Although not really
	  part of Samba proper, these tools were originally part of
	  the Samba package. For several reasons, shipping these tools
	  as part of Samba was problematic and it was deemed better to
	  split them off into their own package.

	  http://wiki.samba.org/index.php/LinuxCIFS_utils

if BR2_PACKAGE_CIFS_UTILS

config BR2_PACKAGE_CIFS_UTILS_SMBTOOLS
	bool "smbtools"
	depends on BR2_USE_WCHAR # python3
	depends on BR2_TOOLCHAIN_HAS_THREADS # python3
	depends on !BR2_STATIC_LIBS # python3
	select BR2_PACKAGE_PYTHON3 if !BR2_PACKAGE_PYTHON # runtime
	help
	  Install the smb tools smbinfo and smb2-quota (python
	  implementations).

comment "smbtools needs a toolchain w/ wchar, threads, dynamic library"
	depends on !BR2_USE_WCHAR || !BR2_TOOLCHAIN_HAS_THREADS || \
		BR2_STATIC_LIBS

endif
```

## buildroot/package/coremark-pro/Config.in
```kconfig
config BR2_PACKAGE_COREMARK_PRO
	bool "coremark-pro"
	depends on BR2_USE_MMU # perl uses fork()
	select BR2_PACKAGE_PERL
	help
	  CoreMark-PRO is a comprehensive, advanced processor benchmark.

	  https://www.eembc.org/coremark-pro/
```

## buildroot/package/coremark/Config.in
```kconfig
config BR2_PACKAGE_COREMARK
	bool "coremark"
	help
	  CoreMark is a benchmark that measures the performance of
	  microcontrollers (MCUs) and central processing units (CPUs)
	  used in embedded systems

	  https://www.eembc.org/coremark/
```

## buildroot/package/cukinia/Config.in
```kconfig
config BR2_PACKAGE_CUKINIA
	bool "cukinia"
	depends on BR2_PACKAGE_BUSYBOX || BR2_PACKAGE_GAWK
	help
	  Cukinia is designed to help Linux-based embedded firmware
	  developers run system-level validation tests on their product.
	  It provides a simple POSIX shell overlay, and primitives to
	  make sure system integrations and features keep behaving the
	  way they should.

	  By default, cukinia reports colorized test results on stdout,
	  but can also report them as CSV and JUnit-XML for easy
	  integration with CI systems such as Jenkins.

	  https://github.com/savoirfairelinux/cukinia

comment "cukinia needs busybox or gawk"
	depends on !(BR2_PACKAGE_BUSYBOX || BR2_PACKAGE_GAWK)
```

## buildroot/package/datatables-buttons/Config.in
```kconfig
config BR2_PACKAGE_DATATABLES_BUTTONS
	bool "datatables-buttons"
	depends on BR2_PACKAGE_DATATABLES
	select BR2_PACKAGE_JSZIP
	help
	  The Buttons library for DataTables provides a framework with
	  common options and API that can be used with DataTables, but
	  is also very extensible, recognising that you will likely want
	  to use buttons which perform an action unique to your
	  applications.

	  https://datatables.net/extensions/buttons
```

## buildroot/package/datatables-fixedcolumns/Config.in
```kconfig
config BR2_PACKAGE_DATATABLES_FIXEDCOLUMNS
	bool "datatables-fixedcolumns"
	depends on BR2_PACKAGE_DATATABLES
	help
	  When making use of DataTables' x-axis scrolling feature
	  (scrollX), you may wish to fix the left or right most columns
	  in place. This extension for DataTables provides exactly this
	  option.

	  https://datatables.net/extensions/fixedcolumns
```

## buildroot/package/datatables-responsive/Config.in
```kconfig
config BR2_PACKAGE_DATATABLES_RESPONSIVE
	bool "datatables-responsive"
	depends on BR2_PACKAGE_DATATABLES
	help
	  In the modern world of responsive web design tables can often
	  cause a particular problem for designers due to their row
	  based layout.  Responsive is an extension for DataTables that
	  resolves that problem by optimising the table's layout for
	  different screen sizes through the dynamic insertion and
	  removal of columns from the table.

	  https://datatables.net/extensions/responsive
```

## buildroot/package/datatables/Config.in
```kconfig
config BR2_PACKAGE_DATATABLES
	bool "datatables"
	help
	  Javascript library providing advanced interaction controls
	  for your HTML tables.

	  https://datatables.net
```

## buildroot/package/delve/Config.in
```kconfig
# Supported architectures are listed in
# pkg/proc/native/support_sentinel.go
config BR2_PACKAGE_DELVE_ARCH_SUPPORTS
	bool
	default y if BR2_aarch64
	default y if BR2_i386
	default y if BR2_x86_64
	depends on BR2_PACKAGE_HOST_GO_TARGET_ARCH_SUPPORTS
	depends on BR2_PACKAGE_HOST_GO_TARGET_CGO_LINKING_SUPPORTS

config BR2_PACKAGE_DELVE
	bool "delve"
	depends on BR2_PACKAGE_DELVE_ARCH_SUPPORTS
	depends on BR2_TOOLCHAIN_HAS_THREADS
	help
	  Delve is a debugger for the Go programming language.

	  https://github.com/go-delve/delve

comment "delve needs a toolchain w/ threads"
	depends on BR2_PACKAGE_DELVE_ARCH_SUPPORTS
	depends on !BR2_TOOLCHAIN_HAS_THREADS
```

## buildroot/package/dfu-util/Config.in
```kconfig
config BR2_PACKAGE_DFU_UTIL
	bool "dfu-util"
	depends on BR2_TOOLCHAIN_HAS_THREADS
	depends on BR2_TOOLCHAIN_GCC_AT_LEAST_4_9 # libusb
	select BR2_PACKAGE_LIBUSB
	help
	  Dfu-util is the host side implementation of the DFU 1.0
	  specification of the USB forum. DFU is intended to download
	  and upload firmware to devices connected over USB.

	  http://dfu-util.sourceforge.net/

comment "dfu-util needs a toolchain w/ threads, gcc >= 4.9"
	depends on !BR2_TOOLCHAIN_HAS_THREADS || \
		!BR2_TOOLCHAIN_GCC_AT_LEAST_4_9
```

## buildroot/package/dfu-util/Config.in.host
```kconfig
config BR2_PACKAGE_HOST_DFU_UTIL
	bool "host dfu-util"
	depends on BR2_HOST_GCC_AT_LEAST_4_9 # host-libusb
	help
	  Dfu-util is the host side implementation of the DFU 1.0
	  specification of the USB forum. DFU is intended to download
	  and upload firmware to devices connected over USB.

	  http://dfu-util.sourceforge.net/

comment "host dfu-util needs a toolchain w/ host gcc >= 4.9"
	depends on !BR2_HOST_GCC_AT_LEAST_4_9
```

## buildroot/package/dump1090/Config.in
```kconfig
config BR2_PACKAGE_DUMP1090
	bool "dump1090"
	depends on BR2_TOOLCHAIN_HAS_THREADS # librtlsdr
	depends on BR2_TOOLCHAIN_GCC_AT_LEAST_4_9 # librtlsdr -> libusb
	select BR2_PACKAGE_LIBRTLSDR
	help
	  Dump1090 is a simple Mode S decoder for RTLSDR devices

	  https://github.com/MalcolmRobb/dump1090

comment "dump1090 needs a toolchain w/ threads, gcc >= 4.9"
	depends on !BR2_TOOLCHAIN_HAS_THREADS || \
		!BR2_TOOLCHAIN_GCC_AT_LEAST_4_9
```

## buildroot/package/earlyoom/Config.in
```kconfig
config BR2_PACKAGE_EARLYOOM
	bool "earlyoom"
	depends on BR2_USE_MMU
	help
	  Early OOM daemon for Linux.

	  User space daemon for triggering Linux OOM killer
	  before running out of memory, avoiding situations
	  where the machine becomes unresponsive from out of
	  control swapping.

	  https://github.com/rfjakob/earlyoom
```

## buildroot/package/easydbus/Config.in
```kconfig
config BR2_PACKAGE_EASYDBUS
	bool "easydbus"
	depends on BR2_USE_WCHAR # libglib2
	depends on BR2_TOOLCHAIN_HAS_THREADS # libglib2
	depends on BR2_USE_MMU # libglib2
	depends on !BR2_PACKAGE_LUA_5_4
	select BR2_PACKAGE_LIBGLIB2
	help
	  Easy to use DBus library for Lua.

	  https://github.com/mniestroj/easydbus

comment "easydbus needs a toolchain w/ wchar, threads, Lua <= 5.3"
	depends on BR2_USE_MMU
	depends on !BR2_USE_WCHAR || !BR2_TOOLCHAIN_HAS_THREADS || BR2_PACKAGE_LUA_5_4
```

## buildroot/package/easyframes/Config.in
```kconfig
config BR2_PACKAGE_EASYFRAMES
	bool "easyframes"
	depends on BR2_USE_MMU # fork()
	select BR2_PACKAGE_LIBPCAP
	help
	  This is a small and simple command-line tool for network
	  testing.  The tool makes it simple to compose a frame,
	  inject and express what and where frames are expected to be
	  received.

	  https://github.com/microchip-ung/easyframes
```

## buildroot/package/ebtables/Config.in
```kconfig
config BR2_PACKAGE_EBTABLES
	bool "ebtables"
	depends on BR2_USE_MMU # fork()
	help
	  Ethernet bridge frame table administration

	  http://ebtables.netfilter.org/

if BR2_PACKAGE_EBTABLES

config BR2_PACKAGE_EBTABLES_UTILS_SAVE
	bool "ebtables save"
	select BR2_PACKAGE_BASH # runtime
	select BR2_PACKAGE_BUSYBOX_SHOW_OTHERS # bash
	help
	  Install the ebtables-legacy-save tool

config BR2_PACKAGE_EBTABLES_UTILS_RESTORE
	bool "ebtables restore"
	help
	  Install the ebtables-legacy-restore tool

endif
```

## buildroot/package/edid-decode/Config.in
```kconfig
config BR2_PACKAGE_EDID_DECODE
	bool "edid-decode"
	depends on BR2_INSTALL_LIBSTDCPP
	depends on BR2_TOOLCHAIN_GCC_AT_LEAST_4_7 # C++11
	help
	  Decode EDID data in human-readable format.

	  https://git.linuxtv.org/edid-decode.git/

comment "edid-decode needs a toolchain w/ C++, gcc >= 4.7"
	depends on !!BR2_INSTALL_LIBSTDCPP || \
		!BR2_TOOLCHAIN_GCC_AT_LEAST_4_7
```

## buildroot/package/ell/Config.in
```kconfig
config BR2_PACKAGE_ELL
	bool "ell"
	depends on BR2_TOOLCHAIN_HAS_SYNC_4
	depends on BR2_TOOLCHAIN_HEADERS_AT_LEAST_4_12
	depends on !BR2_STATIC_LIBS
	depends on BR2_USE_WCHAR
	help
	  Embedded Linux library (ell)

	  https://01.org/ell

comment "ell needs a toolchain w/ dynamic library, wchar, headers >= 4.12"
	depends on BR2_TOOLCHAIN_HAS_SYNC_4
	depends on BR2_STATIC_LIBS || !BR2_USE_WCHAR || \
		!BR2_TOOLCHAIN_HEADERS_AT_LEAST_4_12
```

## buildroot/package/environment-setup/Config.in.host
```kconfig
config BR2_PACKAGE_HOST_ENVIRONMENT_SETUP
	bool "host environment-setup"
	help
	  Install an helper script to setup a build environment
	  based on Buildroot. It's useful when you export an sdk
	  and want to use Buildroot to build an external project.
```

## buildroot/package/erofs-utils/Config.in
```kconfig
config BR2_PACKAGE_EROFS_UTILS
	bool "erofs-utils"
	select BR2_PACKAGE_UTIL_LINUX
	select BR2_PACKAGE_UTIL_LINUX_LIBUUID
	help
	  Userspace utilities for EROFS filesystem

	  https://git.kernel.org/pub/scm/linux/kernel/git/xiang/erofs-utils.git

if BR2_PACKAGE_EROFS_UTILS

config BR2_PACKAGE_EROFS_UTILS_LZ4
	bool "lz4 support"
	select BR2_PACKAGE_LZ4
	help
	  Support LZ4 compression algorithm

config BR2_PACKAGE_EROFS_UTILS_EROFSFUSE
	bool "erofsfuse support"
	depends on BR2_USE_MMU # libfuse
	depends on !BR2_STATIC_LIBS # libfuse
	depends on BR2_TOOLCHAIN_HAS_THREADS # libfuse
	select BR2_PACKAGE_LIBFUSE
	help
	  FUSE file system client for EROFS

comment "erofsfuse needs a toolchain w/ threads, dynamic library"
	depends on BR2_USE_MMU
	depends on !BR2_TOOLCHAIN_HAS_THREADS || BR2_STATIC_LIBS

endif
```

## buildroot/package/erofs-utils/Config.in.host
```kconfig
config BR2_PACKAGE_HOST_EROFS_UTILS
	bool "host erofs-utils"
	select BR2_PACKAGE_HOST_UTIL_LINUX
	help
	  Userspace utilities for EROFS filesystem

	  https://git.kernel.org/pub/scm/linux/kernel/git/xiang/erofs-utils.git
```

## buildroot/package/freescale-imx/firmware-imx/Config.in
```kconfig
config BR2_PACKAGE_FIRMWARE_IMX
	bool "firmware-imx"
	depends on BR2_arm || BR2_aarch64 # Only relevant for i.MX
	help
	  Firmware blobs for the Freescale i.MX SoCs.

	  It contains blobs for SDMA, VPU, HDMI, EDPC, and DDR
	  training.

	  This library is provided by Freescale as-is and doesn't have
	  an upstream.

if BR2_PACKAGE_FIRMWARE_IMX

config BR2_PACKAGE_FIRMWARE_IMX_SDMA_FW_NAME
	string
	default "imx25" if BR2_PACKAGE_FREESCALE_IMX_PLATFORM_IMX25_3STACK
	default "imx51" if BR2_PACKAGE_FREESCALE_IMX_PLATFORM_IMX51
	default "imx53" if BR2_PACKAGE_FREESCALE_IMX_PLATFORM_IMX53
	default "imx6q" if BR2_PACKAGE_FREESCALE_IMX_PLATFORM_IMX6Q
	default "imx6q" if BR2_PACKAGE_FREESCALE_IMX_PLATFORM_IMX6S
	default "imx6q" if BR2_PACKAGE_FREESCALE_IMX_PLATFORM_IMX6UL
	default "imx7d" if BR2_PACKAGE_FREESCALE_IMX_PLATFORM_IMX7
	default "imx7d" if BR2_PACKAGE_FREESCALE_IMX_PLATFORM_IMX8M
	default "imx7d" if BR2_PACKAGE_FREESCALE_IMX_PLATFORM_IMX8MM
	default "imx7d" if BR2_PACKAGE_FREESCALE_IMX_PLATFORM_IMX8MN

config BR2_PACKAGE_FIRMWARE_IMX_VPU_FW_NAME
	string
	default "imx27" if BR2_PACKAGE_FREESCALE_IMX_PLATFORM_IMX27ADS
	default "imx51" if BR2_PACKAGE_FREESCALE_IMX_PLATFORM_IMX51
	default "imx53" if BR2_PACKAGE_FREESCALE_IMX_PLATFORM_IMX53
	default "imx6"  if BR2_PACKAGE_FREESCALE_IMX_PLATFORM_IMX6Q
	default "imx8"  if BR2_PACKAGE_FREESCALE_IMX_PLATFORM_IMX8
	default "imx8"  if BR2_PACKAGE_FREESCALE_IMX_PLATFORM_IMX8X

config BR2_PACKAGE_FIRMWARE_IMX_NEEDS_HDMI_FW
	bool
	default y if BR2_PACKAGE_FREESCALE_IMX_PLATFORM_IMX8M

config BR2_PACKAGE_FIRMWARE_IMX_NEEDS_EPDC_FW
	bool
	default y if BR2_PACKAGE_FREESCALE_IMX_PLATFORM_IMX6Q
	default y if BR2_PACKAGE_FREESCALE_IMX_PLATFORM_IMX6S

config BR2_PACKAGE_FIRMWARE_IMX_NEEDS_DDR_FW
	bool
	default y if BR2_PACKAGE_FREESCALE_IMX_PLATFORM_IMX8M
	default y if BR2_PACKAGE_FREESCALE_IMX_PLATFORM_IMX8MM
	default y if BR2_PACKAGE_FREESCALE_IMX_PLATFORM_IMX8MN

if BR2_PACKAGE_FIRMWARE_IMX_NEEDS_DDR_FW

choice
	bool "DDR training binaries"
	default BR2_PACKAGE_FIRMWARE_IMX_LPDDR4
	help
	  Choose the DDR training binaries to be used depending on the
	  kind of memory that is available on the target board (DDR4,
	  LPDDR4, etc...).

config BR2_PACKAGE_FIRMWARE_IMX_LPDDR4
	bool "lpddr4"
	help
	  Use LPDDR4 binaries (i.e.: lpddr4_pmu_train_*.bin)

config BR2_PACKAGE_FIRMWARE_IMX_DDR4
	bool "DDR4"
	help
	  Use DDR4 binaries (i.e.: ddr4_*_201810.bin).

endchoice # DDR training FW

config BR2_PACKAGE_FIRMWARE_IMX_IMEM_LEN
	hex "(LP)DDR IMEM padding length"
	default 0x8000
	help
	  The IMEM firmware will be padded to this length

config BR2_PACKAGE_FIRMWARE_IMX_DMEM_LEN
	hex "(LP)DDR DMEM padding length"
	default 0x4000
	help
	  The DMEM firmware will be padded to this length

endif # BR2_PACKAGE_FIRMWARE_IMX_NEEDS_DDR_FW

endif # BR2_PACKAGE_FIRMWARE_IMX
```

## buildroot/package/frotz/Config.in
```kconfig
config BR2_PACKAGE_FROTZ
	bool "frotz"
	depends on BR2_TOOLCHAIN_HAS_THREADS
	select BR2_PACKAGE_NCURSES
	help
	  Frotz is an interpreter for old Infocom adventure games and
	  other Z-code games. Note that frotz can not be run as root.
	  You must add a normal user to your buildroot configuration to
	  be able to use it.

	  https://661.org/proj/if/frotz/

comment "frotz needs a toolchain w/ threads"
	depends on !BR2_TOOLCHAIN_HAS_THREADS
```

## buildroot/package/frr/Config.in
```kconfig
config BR2_PACKAGE_FRR
	bool "frr"
	depends on BR2_TOOLCHAIN_HAS_THREADS
	depends on !BR2_STATIC_LIBS # libyang
	depends on BR2_USE_MMU # fork()
	depends on BR2_TOOLCHAIN_HAS_SYNC_4 # json-c
	select BR2_PACKAGE_BASH
	select BR2_PACKAGE_BUSYBOX_SHOW_OTHERS # bash
	select BR2_PACKAGE_C_ARES
	select BR2_PACKAGE_LIBYANG
	select BR2_PACKAGE_LIBNL
	select BR2_PACKAGE_READLINE
	select BR2_PACKAGE_JSON_C
	help
	  The FRRouting Protocol Suite.

	  FRR is free software that implements and manages various
	  IPv4 and IPv6 routing protocols.

	  https://frrouting.org

comment "frr needs a toolchain w/ threads, dynamic library"
	depends on BR2_TOOLCHAIN_HAS_SYNC_4
	depends on BR2_USE_MMU
	depends on !BR2_TOOLCHAIN_HAS_THREADS || BR2_STATIC_LIBS
```

## buildroot/package/fuse-overlayfs/Config.in
```kconfig
config BR2_PACKAGE_FUSE_OVERLAYFS
	bool "fuse-overlayfs"
	depends on BR2_USE_MMU # libfuse3
	depends on !BR2_STATIC_LIBS # libfuse3
	depends on BR2_TOOLCHAIN_HAS_THREADS # libfuse3
	depends on BR2_TOOLCHAIN_HEADERS_AT_LEAST_3_15
	select BR2_PACKAGE_LIBFUSE3
	help
	  FUSE-overlayfs is an implementation of overlay+shiftfs in
	  FUSE, intended to be used for rootless containers.

	  http://github.com/containers/fuse-overlayfs

comment "fuse-overlayfs needs a toolchain w/ threads, dynamic library, headers >= 3.15"
	depends on BR2_USE_MMU
	depends on !BR2_TOOLCHAIN_HAS_THREADS || BR2_STATIC_LIBS || \
		!BR2_TOOLCHAIN_HEADERS_AT_LEAST_3_15
```
