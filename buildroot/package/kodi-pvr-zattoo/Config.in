## buildroot/package/libodb-boost/Config.in
```kconfig
config BR2_PACKAGE_LIBODB_BOOST
	bool "libodb-boost"
	depends on BR2_TOOLCHAIN_HAS_THREADS
	depends on BR2_INSTALL_LIBSTDCPP
	depends on BR2_PACKAGE_BOOST
	select BR2_PACKAGE_LIBODB
	help
	  This package contains the common ODB runtime library. Every
	  application that includes code generated by the ODB compiler
	  will need to link to this library.

	  https://www.codesynthesis.com/products/odb/

comment "libodb-boost needs a toolchain w/ C++, threads"
	depends on !BR2_INSTALL_LIBSTDCPP || !BR2_TOOLCHAIN_HAS_THREADS
	depends on BR2_PACKAGE_BOOST
```

## buildroot/package/libodb-mysql/Config.in
```kconfig
config BR2_PACKAGE_LIBODB_MYSQL
	bool "libodb-mysql"
	depends on BR2_TOOLCHAIN_HAS_THREADS
	depends on BR2_INSTALL_LIBSTDCPP
	depends on BR2_PACKAGE_MYSQL
	select BR2_PACKAGE_LIBODB
	help
	  This package contains the MySQL ODB runtime library. Every
	  application that includes code generated for the MySQL
	  database will need to link to this library.

	  https://www.codesynthesis.com/products/odb/

comment "libodb-mysql needs a toolchain w/ C++, threads"
	depends on !BR2_INSTALL_LIBSTDCPP || !BR2_TOOLCHAIN_HAS_THREADS
	depends on BR2_PACKAGE_MYSQL
```

## buildroot/package/libodb-pgsql/Config.in
```kconfig
config BR2_PACKAGE_LIBODB_PGSQL
	bool "libodb-pgsql"
	depends on BR2_TOOLCHAIN_HAS_THREADS
	depends on BR2_INSTALL_LIBSTDCPP
	depends on BR2_PACKAGE_POSTGRESQL
	select BR2_PACKAGE_LIBODB
	help
	  This package contains the PostgreSQL ODB runtime library.
	  Every application that includes code generated for the
	  PostgreSQL database will need to link to this library.

	  https://www.codesynthesis.com/products/odb/

comment "libodb-pgsql needs a toolchain w/ C++, threads"
	depends on !BR2_INSTALL_LIBSTDCPP || !BR2_TOOLCHAIN_HAS_THREADS
	depends on BR2_PACKAGE_POSTGRESQL
```

## buildroot/package/libodb/Config.in
```kconfig
config BR2_PACKAGE_LIBODB
	bool "libodb"
	depends on BR2_TOOLCHAIN_HAS_THREADS
	depends on BR2_INSTALL_LIBSTDCPP
	help
	  This package contains the common ODB runtime library. Every
	  application that includes code generated by the ODB compiler
	  will need to link to this library.

	  https://www.codesynthesis.com/products/odb/

comment "libodb needs a toolchain w/ C++, threads"
	depends on !BR2_INSTALL_LIBSTDCPP || !BR2_TOOLCHAIN_HAS_THREADS
```

## buildroot/package/librelp/Config.in
```kconfig
config BR2_PACKAGE_LIBRELP
	bool "librelp"
	depends on BR2_TOOLCHAIN_HAS_THREADS
	help
	  Reliable Event Logging Protocol library

	  https://www.rsyslog.com/librelp/

comment "librelp needs a toolchain w/ threads"
	depends on !BR2_TOOLCHAIN_HAS_THREADS
```

## buildroot/package/librtlsdr/Config.in
```kconfig
config BR2_PACKAGE_LIBRTLSDR
	bool "librtlsdr"
	depends on BR2_TOOLCHAIN_HAS_THREADS
	depends on BR2_TOOLCHAIN_GCC_AT_LEAST_4_9 # libusb
	select BR2_PACKAGE_LIBUSB
	help
	  Library and command line programs for accessing
	  RTL2832U SDR dongles.

	  http://sdr.osmocom.org/trac/wiki/rtl-sdr/

if BR2_PACKAGE_LIBRTLSDR

config BR2_PACKAGE_LIBRTLSDR_DETACH_DRIVER
	bool "Detach kernel driver"
	default y
	help
	  Enable this option if you would like librtlsdr to
	  automatically detach any kernel driver associated to the
	  RTL2832U USB device on startup if one is loaded.

config BR2_PACKAGE_LIBRTLSDR_ZEROCOPY
	bool "Enable usbfs zero-copy support"
	default y
	help
	  This option allows to use kernel usbfs mmap instead
	  of buffers in userspace. If you experiment crash with
	  kernel < 5.6, disable this option.

endif

comment "librtlsdr needs a toolchain w/ threads, gcc >= 4.9"
	depends on !BR2_TOOLCHAIN_HAS_THREADS || \
		!BR2_TOOLCHAIN_GCC_AT_LEAST_4_9
```
