## buildroot/package/kodi-pvr-zattoo/Config.in
```kconfig
config BR2_PACKAGE_KODI_PVR_ZATTOO
	bool "kodi-pvr-zattoo"
	select BR2_PACKAGE_KODI_PLATFORM
	select BR2_PACKAGE_LIBPLATFORM
	select BR2_PACKAGE_RAPIDJSON
	select BR2_PACKAGE_TINYXML2
	help
	  Kodi PVR-Addon for Zattoo

	  https://github.com/rbuehlma/pvr.zattoo
```

## buildroot/package/libabseil-cpp/Config.in
```kconfig
# see absl/debugging/internal/examine_stack.cc for the list of
# architectures that are supported, and for which ucontext is used.
config BR2_PACKAGE_LIBABSEIL_CPP_ARCH_SUPPORTS
	bool
	default y if BR2_aarch64 || BR2_aarch64_be
	default y if BR2_arm || BR2_armeb
	default y if BR2_i386
	default y if BR2_mips || BR2_mipsel || BR2_mips64 || BR2_mips64el
	default y if BR2_powerpc || BR2_powerpc64 || BR2_powerpc64le
	default y if BR2_riscv
	default y if BR2_x86_64
	depends on BR2_TOOLCHAIN_HAS_UCONTEXT

config BR2_PACKAGE_LIBABSEIL_CPP
	bool "libabseil-cpp"
	depends on BR2_INSTALL_LIBSTDCPP
	depends on BR2_TOOLCHAIN_GCC_AT_LEAST_4_9
	depends on BR2_TOOLCHAIN_HAS_THREADS
	depends on !BR2_STATIC_LIBS # uses dlfcn.h
	depends on BR2_PACKAGE_LIBABSEIL_CPP_ARCH_SUPPORTS
	help
	  Abseil is an open-source collection of C++ library code
	  designed to augment the C++ standard library. The Abseil
	  library code is collected from Google's own C++ code base,
	  has been extensively tested and used in production, and is
	  the same code we depend on in our daily coding lives.

	  https://github.com/abseil/abseil-cpp

comment "libabseil-cpp needs a toolchain w/ gcc >= 4.9, C++, threads, dynamic library"
	depends on BR2_PACKAGE_LIBABSEIL_CPP_ARCH_SUPPORTS
	depends on !BR2_INSTALL_LIBSTDCPP || !BR2_TOOLCHAIN_HAS_THREADS || \
		BR2_STATIC_LIBS || !BR2_TOOLCHAIN_GCC_AT_LEAST_4_9
```

## buildroot/package/libass/Config.in
```kconfig
config BR2_PACKAGE_LIBASS
	bool "libass"
	depends on BR2_INSTALL_LIBSTDCPP # harfbuzz
	depends on BR2_TOOLCHAIN_HAS_SYNC_4 # harfbuzz
	depends on BR2_TOOLCHAIN_GCC_AT_LEAST_4_8 # harfbuzz
	select BR2_PACKAGE_FREETYPE
	select BR2_PACKAGE_HARFBUZZ
	select BR2_PACKAGE_LIBFRIBIDI
	help
	  libass is a portable subtitle renderer for the ASS/SSA
	  (Advanced Substation Alpha/Substation Alpha) subtitle format

	  https://github.com/libass/libass

comment "libass needs a toolchain w/ C++, gcc >= 4.8"
	depends on BR2_TOOLCHAIN_HAS_SYNC_4
	depends on !BR2_INSTALL_LIBSTDCPP || \
		!BR2_TOOLCHAIN_GCC_AT_LEAST_4_8
```

## buildroot/package/libbacktrace/Config.in
```kconfig
config BR2_PACKAGE_LIBBACKTRACE
	bool "libbacktrace"
	help
	  A C library that may be linked into a C/C++ program to
	  produce symbolic backtraces

	  https://github.com/ianlancetaylor/libbacktrace
```

## buildroot/package/libblockdev/Config.in
```kconfig
config BR2_PACKAGE_LIBBLOCKDEV
	bool "libblockdev"
	depends on !BR2_STATIC_LIBS # kmod
	depends on BR2_USE_WCHAR # libglib2
	depends on BR2_TOOLCHAIN_HAS_THREADS # libglib2
	depends on BR2_USE_MMU # libglib2
	depends on BR2_PACKAGE_HAS_UDEV
	select BR2_PACKAGE_KMOD
	select BR2_PACKAGE_LIBGLIB2
	help
	  libblockdev is a C library supporting GObject introspection
	  for manipulation of block devices. It has a plugin-based
	  architecture where each technology (like LVM, Btrfs, MD RAID,
	  Swap,...) is implemented in a separate plugin, possibly with
	  multiple implementations.

	  https://github.com/storaged-project/libblockdev/

if BR2_PACKAGE_LIBBLOCKDEV

comment "plugins"

config BR2_PACKAGE_LIBBLOCKDEV_CRYPTO
	bool "crypto"
	depends on BR2_TOOLCHAIN_HAS_SYNC_4 # cryptsetup -> json-c
	select BR2_PACKAGE_CRYPTSETUP

config BR2_PACKAGE_LIBBLOCKDEV_FS
	bool "filesystem"
	depends on BR2_ENABLE_LOCALE # parted
	select BR2_PACKAGE_UTIL_LINUX
	select BR2_PACKAGE_UTIL_LINUX_LIBMOUNT
	select BR2_PACKAGE_PARTED

comment "filesystem plugin needs a toolchain w/ locale"
	depends on !BR2_ENABLE_LOCALE

config BR2_PACKAGE_LIBBLOCKDEV_LOOP
	bool "loop"

config BR2_PACKAGE_LIBBLOCKDEV_LVM2
	bool "lvm2"
	depends on BR2_ENABLE_LOCALE # parted
	select BR2_PACKAGE_PARTED
	select BR2_PACKAGE_LVM2

comment "lvm2 support needs a toolchain w/ locale"
	depends on !BR2_ENABLE_LOCALE

config BR2_PACKAGE_LIBBLOCKDEV_MDRAID
	bool "mdraid"
	select BR2_PACKAGE_LIBBYTESIZE

config BR2_PACKAGE_LIBBLOCKDEV_PART
	bool "part"
	depends on BR2_ENABLE_LOCALE # parted
	select BR2_PACKAGE_PARTED

comment "part plugin needs a toolchain w/ locale"
	depends on !BR2_ENABLE_LOCALE

config BR2_PACKAGE_LIBBLOCKDEV_SWAP
	bool "swap"
	select BR2_PACKAGE_UTIL_LINUX
	select BR2_PACKAGE_UTIL_LINUX_LIBBLKID

endif

comment "libblockdev needs udev /dev management and a toolchain w/ wchar, threads, dynamic library"
	depends on BR2_USE_MMU
	depends on !BR2_PACKAGE_HAS_UDEV || BR2_STATIC_LIBS || \
		!BR2_USE_WCHAR || !BR2_TOOLCHAIN_HAS_THREADS
```

## buildroot/package/libbytesize/Config.in
```kconfig
config BR2_PACKAGE_LIBBYTESIZE
	bool "libbytesize"
	select BR2_PACKAGE_GMP
	select BR2_PACKAGE_MPFR
	select BR2_PACKAGE_PCRE2
	help
	  A tiny library that facilitates the common operations with
	  sizes in bytes

	  https://github.com/storaged-project/libbytesize/
```

## buildroot/package/libcamera/Config.in
```kconfig
config BR2_PACKAGE_LIBCAMERA_ARCH_SUPPORTS
	bool
	default y
	# Invalid packing size of ControlValue struct on m68k
	depends on !BR2_m68k
	depends on !BR2_TOOLCHAIN_HAS_BINUTILS_BUG_27597

menuconfig BR2_PACKAGE_LIBCAMERA
	bool "libcamera"
	depends on BR2_PACKAGE_LIBCAMERA_ARCH_SUPPORTS
	depends on BR2_INSTALL_LIBSTDCPP
	depends on BR2_TOOLCHAIN_HAS_THREADS
	depends on BR2_TOOLCHAIN_GCC_AT_LEAST_7 # C++17
	depends on !BR2_STATIC_LIBS # gnutls
	depends on BR2_USE_WCHAR # gnutls
	select BR2_PACKAGE_GNUTLS
	select BR2_PACKAGE_LIBCAMERA_PIPELINE_UVCVIDEO if !BR2_PACKAGE_LIBCAMERA_HAS_PIPELINE
	help
	  libcamera provides a software stack to support
	  complex devices that need heavy hardware image
	  processing operations.

	  http://www.libcamera.org/

if BR2_PACKAGE_LIBCAMERA

config BR2_PACKAGE_LIBCAMERA_V4L2
	bool "libcamera v4l2 compatibility layer"
	help
	  libcamera v4l2 compatibility layer

config BR2_PACKAGE_LIBCAMERA_HAS_PIPELINE
	bool

config BR2_PACKAGE_LIBCAMERA_PIPELINE_IPU3
	bool "ipu3 pipeline"
	select BR2_PACKAGE_LIBCAMERA_HAS_PIPELINE
	help
	  Pipeline for Intel IPU3.

config BR2_PACKAGE_LIBCAMERA_PIPELINE_RASPBERRYPI
	bool "raspberrypi pipeline"
	depends on BR2_USE_WCHAR # boost (already enforced for gnutls)
	select BR2_PACKAGE_BOOST
	select BR2_PACKAGE_LIBCAMERA_HAS_PIPELINE
	help
	  Pipeline for Raspberry Pi devices.

config BR2_PACKAGE_LIBCAMERA_PIPELINE_RKISP1
	bool "rkisp1 pipeline"
	select BR2_PACKAGE_LIBCAMERA_HAS_PIPELINE
	help
	  Pipeline for Rockchip ISP1.

config BR2_PACKAGE_LIBCAMERA_PIPELINE_SIMPLE
	bool "simple pipeline"
	select BR2_PACKAGE_LIBCAMERA_HAS_PIPELINE
	help
	  Pipeline for simple pipelines.

config BR2_PACKAGE_LIBCAMERA_PIPELINE_UVCVIDEO
	bool "uvcvideo pipeline"
	help
	  Pipeline for uvcvideo devices.

config BR2_PACKAGE_LIBCAMERA_PIPELINE_VIMC
	bool "vimc pipeline"
	select BR2_PACKAGE_LIBCAMERA_HAS_PIPELINE
	help
	  Pipeline for the vimc device.

endif # BR2_PACKAGE_LIBCAMERA

comment "libcamera needs a toolchain w/ C++, threads, wchar, dynamic library, gcc >= 7"
	depends on BR2_PACKAGE_LIBCAMERA_ARCH_SUPPORTS
	depends on !BR2_INSTALL_LIBSTDCPP || !BR2_TOOLCHAIN_HAS_THREADS || \
		!BR2_TOOLCHAIN_GCC_AT_LEAST_7 || BR2_STATIC_LIBS || !BR2_USE_WCHAR
```

## buildroot/package/libfreefare/Config.in
```kconfig
config BR2_PACKAGE_LIBFREEFARE
	bool "libfreefare"
	select BR2_PACKAGE_OPENSSL
	select BR2_PACKAGE_LIBNFC
	help
	  Library for high level manipulation of MIFARE cards.

	  http://nfc-tools.org/index.php?title=Libfreefare
```

## buildroot/package/libftdi/Config.in
```kconfig
config BR2_PACKAGE_LIBFTDI
	bool "libftdi"
	depends on BR2_TOOLCHAIN_HAS_THREADS # libusb
	depends on BR2_TOOLCHAIN_GCC_AT_LEAST_4_9 # libusb
	select BR2_PACKAGE_LIBUSB
	select BR2_PACKAGE_LIBUSB_COMPAT
	help
	  Userspace access to FTDI USB interface chips

	  http://www.intra2net.com/en/developer/libftdi/index.php

if BR2_PACKAGE_LIBFTDI

config BR2_PACKAGE_LIBFTDI_CPP
	bool "C++ bindings"
	depends on BR2_INSTALL_LIBSTDCPP
	depends on BR2_USE_WCHAR
	select BR2_PACKAGE_BOOST
	help
	  C++ bindings for libftdi

comment "libftdi C++ bindings need a toolchain w/ wchar, C++"
	depends on !BR2_USE_WCHAR || !BR2_INSTALL_LIBSTDCPP

endif # BR2_PACKAGE_LIBFTDI

comment "libftdi needs a toolchain w/ threads, gcc >= 4.9"
	depends on !BR2_TOOLCHAIN_HAS_THREADS || \
		!BR2_TOOLCHAIN_GCC_AT_LEAST_4_9
```

## buildroot/package/libgeos/Config.in
```kconfig
config BR2_PACKAGE_LIBGEOS
	bool "libgeos"
	depends on BR2_INSTALL_LIBSTDCPP
	depends on BR2_USE_WCHAR
	depends on !BR2_TOOLCHAIN_HAS_BINUTILS_BUG_21464
	depends on !BR2_TOOLCHAIN_HAS_BINUTILS_BUG_27597
	help
	  GEOS (Geometry Engine - Open Source) is a C++ port of the
	  JTS Topology Suite (JTS). It aims to contain the complete
	  functionality of JTS in C++. This includes all the OpenGIS
	  Simple Features for SQL spatial predicate functions and
	  spatial operators, as well as specific JTS enhanced functions.

	  https://trac.osgeo.org/geos

comment "libgeos needs a toolchain w/ C++, wchar, not binutils bug 21464, 27597"
	depends on !BR2_INSTALL_LIBSTDCPP || !BR2_USE_WCHAR || \
		   BR2_TOOLCHAIN_HAS_BINUTILS_BUG_21464 || \
		   BR2_TOOLCHAIN_HAS_BINUTILS_BUG_27597
```

## buildroot/package/libgphoto2/Config.in
```kconfig
config BR2_PACKAGE_LIBGPHOTO2
	bool "libgphoto2"
	depends on BR2_TOOLCHAIN_HAS_THREADS # libusb
	depends on BR2_TOOLCHAIN_GCC_AT_LEAST_4_9 # libusb
	select BR2_PACKAGE_LIBTOOL
	select BR2_PACKAGE_LIBUSB
	select BR2_PACKAGE_LIBXML2
	help
	  libgphoto2 is the core library designed to allow access to
	  digital camera by external programs.

	  http://gphoto.org/proj/libgphoto2/

comment "libgphoto needs a toolchain w/ threads, gcc >= 4.9"
	depends on !BR2_TOOLCHAIN_HAS_THREADS || \
		!BR2_TOOLCHAIN_GCC_AT_LEAST_4_9
```

## buildroot/package/libhid/Config.in
```kconfig
config BR2_PACKAGE_LIBHID
	bool "libhid"
	depends on BR2_TOOLCHAIN_HAS_THREADS # libusb
	depends on BR2_TOOLCHAIN_GCC_AT_LEAST_4_9 # libusb
	select BR2_PACKAGE_LIBUSB
	select BR2_PACKAGE_LIBUSB_COMPAT
	help
	  Userspace library for accessing USB HID devices

	  https://directory.fsf.org/wiki/Libhid

comment "libhid needs a toolchain w/ threads, gcc >= 4.9"
	depends on !BR2_TOOLCHAIN_HAS_THREADS || \
		!BR2_TOOLCHAIN_GCC_AT_LEAST_4_9
```

## buildroot/package/libhttpserver/Config.in
```kconfig
config BR2_PACKAGE_LIBHTTPSERVER
	bool "libhttpserver"
	depends on BR2_TOOLCHAIN_GCC_AT_LEAST_5 # C++11 PR59526
	depends on BR2_INSTALL_LIBSTDCPP
	depends on BR2_TOOLCHAIN_HAS_THREADS
	select BR2_PACKAGE_LIBMICROHTTPD
	help
	  libhttpserver is a C++ library for building high performance
	  RESTfuls web servers. libhttpserver is built upon
	  libmicrohttpd to provide a simple API for developers to
	  create HTTP services in C++.

	  https://github.com/etr/libhttpserver

comment "libhttpserver needs a toolchain w/ C++, threads, gcc >= 5"
	depends on !BR2_INSTALL_LIBSTDCPP || !BR2_TOOLCHAIN_HAS_THREADS || \
		!BR2_TOOLCHAIN_GCC_AT_LEAST_5
```

## buildroot/package/libiec61850/Config.in
```kconfig
config BR2_PACKAGE_LIBIEC61850
	bool "libiec61850"
	depends on BR2_INSTALL_LIBSTDCPP
	depends on BR2_TOOLCHAIN_HAS_THREADS
	depends on !BR2_STATIC_LIBS
	help
	  IEC 61850 is an international standard for
	  communication systems in Substation Automation Systems
	  (SAS) and management of Decentralized Energy Resources
	  (DER). It is seen as one of the communication standards
	  of the emerging Smart Grid.

	  The project libIEC61850 provides a server and client
	  library for the IEC 61850/MMS, IEC 61850/GOOSE and IEC
	  61850-9-2/Sampled Values communication protocols
	  written in C. It is available under the GPLv3 license.

	  http://libiec61850.com

comment "libiec61850 needs a toolchain w/ C++, threads, dynamic library"
	depends on !BR2_INSTALL_LIBSTDCPP || !BR2_TOOLCHAIN_HAS_THREADS || BR2_STATIC_LIBS
```

## buildroot/package/libiqrf/Config.in
```kconfig
config BR2_PACKAGE_LIBIQRF
	bool "libiqrf"
	depends on BR2_TOOLCHAIN_HAS_THREADS # libusb
	depends on BR2_TOOLCHAIN_GCC_AT_LEAST_4_9 # libusb
	select BR2_PACKAGE_LIBUSB
	help
	  This library implement specific protocol
	  which is used for communicating with iqrf devices
	  (http://iqrf.org) over usb. For usb access is used
	  libusb library.

	  https://github.com/nandra/libiqrf

comment "libiqrf needs a toolchain w/ threads, gcc >= 4.9"
	depends on !BR2_TOOLCHAIN_HAS_THREADS || \
		!BR2_TOOLCHAIN_GCC_AT_LEAST_4_9
```

## buildroot/package/libllcp/Config.in
```kconfig
config BR2_PACKAGE_LIBLLCP
	bool "libllcp"
	depends on BR2_TOOLCHAIN_HAS_THREADS
	select BR2_PACKAGE_LIBNFC
	help
	  Library extending libnfc with support for Logical Link Control
	  Protocol.

	  https://github.com/nfc-tools/libllcp

comment "libllcp needs a toolchain w/ threads"
	depends on !BR2_TOOLCHAIN_HAS_THREADS
```

## buildroot/package/libmdbx/Config.in
```kconfig
config BR2_PACKAGE_LIBMDBX
	bool "libmdbx"
	depends on BR2_USE_MMU
	depends on BR2_TOOLCHAIN_HAS_SYNC_4
	depends on BR2_TOOLCHAIN_HAS_THREADS
	depends on BR2_TOOLCHAIN_GCC_AT_LEAST_4_4
	help
	  One of the fastest compact key-value ACID database
	  without WAL. libmdbx has a specific set of properties
	  and capabilities, focused on creating unique lightweight
	  solutions.

	  libmdbx surpasses the legendary LMDB in terms of
	  reliability, features and performance.

	  https://github.com/erthink/libmdbx

if BR2_PACKAGE_LIBMDBX

config BR2_PACKAGE_LIBMDBX_TOOLS
	bool "install tools"
	help
	  Install libmdbx tools for checking, dump, restore
	  and show statistics of databases.

config BR2_PACKAGE_LIBMDBX_CXX
	bool "C++ API"
	depends on BR2_INSTALL_LIBSTDCPP
	depends on BR2_TOOLCHAIN_GCC_AT_LEAST_4_8
	depends on !BR2_TOOLCHAIN_HAS_GCC_BUG_64735
	help
	  Enable modern C++11/14/17/20 API for libmdbx.

comment "libmdbx C++ support needs a toolchain w/ C++11, gcc >= 4.8 w/o bug#64735"
	depends on !BR2_INSTALL_LIBSTDCPP || \
		!BR2_TOOLCHAIN_GCC_AT_LEAST_4_8 || \
		BR2_TOOLCHAIN_HAS_GCC_BUG_64735

endif

comment "libmdbx needs MMU, a toolchain w/ threads, gcc >= 4.4 w/ 4-byte atomics"
	depends on BR2_USE_MMU
	depends on !BR2_TOOLCHAIN_HAS_THREADS || \
		!BR2_TOOLCHAIN_HAS_SYNC_4 || \
		!BR2_TOOLCHAIN_GCC_AT_LEAST_4_4
```

## buildroot/package/libnids/Config.in
```kconfig
config BR2_PACKAGE_LIBNIDS
	bool "libnids"
	select BR2_PACKAGE_LIBPCAP
	help
	  Libnids is an implementation of an E-component of Network
	  Intrusion Detection System.

	  libnids watches all local network traffic, and provides
	  convenient information on them to perform further analysis.

	  Libnids offers IP defragmentation, TCP stream assembly, TCP
	  port scan detection.

	  http://libnids.sourceforge.net/
```

## buildroot/package/libnpupnp/Config.in
```kconfig
config BR2_PACKAGE_LIBNPUPNP
	bool "libnpupnp"
	depends on BR2_INSTALL_LIBSTDCPP
	depends on BR2_TOOLCHAIN_HAS_THREADS
	depends on BR2_TOOLCHAIN_GCC_AT_LEAST_4_9 # C++11
	select BR2_PACKAGE_EXPAT
	select BR2_PACKAGE_LIBCURL
	select BR2_PACKAGE_LIBMICROHTTPD
	help
	  npupnp (new pupnp or not pupnp ?) is an UPnP library derived
	  from the venerable pupnp (https://github.com/pupnp/pupnp),
	  based on its 1.6.x branch (around 1.6.25).

	  https://www.lesbonscomptes.com/upmpdcli/libnpupnp.html

comment "libnpupnp needs a toolchain w/ C++, threads, gcc >= 4.9"
	depends on !BR2_INSTALL_LIBSTDCPP || !BR2_TOOLCHAIN_HAS_THREADS || \
		!BR2_TOOLCHAIN_GCC_AT_LEAST_4_9
```
