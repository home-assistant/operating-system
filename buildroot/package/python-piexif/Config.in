## buildroot/package/python-piexif/Config.in
```kconfig
config BR2_PACKAGE_PYTHON_PIEXIF
	bool "python-piexif"
	depends on BR2_PACKAGE_PYTHON3
	help
	  Piexif simplifies interacting with EXIF data in Python. It
	  includes the tools necessary for extracting, creating,
	  manipulating, converting and writing EXIF data to JPEG, WebP
	  and TIFF files.

	  https://github.com/hMatoba/Piexif
```

## buildroot/package/python-pluggy/Config.in
```kconfig
config BR2_PACKAGE_PYTHON_PLUGGY
	bool "python-pluggy"
	depends on BR2_PACKAGE_PYTHON3
	help
	  plugin and hook calling mechanisms for python.

	  https://github.com/pytest-dev/pluggy
```

## buildroot/package/python-pudb/Config.in
```kconfig
config BR2_PACKAGE_PYTHON_PUDB
	bool "python-pudb"
	depends on BR2_PACKAGE_PYTHON3 # pygments
	select BR2_PACKAGE_PYTHON_URWID # runtime
	select BR2_PACKAGE_PYTHON_PYGMENTS # runtime
	select BR2_PACKAGE_PYTHON_SETUPTOOLS # runtime
	select BR2_PACKAGE_PYTHON3_CURSES # runtime
	help
	  A full-screen, console-based Python debugger.

	  https://github.com/inducer/pudb
```

## buildroot/package/python-pybind/Config.in
```kconfig
config BR2_PACKAGE_PYTHON_PYBIND
	bool "python-pybind"
	help
	  PyBind is a lightweight header-only library that exposes C++
	  types in Python and vice versa, mainly to create Python
	  bindings of existing C++ code.

	  http://pybind11.readthedocs.org/en/master
```

## buildroot/package/python-pycups/Config.in
```kconfig
config BR2_PACKAGE_PYTHON_PYCUPS
	bool "python-pycups"
	depends on BR2_PACKAGE_CUPS
	depends on BR2_PACKAGE_PYTHON3
	help
	  Python bindings for libcups.

	  https://github.com/zdohnal/pycups
```

## buildroot/package/python-pyicu/Config.in
```kconfig
config BR2_PACKAGE_PYTHON_PYICU
	bool "python-pyicu"
	depends on !BR2_BINFMT_FLAT # icu
	depends on BR2_HOST_GCC_AT_LEAST_4_9 # icu
	depends on BR2_INSTALL_LIBSTDCPP # icu
	depends on BR2_TOOLCHAIN_GCC_AT_LEAST_4_9 # icu
	select BR2_PACKAGE_ICU
	help
	  Python extension wrapping the ICU C++ API.

	  https://github.com/ovalhub/pyicu

comment "python-pyicu needs a toolchain w/ C++, gcc >= 4.9, host gcc >= 4.9"
	depends on !BR2_BINFMT_FLAT
	depends on !BR2_INSTALL_LIBSTDCPP || \
		!BR2_TOOLCHAIN_GCC_AT_LEAST_4_9 || \
		!BR2_HOST_GCC_AT_LEAST_4_9
```

## buildroot/package/python-pylibftdi/Config.in
```kconfig
config BR2_PACKAGE_PYTHON_PYLIBFTDI
	bool "python-pylibftdi"
	depends on BR2_TOOLCHAIN_HAS_THREADS # libusb
	depends on BR2_TOOLCHAIN_GCC_AT_LEAST_4_9 # libftdi -> libusb
	select BR2_PACKAGE_LIBFTDI
	help
	  This package contains the python language binding libftdi.

	  https://pypi.python.org/pypi/pylibftdi

comment "python-pylibftdi needs a toolchain w/ threads, gcc >= 4.9"
	depends on !BR2_TOOLCHAIN_HAS_THREADS || \
		!BR2_TOOLCHAIN_GCC_AT_LEAST_4_9
```

## buildroot/package/python-pysftp/Config.in
```kconfig
config BR2_PACKAGE_PYTHON_PYSFTP
	bool "python-pysftp"
	depends on BR2_INSTALL_LIBSTDCPP # python-paramiko
	select BR2_PACKAGE_PYTHON_PARAMIKO # runtime
	help
	  A friendly face on SFTP.

	  https://bitbucket.org/dundeemt/pysftp

comment "python-pysftp needs a toolchain w/ C++"
	depends on !BR2_INSTALL_LIBSTDCPP
```

## buildroot/package/python-pytest-asyncio/Config.in
```kconfig
config BR2_PACKAGE_PYTHON_PYTEST_ASYNCIO
	bool "python-pytest-asyncio"
	depends on BR2_PACKAGE_PYTHON3 # pytest
	select BR2_PACKAGE_PYTHON_PYTEST # runtime
	help
	  Pytest support for asyncio.

	  https://github.com/pytest-dev/pytest-asyncio
```

## buildroot/package/python-pytest/Config.in
```kconfig
config BR2_PACKAGE_PYTHON_PYTEST
	bool "python-pytest"
	depends on BR2_PACKAGE_PYTHON3
	select BR2_PACKAGE_PYTHON_ATTRS # runtime
	select BR2_PACKAGE_PYTHON_INICONFIG # runtime
	select BR2_PACKAGE_PYTHON_PACKAGING # runtime
	select BR2_PACKAGE_PYTHON_PLUGGY # runtime
	select BR2_PACKAGE_PYTHON_PY # runtime
	select BR2_PACKAGE_PYTHON_TOML # runtime
	select BR2_PACKAGE_PYTHON3_PYEXPAT # runtime
	help
	  pytest is a framework that makes building simple and scalable
	  tests easy. Tests are expressive and readable—no boilerplate
	  code required.

	  https://docs.pytest.org/en/latest/
```

## buildroot/package/python-pyusb/Config.in
```kconfig
config BR2_PACKAGE_PYTHON_PYUSB
	bool "python-pyusb"
	depends on BR2_TOOLCHAIN_HAS_THREADS # libusb
	depends on BR2_TOOLCHAIN_GCC_AT_LEAST_4_9 # libusb
	select BR2_PACKAGE_LIBUSB
	help
	  The PyUSB module provides easy access to the Universal
	  Serial Bus (USB) from Python.

	  http://sourceforge.net/apps/trac/pyusb/

comment "python-pyusb needs a toolchain w/ threads, gcc >= 4.9"
	depends on !BR2_TOOLCHAIN_HAS_THREADS || \
		!BR2_TOOLCHAIN_GCC_AT_LEAST_4_9
```

## buildroot/package/python-remi/Config.in
```kconfig
config BR2_PACKAGE_PYTHON_REMI
	bool "python-remi"
	select BR2_PACKAGE_PYTHON_SSL if BR2_PACKAGE_PYTHON # runtime
	select BR2_PACKAGE_PYTHON3_SSL if BR2_PACKAGE_PYTHON3 # runtime
	select BR2_PACKAGE_PYTHON_SETUPTOOLS # runtime
	help
	  Remi is a GUI library for Python applications which transpiles
	  an application's interface into HTML to be rendered in a web
	  browser. This removes platform-specific dependencies and lets
	  you easily develop cross-platform applications in Python!

	  https://github.com/dddomodossola/remi/tree/master
```

## buildroot/package/python-s3transfer/Config.in
```kconfig
config BR2_PACKAGE_PYTHON_S3TRANSFER
	bool "python-s3transfer"
	select BR2_PACKAGE_PYTHON_BOTOCORE # runtime
	# runtime, not needed for python3:
	select BR2_PACKAGE_PYTHON_FUTURES if BR2_PACKAGE_PYTHON
	help
	  An Amazon S3 Transfer Manager.

	  https://github.com/boto/s3transfer
```

## buildroot/package/python-sentry-sdk/Config.in
```kconfig
config BR2_PACKAGE_PYTHON_SENTRY_SDK
	bool "python-sentry-sdk"
	select BR2_PACKAGE_PYTHON_CERTIFI # runtime
	select BR2_PACKAGE_PYTHON_URLLIB3 # runtime
	help
	  Python client for Sentry (https://sentry.io).

	  https://github.com/getsentry/sentry-python
```

## buildroot/package/python-thrift/Config.in
```kconfig
config BR2_PACKAGE_PYTHON_THRIFT
	bool "python-thrift"
	select BR2_PACKAGE_PYTHON_SIX # runtime
	help
	  Python bindings for the Apache Thrift RPC system.

	  https://thrift.apache.org
```

## buildroot/package/python-tinyrpc/Config.in
```kconfig
config BR2_PACKAGE_PYTHON_TINYRPC
	bool "python-tinyrpc"
	depends on BR2_PACKAGE_PYTHON3
	select BR2_PACKAGE_PYTHON_SIX # runtime
	help
	  A small, modular, transport and protocol neutral RPC
	  library that, among other things, supports JSON-RPC and
	  zmq.

	  http://github.com/mbr/tinyrpc
```

## buildroot/package/python-typing-extensions/Config.in
```kconfig
config BR2_PACKAGE_PYTHON_TYPING_EXTENSIONS
	bool "python-typing-extensions"
	select BR2_PACKAGE_PYTHON_TYPING if BR2_PACKAGE_PYTHON # runtime
	help
	  Backported and Experimental Type Hints for Python 3.5+.

	  https://github.com/python/typing/blob/master/typing_extensions/README.rst
```

## buildroot/package/python-validators/Config.in
```kconfig
config BR2_PACKAGE_PYTHON_VALIDATORS
	bool "python-validators"
	depends on BR2_PACKAGE_PYTHON3
	select BR2_PACKAGE_PYTHON_SIX # runtime
	select BR2_PACKAGE_PYTHON_DECORATOR # runtime
	help
	  Python Data Validation for Humans.

	  https://github.com/kvesteri/validators
```

## buildroot/package/python-xmodem/Config.in
```kconfig
config BR2_PACKAGE_PYTHON_XMODEM
	bool "python-xmodem"
	help
	  XMODEM protocol implementation.

	  https://github.com/tehmaze/xmodem
```

## buildroot/package/python-yatl/Config.in
```kconfig
config BR2_PACKAGE_PYTHON_YATL
	bool "python-yatl"
	help
	  Yet Another Template Language.

	  https://github.com/web2py/yatl
```

## buildroot/package/qcom-db410c-firmware/Config.in
```kconfig
config BR2_PACKAGE_QCOM_DB410C_FIRMWARE
	bool "qcom-db410c-firmware"
	select BR2_PACKAGE_HOST_MTOOLS
	help
	  Wifi/BT firmware for Qualcomm Dragonboard 410c SBC.

	  https://releases.linaro.org/96boards/dragonboard410c/qualcomm/firmware/
```

## buildroot/package/qprint/Config.in
```kconfig
config BR2_PACKAGE_QPRINT
	bool "qprint"
	help
	  qprint is a program that encodes and decodes binary data in
	  the Quoted-Printable encoding, defined as a part of the MIME
	  specification in RFC 1521. This encoding allows for efficient
	  transfer of mostly ASCII data over transports that are only
	  7-bit clean, like SMTP without 8BITMIME or BINARYMIME
	  extensions. It also allows the transfer of long lines of text
	  by wrapping them every 76 characters.

	  Usually, a sophisticated MUA will take care of automatically
	  choosing the best encodings for an e-mail. Nevertheless, this
	  utility may be useful when a MTA (e.g. msmtp) is used without
	  a MUA, or if using this encoding for other purposes is
	  desired.

	  https://www.fourmilab.ch/webtools/qprint/
```

## buildroot/package/qt5/qt5coap/Config.in
```kconfig
config BR2_PACKAGE_QT5COAP
	bool "qt5coap"
	help
	  Qt is a cross-platform application and UI framework for
	  developers using C++.

	  CoAP is a protocol for IoT devices, and machine to machine
	  communication. The Qt CoAP module implements the client side
	  of CoAP defined by RFC 7252.

	  https://doc.qt.io/QtCoAP/qtcoap-index.html
```

## buildroot/package/qt5/qt5knx/Config.in
```kconfig
config BR2_PACKAGE_QT5KNX
	bool "qt5knx"
	help
	  Qt is a cross-platform application and UI framework for
	  developers using C++.

	  The Qt KNX module implements the client side of a connection
	  between a client and a KNXnet/IP server. This connection
	  can be used to send messages to the KNX bus and to control
	  the functionalities of the KNX devices.

	  https://doc.qt.io/QtKNX/index.html
```

## buildroot/package/qt5/qt5lottie/Config.in
```kconfig
config BR2_PACKAGE_QT5LOTTIE
	bool "qt5lottie"
	depends on BR2_PACKAGE_QT5_JSCORE_AVAILABLE
	select BR2_PACKAGE_QT5DECLARATIVE
	select BR2_PACKAGE_QT5DECLARATIVE_QUICK
	help
	  Qt is a cross-platform application and UI framework for
	  developers using C++.

	  This package corresponds to the qt5lottie module.

	  https://doc.qt.io/qt-5/qtlottieanimation-index.html
```
