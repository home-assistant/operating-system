## buildroot/package/gerbera/Config.in
```kconfig
config BR2_PACKAGE_GERBERA
	bool "gerbera"
	depends on BR2_USE_MMU # fork()
	depends on BR2_TOOLCHAIN_HAS_ATOMIC
	depends on BR2_TOOLCHAIN_HAS_THREADS
	depends on BR2_TOOLCHAIN_GCC_AT_LEAST_8 # C++17 filesystem
	depends on BR2_INSTALL_LIBSTDCPP
	depends on BR2_USE_WCHAR # fmt
	select BR2_PACKAGE_FMT
	select BR2_PACKAGE_LIBICONV if !BR2_ENABLE_LOCALE
	select BR2_PACKAGE_LIBUPNP if !BR2_PACKAGE_LIBNPUPNP
	select BR2_PACKAGE_PUGIXML
	select BR2_PACKAGE_PUGIXML_XPATH_SUPPORT
	select BR2_PACKAGE_SPDLOG
	select BR2_PACKAGE_SQLITE
	select BR2_PACKAGE_UTIL_LINUX
	select BR2_PACKAGE_UTIL_LINUX_LIBUUID
	select BR2_PACKAGE_ZLIB
	help
	  A free media server.
	  Stream your media to devices on your home network.

	  https://gerbera.io

comment "gerbera needs a toolchain w/ C++, threads, wchar, gcc >= 8"
	depends on BR2_USE_MMU
	depends on BR2_TOOLCHAIN_HAS_ATOMIC
	depends on !BR2_INSTALL_LIBSTDCPP || !BR2_TOOLCHAIN_HAS_THREADS || \
		!BR2_USE_WCHAR || !BR2_TOOLCHAIN_GCC_AT_LEAST_8
```

## buildroot/package/gkrellm/Config.in
```kconfig
config BR2_PACKAGE_GKRELLM
	bool "gkrellm"
	depends on BR2_USE_WCHAR # libglib2
	depends on BR2_TOOLCHAIN_HAS_THREADS # libglib2
	depends on BR2_USE_MMU # libglib2
	select BR2_PACKAGE_GKRELLM_SERVER if !BR2_PACKAGE_GKRELLM_CLIENT
	select BR2_PACKAGE_LIBGLIB2
	help
	  GKrellM is a single process stack of system monitors which
	  supports applying themes to match its appearance to your
	  window manager, Gtk, or any other theme.

	  http://gkrellm.srcbox.net/

if BR2_PACKAGE_GKRELLM

config BR2_PACKAGE_GKRELLM_SERVER
	bool "server"
	help
	  Enable gkrellm server.

config BR2_PACKAGE_GKRELLM_CLIENT
	bool "client"
	depends on BR2_PACKAGE_XORG7 # libgtk2
	depends on BR2_INSTALL_LIBSTDCPP # libgtk2
	depends on BR2_TOOLCHAIN_HAS_SYNC_4 # libgtk2
	depends on BR2_TOOLCHAIN_GCC_AT_LEAST_4_8 # libgtk2
	select BR2_PACKAGE_LIBGTK2
	select BR2_PACKAGE_XLIB_LIBSM
	help
	  Enable gkrellm client.

comment "client needs a toolchain w/ C++, gcc >= 4.8"
	depends on BR2_TOOLCHAIN_HAS_SYNC_4
	depends on BR2_PACKAGE_XORG7
	depends on !BR2_INSTALL_LIBSTDCPP || \
		!BR2_TOOLCHAIN_GCC_AT_LEAST_4_8

endif # BR2_PACKAGE_GKRELLM

comment "gkrellm needs a toolchain w/ wchar, threads"
	depends on BR2_USE_MMU
	depends on !BR2_USE_WCHAR || !BR2_TOOLCHAIN_HAS_THREADS
```

## buildroot/package/gloox/Config.in
```kconfig
config BR2_PACKAGE_GLOOX
	bool "gloox"
	depends on BR2_INSTALL_LIBSTDCPP
	select BR2_PACKAGE_MPC
	help
	  gloox is a portable high-level Jabber/XMPP library for C++. It
	  is fully compliant with the XMPP RFCs, supports all of the
	  XMPP features (including SRV lookups, TLS, SASL, roster
	  management, and privacy lists), and implements several XEPs
	  that make it ideal for writing any kind of Jabber/XMPP client
	  or component.

	  https://camaya.net/gloox/

comment "gloox needs a toolchain w/ C++"
	depends on !BR2_INSTALL_LIBSTDCPP
```

## buildroot/package/graphicsmagick/Config.in
```kconfig
config BR2_PACKAGE_GRAPHICSMAGICK
	bool "graphicsmagick"
	depends on BR2_USE_MMU # fork()
	depends on BR2_TOOLCHAIN_HAS_THREADS
	help
	  GraphicsMagick is the swiss army knife of image processing.
	  It provides a robust and efficient collection of tools
	  and libraries which support reading, writing,
	  and manipulating an image in over 89 major formats
	  including important formats like DPX, GIF, JPEG, JPEG-2000,
	  PNG, PDF, PNM, TIFF, and WebP.

	  http://www.graphicsmagick.org/

comment "graphicsmagick needs a toolchain w/ threads"
	depends on BR2_USE_MMU
	depends on !BR2_TOOLCHAIN_HAS_THREADS
```

## buildroot/package/graphite2/Config.in
```kconfig
config BR2_PACKAGE_GRAPHITE2
	bool "graphite2"
	depends on BR2_INSTALL_LIBSTDCPP
	help
	  Graphite is a project within SIL's scripts and software dev
	  groups to provide cross-platform rendering for complex
	  writing systems.

	  https://github.com/silnrsi/graphite

comment "graphite2 needs a toolchain w/ C++"
	depends on !BR2_INSTALL_LIBSTDCPP
```

## buildroot/package/grpc/Config.in
```kconfig
config BR2_PACKAGE_GRPC
	bool "grpc"
	depends on BR2_INSTALL_LIBSTDCPP
	depends on BR2_TOOLCHAIN_HAS_THREADS # protobuf, re2
	depends on BR2_PACKAGE_PROTOBUF_ARCH_SUPPORTS # protobuf
	depends on BR2_TOOLCHAIN_GCC_AT_LEAST_4_9 # protobuf, re2, libabseil-cpp
	depends on BR2_HOST_GCC_AT_LEAST_4_9 # host-libabseil-cpp
	depends on !BR2_STATIC_LIBS # protobuf, libabseil-cpp
	depends on BR2_TOOLCHAIN_HAS_SYNC_4 || BR2_TOOLCHAIN_HAS_ATOMIC
	depends on BR2_PACKAGE_LIBABSEIL_CPP_ARCH_SUPPORTS
	select BR2_PACKAGE_C_ARES
	select BR2_PACKAGE_LIBABSEIL_CPP
	select BR2_PACKAGE_OPENSSL
	select BR2_PACKAGE_PROTOBUF
	select BR2_PACKAGE_RE2
	select BR2_PACKAGE_ZLIB
	help
	  A language-neutral, platform-neutral, open source, remote
	  procedure call (RPC) system initially developed at Google.

	  http://github.com/grpc/grpc

comment "grpc needs a toolchain w/ C++, threads, dynamic library, gcc >= 4.9, host gcc >= 4.9"
	depends on BR2_PACKAGE_LIBABSEIL_CPP_ARCH_SUPPORTS
	depends on BR2_TOOLCHAIN_HAS_SYNC_4 || BR2_TOOLCHAIN_HAS_ATOMIC
	depends on !BR2_INSTALL_LIBSTDCPP || !BR2_TOOLCHAIN_HAS_THREADS \
		|| BR2_STATIC_LIBS || !BR2_TOOLCHAIN_GCC_AT_LEAST_4_9 \
		|| !BR2_HOST_GCC_AT_LEAST_4_9
	depends on BR2_PACKAGE_PROTOBUF_ARCH_SUPPORTS
```

## buildroot/package/gstreamer1/gst1-devtools/Config.in
```kconfig
config BR2_PACKAGE_GST1_DEVTOOLS
	bool "gst1-devtools"
	depends on BR2_PACKAGE_PYTHON || BR2_PACKAGE_PYTHON3
	select BR2_PACKAGE_GSTREAMER1_CHECK
	select BR2_PACKAGE_GST1_PLUGINS_BASE
	select BR2_PACKAGE_JSON_GLIB
	select BR2_PACKAGE_PYTHON_PYEXPAT if BR2_PACKAGE_PYTHON
	select BR2_PACKAGE_PYTHON3_PYEXPAT if BR2_PACKAGE_PYTHON3
	# cairo is autodetected but needs PNG support
	select BR2_PACKAGE_CAIRO_PNG if BR2_PACKAGE_CAIRO
	help
	  GStreamer development tools (gst-validate).

	  https://gstreamer.freedesktop.org

comment "gst1-devtools depends on python"
	depends on !BR2_PACKAGE_PYTHON
	depends on !BR2_PACKAGE_PYTHON3
```

## buildroot/package/hdparm/Config.in
```kconfig
config BR2_PACKAGE_HDPARM
	bool "hdparm"
	depends on BR2_PACKAGE_BUSYBOX_SHOW_OTHERS
	help
	  hdparm - get/set ATA/SATA drive parameters under Linux

	  https://sourceforge.net/projects/hdparm/
```

## buildroot/package/htop/Config.in
```kconfig
config BR2_PACKAGE_HTOP
	bool "htop"
	depends on BR2_USE_MMU # fork()
	depends on !BR2_STATIC_LIBS # dlopen()
	select BR2_PACKAGE_NCURSES
	help
	  htop is an interactive text-mode process viewer for Linux.
	  It aims to be a better top.

	  https://htop.dev/

comment "htop needs a toolchain w/ dynamic library"
	depends on BR2_USE_MMU
	depends on BR2_STATIC_LIBS
```

## buildroot/package/htpdate/Config.in
```kconfig
config BR2_PACKAGE_HTPDATE
	bool "htpdate"
	depends on BR2_USE_MMU # fork()
	help
	  The HTTP Time Protocol (HTP) is used to synchronize a
	  computer's time with web servers as reference time source.

	  https://github.com/angeloc/htpdate
```

## buildroot/package/ima-evm-utils/Config.in
```kconfig
config BR2_PACKAGE_IMA_EVM_UTILS
	bool "ima-evm-utils"
	depends on BR2_USE_MMU # keyutils
	depends on BR2_PACKAGE_LIBOPENSSL_ARCH_SUPPORTS # tpm2-tss
	depends on !BR2_STATIC_LIBS # keyutils, tpm2-tss
	select BR2_PACKAGE_OPENSSL
	select BR2_PACKAGE_KEYUTILS
	select BR2_PACKAGE_TPM2_TSS
	help
	  Linux Integrity Measurement Architecture (IMA)
	  Extended Verification Module (EVM) tools.

	  https://sourceforge.net/p/linux-ima/wiki/Home/

comment "ima-evm-utils needs dynamic library support"
	depends on BR2_USE_MMU
	depends on BR2_PACKAGE_LIBOPENSSL_ARCH_SUPPORTS
	depends on BR2_STATIC_LIBS
```

## buildroot/package/imx-usb-loader/Config.in
```kconfig
config BR2_PACKAGE_IMX_USB_LOADER
	bool "imx-usb-loader"
	depends on BR2_TOOLCHAIN_HAS_THREADS # libusb
	depends on BR2_TOOLCHAIN_GCC_AT_LEAST_4_9 # libusb
	select BR2_PACKAGE_LIBUSB
	help
	  This package contains tools to download and execute code
	  on Freescale i.MX5/i.MX6 and Vybrid SoCs through the
	  Serial Download Protocol.

	  https://github.com/boundarydevices/imx_usb_loader

comment "imx-usb-loader needs a toolchain w/ threads, gcc >= 4.9"
	depends on !BR2_TOOLCHAIN_HAS_THREADS || \
		!BR2_TOOLCHAIN_GCC_AT_LEAST_4_9
```

## buildroot/package/imx-usb-loader/Config.in.host
```kconfig
config BR2_PACKAGE_HOST_IMX_USB_LOADER
	bool "host imx-usb-loader"
	depends on BR2_arm || BR2_aarch64
	depends on BR2_HOST_GCC_AT_LEAST_4_9 # host-libusb
	help
	  This package contains tools to download and execute code
	  on Freescale i.MX5x/6x/7x/8x and Vybrid SoCs through the
	  Serial Download Protocol.

	  https://github.com/boundarydevices/imx_usb_loader

comment "host imx-usb-loader needs a toolchain w/ host gcc >= 4.9"
	depends on BR2_arm || BR2_aarch64
	depends on !BR2_HOST_GCC_AT_LEAST_4_9
```

## buildroot/package/inih/Config.in
```kconfig
config BR2_PACKAGE_INIH
	bool "inih"
	help
	  inih (INI Not Invented Here) is a simple .INI file parser
	  written in C.

	  https://github.com/benhoyt/inih/
```

## buildroot/package/ipcalc/Config.in
```kconfig
config BR2_PACKAGE_IPCALC
	bool "ipcalc"
	depends on BR2_PACKAGE_BUSYBOX_SHOW_OTHERS
	help
	  A modern IPv4/IPv6 ipcalc tool, assisting in network
	  calculations in command line and as a tool for scripts.

	  https://gitlab.com/ipcalc/ipcalc
```

## buildroot/package/iptraf-ng/Config.in
```kconfig
config BR2_PACKAGE_IPTRAF_NG
	bool "iptraf-ng"
	depends on BR2_USE_MMU # fork()
	depends on BR2_TOOLCHAIN_HEADERS_AT_LEAST_3_14
	select BR2_PACKAGE_NCURSES
	help
	  IPTraf-ng is a console-based network monitoring program for
	  Linux that gathers displays information about IP traffic.

	  https://github.com/iptraf-ng/iptraf-ng

	  IPTraf-ng is a fork of original IPTraf v3.0.0
	  (http://iptraf.seul.org).

comment "iptraf-ng needs a toolchain w/ kernel headers >= 3.14"
	depends on BR2_USE_MMU
	depends on !BR2_TOOLCHAIN_HEADERS_AT_LEAST_3_14
```

## buildroot/package/iputils/Config.in
```kconfig
config BR2_PACKAGE_IPUTILS
	bool "iputils"
	depends on BR2_USE_MMU # fork()
	help
	  This package is set of small useful utilities for Linux
	  networking. It includes complete versions of ping, traceroute,
	  etc.

	  https://github.com/iputils/iputils

if BR2_PACKAGE_IPUTILS

config BR2_PACKAGE_IPUTILS_ARPING
	bool "arping"
	default y
	help
	  Installs arping.

config BR2_PACKAGE_IPUTILS_CLOCKDIFF
	bool "clockdiff"
	default y
	help
	  Installs clockdiff.

config BR2_PACKAGE_IPUTILS_PING
	bool "ping"
	default y
	help
	  Installs ping.

config BR2_PACKAGE_IPUTILS_RARPD
	bool "rarpd"
	help
	  Installs rarpd.

config BR2_PACKAGE_IPUTILS_RDISC
	bool "rdisc"
	default y
	help
	  Installs rdisc.

config BR2_PACKAGE_IPUTILS_RDISC_SERVER
	bool "rdisc (server code)"
	default y
	depends on BR2_PACKAGE_IPUTILS_RDISC
	help
	  Builds rdisc with server code.

config BR2_PACKAGE_IPUTILS_TFTPD
	bool "tftpd"
	help
	  Installs tftpd.

config BR2_PACKAGE_IPUTILS_TRACEPATH
	bool "tracepath"
	default y
	help
	  Installs tracepath.

config BR2_PACKAGE_IPUTILS_TRACEROUTE6
	bool "traceroute6"
	default y
	help
	  Installs traceroute6.

config BR2_PACKAGE_IPUTILS_NINFOD
	bool "ninfod"
	default y
	depends on BR2_TOOLCHAIN_HAS_THREADS # ninfod requires <pthread.h>
	help
	  Installs ninfod.

comment "ninfod needs a toolchain w/ threads"
	depends on !BR2_TOOLCHAIN_HAS_THREADS

endif
```

## buildroot/package/iwd/Config.in
```kconfig
config BR2_PACKAGE_IWD
	bool "iwd"
	depends on BR2_USE_MMU # dbus
	depends on BR2_TOOLCHAIN_HAS_THREADS # dbus
	depends on BR2_TOOLCHAIN_HAS_SYNC_4 # ell
	depends on BR2_TOOLCHAIN_HEADERS_AT_LEAST_4_12 # ell
	depends on BR2_USE_WCHAR # ell
	select BR2_PACKAGE_DBUS # runtime
	select BR2_PACKAGE_ELL
	select BR2_PACKAGE_OPENRESOLV if !BR2_PACKAGE_SYSTEMD_RESOLVED
	help
	  iNet Wireless daemon (iwd)

	  https://iwd.wiki.kernel.org/

comment "iwd needs a toolchain w/ threads, wchar, headers >= 4.12"
	depends on BR2_USE_MMU # dbus
	depends on BR2_TOOLCHAIN_HAS_SYNC_4 # ell
	depends on !BR2_TOOLCHAIN_HAS_THREADS || !BR2_USE_WCHAR || \
		!BR2_TOOLCHAIN_HEADERS_AT_LEAST_4_12
```

## buildroot/package/jszip/Config.in
```kconfig
config BR2_PACKAGE_JSZIP
	bool "jszip"
	help
	  JSZip is a javascript library for creating, reading and
	  editing .zip files, with a lovely and simple API.

	  https://stuk.github.io/jszip
```

## buildroot/package/kbd/Config.in
```kconfig
config BR2_PACKAGE_KBD
	bool "kbd"
	# Uses fork()
	depends on BR2_USE_MMU
	depends on BR2_TOOLCHAIN_GCC_AT_LEAST_4_9 # _Generic
	help
	  Keytable files and keyboard utilities.

	  http://kernel.org/pub/linux/utils/kbd/

comment "kbd needs a toolchain w/ gcc >= 4.9"
	depends on BR2_USE_MMU
	depends on !BR2_TOOLCHAIN_GCC_AT_LEAST_4_9
```

## buildroot/package/keyutils/Config.in
```kconfig
config BR2_PACKAGE_KEYUTILS
	bool "keyutils"
	depends on BR2_USE_MMU # fork()
	depends on !BR2_STATIC_LIBS # dlopen
	help
	  These tools are used to control the key management system
	  built into the Linux kernel.

	  https://git.kernel.org/pub/scm/linux/kernel/git/dhowells/keyutils.git/

comment "keyutils needs a toolchain w/ dynamic library"
	depends on BR2_USE_MMU
	depends on BR2_STATIC_LIBS
```

## buildroot/package/kismet/Config.in
```kconfig
comment "kismet needs a toolchain w/ threads, C++"
	depends on BR2_USE_MMU
	depends on !BR2_INSTALL_LIBSTDCPP || !BR2_TOOLCHAIN_HAS_THREADS
	depends on BR2_HOSTARCH = "x86_64" || BR2_HOSTARCH = "x86"

config BR2_PACKAGE_KISMET
	bool "kismet"
	depends on BR2_INSTALL_LIBSTDCPP
	depends on BR2_TOOLCHAIN_HAS_THREADS
	depends on BR2_USE_MMU # fork()
	depends on BR2_HOSTARCH = "x86_64" || BR2_HOSTARCH = "x86" # protobuf-c
	select BR2_PACKAGE_LIBPCAP
	select BR2_PACKAGE_PROTOBUF_C
	select BR2_PACKAGE_SQLITE
	select BR2_PACKAGE_ZLIB
	help
	  Kismet is a wireless network and device detector, sniffer,
	  wardriving tool, and WIDS (wireless intrusion detection)
	  framework.

	  Kismet works with Wi-Fi interfaces, Bluetooth interfaces, some
	  SDR (software defined radio) hardware like the RTLSDR, and
	  other specialized capture hardware.

	  http://www.kismetwireless.net

if BR2_PACKAGE_KISMET

config BR2_PACKAGE_KISMET_PYTHON_TOOLS
	bool "Install python tools"
	depends on BR2_PACKAGE_PROTOBUF_ARCH_SUPPORTS # protobuf
	depends on BR2_PACKAGE_PYTHON_NUMPY_ARCH_SUPPORTS # python-numpy
	depends on BR2_PACKAGE_PYTHON3
	depends on !BR2_STATIC_LIBS # protobuf
	depends on BR2_TOOLCHAIN_GCC_AT_LEAST_4_8 # protobuf
	depends on BR2_TOOLCHAIN_USES_GLIBC || BR2_TOOLCHAIN_USES_MUSL # python-numpy
	select BR2_PACKAGE_PROTOBUF
	select BR2_PACKAGE_PYTHON_NUMPY # runtime for RTLAMR and RTLADSB
	select BR2_PACKAGE_PYTHON_PROTOBUF # runtime
	select BR2_PACKAGE_PYTHON_SERIAL # runtime for Freaklabs Zigbee
	select BR2_PACKAGE_PYTHON_SETUPTOOLS
	help
	  Enable Python and Python-related tools (RTL_433, RTLAMR,
	  RTLADSB and Freaklabs Zigbee)

comment "python tools needs python3"
	depends on !BR2_PACKAGE_PYTHON3
	depends on BR2_PACKAGE_PROTOBUF_ARCH_SUPPORTS
	depends on BR2_PACKAGE_PYTHON_NUMPY_ARCH_SUPPORTS

comment "python tools needs a glibc or musl toolchain w/ dynamic library, gcc >= 4.8"
	depends on BR2_STATIC_LIBS || !BR2_TOOLCHAIN_GCC_AT_LEAST_4_8
	depends on BR2_PACKAGE_PROTOBUF_ARCH_SUPPORTS
	depends on BR2_PACKAGE_PYTHON_NUMPY_ARCH_SUPPORTS
	depends on !(BR2_TOOLCHAIN_USES_GLIBC || BR2_TOOLCHAIN_USES_MUSL)

config BR2_PACKAGE_KISMET_SERVER
	bool "Install server"
	default y
	depends on BR2_PACKAGE_PROTOBUF_ARCH_SUPPORTS # protobuf
	depends on !BR2_STATIC_LIBS # dlfcn.h
	depends on BR2_USE_WCHAR
	depends on BR2_TOOLCHAIN_GCC_AT_LEAST_4_8 # protobuf
	depends on !BR2_TOOLCHAIN_HAS_GCC_BUG_64735 # std::future
	select BR2_PACKAGE_PROTOBUF

comment "server needs a toolchain w/ dynamic library, wchar, gcc >= 4.8"
	depends on BR2_PACKAGE_PROTOBUF_ARCH_SUPPORTS
	depends on !BR2_TOOLCHAIN_HAS_GCC_BUG_64735
	depends on BR2_STATIC_LIBS || !BR2_USE_WCHAR || \
		!BR2_TOOLCHAIN_GCC_AT_LEAST_4_8

comment "server needs a toolchain not affected by GCC bug 64735"
	depends on BR2_TOOLCHAIN_HAS_GCC_BUG_64735

endif
```
