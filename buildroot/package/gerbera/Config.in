## buildroot/package/kmod/Config.in.host
```kconfig
config BR2_PACKAGE_HOST_KMOD
	bool "host kmod"
	help
	  kmod is a set of tools to handle common tasks with Linux
	  kernel modules like insert, remove, list, check properties,
	  resolve dependencies and aliases.

if BR2_PACKAGE_HOST_KMOD

config BR2_PACKAGE_HOST_KMOD_GZ
	bool "support gzip-compressed modules"

config BR2_PACKAGE_HOST_KMOD_XZ
	bool "support xz-compressed modules"

endif
```

## buildroot/package/kmsxx/Config.in
```kconfig
config BR2_PACKAGE_KMSXX
	bool "kms++"
	depends on BR2_TOOLCHAIN_GCC_AT_LEAST_4_8
	depends on BR2_TOOLCHAIN_HEADERS_AT_LEAST_4_11 # linux/dma-buf.h
	depends on BR2_INSTALL_LIBSTDCPP
	depends on BR2_TOOLCHAIN_HAS_THREADS # libdrm
	depends on BR2_USE_WCHAR # fmt
	select BR2_PACKAGE_FMT
	select BR2_PACKAGE_LIBDRM
	help
	  libkms++ is a C++11 library for kernel mode setting.

	  Also included are simple test tools for KMS.

	  https://github.com/tomba/kmsxx

if BR2_PACKAGE_KMSXX

config BR2_PACKAGE_KMSXX_INSTALL_TESTS
	bool "Install test programs"
	help
	  This option allows to install the kmsxx test programs.

endif

comment "kms++ needs a toolchain w/ threads, C++, gcc >= 4.8, headers >= 4.11, wchar"
	depends on !BR2_TOOLCHAIN_HAS_THREADS || !BR2_INSTALL_LIBSTDCPP || \
		!BR2_TOOLCHAIN_GCC_AT_LEAST_4_8 || !BR2_TOOLCHAIN_HEADERS_AT_LEAST_4_11 \
		|| !BR2_USE_WCHAR
```

## buildroot/package/kodi-pvr-octonet/Config.in
```kconfig
config BR2_PACKAGE_KODI_PVR_OCTONET
	bool "kodi-pvr-octonet"
	depends on BR2_TOOLCHAIN_GCC_AT_LEAST_4_7 # jsoncpp
	select BR2_PACKAGE_JSONCPP
	select BR2_PACKAGE_KODI_PLATFORM
	select BR2_PACKAGE_LIBPLATFORM
	help
	  DigitalDevices Octonet PVR client addon for Kodi

	  https://github.com/DigitalDevices/pvr.octonet

comment "kodi-pvr-octonet needs a toolchain w/ gcc >= 4.7"
	depends on !BR2_TOOLCHAIN_GCC_AT_LEAST_4_7
```
