## buildroot/package/python-bluezero/Config.in
```kconfig
config BR2_PACKAGE_PYTHON_BLUEZERO
	bool "python-bluezero"
	depends on BR2_PACKAGE_GOBJECT_INTROSPECTION_ARCH_SUPPORTS # python-gobject -> gobject-introspection
	depends on BR2_TOOLCHAIN_GCC_AT_LEAST_4_9 # python-gobject -> gobject-introspection
	depends on BR2_TOOLCHAIN_USES_GLIBC # python-gobject -> gobject-introspection
	depends on BR2_PACKAGE_PYTHON3
	select BR2_PACKAGE_DBUS # runtime
	select BR2_PACKAGE_DBUS_PYTHON # runtime
	select BR2_PACKAGE_PYTHON_GOBJECT # runtime
	help
	  Python library for Bluetooth Low Energy (BLE) on Linux.

	  https://github.com/ukBaz/python-bluezero

comment "python-bluezero needs a glibc toolchain, gcc >= 4.9"
	depends on BR2_PACKAGE_PYTHON3
	depends on BR2_PACKAGE_GOBJECT_INTROSPECTION_ARCH_SUPPORTS
	depends on !BR2_TOOLCHAIN_USES_GLIBC || \
		!BR2_TOOLCHAIN_GCC_AT_LEAST_4_9
```

## buildroot/package/python-boto3/Config.in
```kconfig
config BR2_PACKAGE_PYTHON_BOTO3
	bool "python-boto3"
	select BR2_PACKAGE_PYTHON_BOTOCORE # runtime
	select BR2_PACKAGE_PYTHON_JMESPATH # runtime
	select BR2_PACKAGE_PYTHON_S3TRANSFER # runtime
	help
	  The AWS SDK for Python.

	  https://github.com/boto/boto3
```

## buildroot/package/python-botocore/Config.in
```kconfig
config BR2_PACKAGE_PYTHON_BOTOCORE
	bool "python-botocore"
	select BR2_PACKAGE_PYTHON_JMESPATH # runtime
	select BR2_PACKAGE_PYTHON_DOCUTILS # runtime
	select BR2_PACKAGE_PYTHON_DATEUTIL # runtime
	select BR2_PACKAGE_PYTHON_URLLIB3 # runtime
	help
	  Low-level, data-driven core of boto 3.

	  https://github.com/boto/botocore
```

## buildroot/package/python-bsdiff4/Config.in
```kconfig
config BR2_PACKAGE_PYTHON_BSDIFF4
	bool "python-bsdiff4"
	select BR2_PACKAGE_PYTHON_BZIP2 if BR2_PACKAGE_PYTHON # runtime
	select BR2_PACKAGE_PYTHON3_BZIP2 if BR2_PACKAGE_PYTHON3 # runtime
	help
	  binary diff and patch using the BSDIFF4-format.

	  https://github.com/ilanschnell/bsdiff4
```

## buildroot/package/python-colorzero/Config.in
```kconfig
config BR2_PACKAGE_PYTHON_COLORZERO
	bool "python-colorzero"
	help
	  A color manipulation library for Python.

	  https://github.com/waveform80/colorzero
```

## buildroot/package/python-crayons/Config.in
```kconfig
config BR2_PACKAGE_PYTHON_CRAYONS
	bool "python-crayons"
	depends on BR2_PACKAGE_PYTHON3
	help
	  This module is really simple, it gives you
	  colored strings for terminal usage.

	  https://pypi.org/project/crayons
```

## buildroot/package/python-cycler/Config.in
```kconfig
config BR2_PACKAGE_PYTHON_CYCLER
	bool "python-cycler"
	help
	  Creates a Cycler objects much like cycler, but
	  includes input validation.

	  https://matplotlib.org/cycler/
```

## buildroot/package/python-dataproperty/Config.in
```kconfig
config BR2_PACKAGE_PYTHON_DATAPROPERTY
	bool "python-dataproperty"
	depends on BR2_PACKAGE_PYTHON3
	select BR2_PACKAGE_PYTHON_MBSTRDECODER # runtime
	select BR2_PACKAGE_PYTHON_TYPEPY # runtime
	help
	  Python library for extract property from data.

	  https://github.com/thombashi/DataProperty
```

## buildroot/package/python-defusedxml/Config.in
```kconfig
config BR2_PACKAGE_PYTHON_DEFUSEDXML
	bool "python-defusedxml"
	help
	  XML bomb protection for Python stdlib modules

	  https://pypi.org/project/defusedxml/
```

## buildroot/package/python-esptool/Config.in
```kconfig
config BR2_PACKAGE_PYTHON_ESPTOOL
	bool "python-esptool"
	select BR2_PACKAGE_PYTHON_ECDSA # runtime
	select BR2_PACKAGE_PYTHON_PYAES # runtime
	select BR2_PACKAGE_PYTHON_SERIAL # runtime
	select BR2_PACKAGE_PYTHON_ZLIB if BR2_PACKAGE_PYTHON
	select BR2_PACKAGE_PYTHON3_ZLIB if BR2_PACKAGE_PYTHON3
	help
	  A serial utility to communicate & flash code to Espressif
	  ESP8266 & ESP32 chips.

	  https://github.com/espressif/esptool
```

## buildroot/package/python-gpiozero/Config.in
```kconfig
config BR2_PACKAGE_PYTHON_GPIOZERO
	bool "python-gpiozero"
	depends on BR2_arm
	select BR2_PACKAGE_PYTHON_COLORZERO # runtime
	select BR2_PACKAGE_PYTHON_RPI_GPIO # runtime
	help
	  A simple interface to GPIO devices with Raspberry Pi.

	  https://github.com/gpiozero/gpiozero
```

## buildroot/package/python-iniconfig/Config.in
```kconfig
config BR2_PACKAGE_PYTHON_INICONFIG
	bool "python-iniconfig"
	help
	  iniconfig: brain-dead simple config-ini parsing.

	  http://github.com/RonnyPfannschmidt/iniconfig
```

## buildroot/package/python-intelhex/Config.in
```kconfig
config BR2_PACKAGE_PYTHON_INTELHEX
	bool "python-intelhex"
	help
	  Python library for Intel HEX files manipulations.

	  https://github.com/python-intelhex/intelhex
```

## buildroot/package/python-ipdb/Config.in
```kconfig
config BR2_PACKAGE_PYTHON_IPDB
	bool "python-ipdb"
	depends on BR2_PACKAGE_PYTHON3 # python-ipython
	select BR2_PACKAGE_PYTHON_SETUPTOOLS # runtime
	select BR2_PACKAGE_PYTHON_IPYTHON # runtime
	help
	  IPython-enabled pdb.

	  https://github.com/gotcha/ipdb
```

## buildroot/package/python-iso8601/Config.in
```kconfig
config BR2_PACKAGE_PYTHON_ISO8601
	bool "python-iso8601"
	help
	  Simple module to parse ISO 8601 dates.

	  https://github.com/micktwomey/pyiso8601
```

## buildroot/package/python-jmespath/Config.in
```kconfig
config BR2_PACKAGE_PYTHON_JMESPATH
	bool "python-jmespath"
	help
	  JMESPath is a query language for JSON.

	  https://github.com/jmespath/jmespath.py
```

## buildroot/package/python-libusb1/Config.in
```kconfig
config BR2_PACKAGE_PYTHON_LIBUSB1
	bool "python-libusb1"
	depends on BR2_TOOLCHAIN_HAS_THREADS # libusb
	depends on BR2_TOOLCHAIN_GCC_AT_LEAST_4_9 # libusb
	select BR2_PACKAGE_LIBUSB
	help
	  Pure-python wrapper for libusb-1.0.

	  http://github.com/vpelletier/python-libusb1

comment "python-libusb1 needs a toolchain w/ threads, gcc >= 4.9"
	depends on !BR2_TOOLCHAIN_HAS_THREADS || \
		!BR2_TOOLCHAIN_GCC_AT_LEAST_4_9
```

## buildroot/package/python-m2crypto/Config.in
```kconfig
config BR2_PACKAGE_PYTHON_M2CRYPTO
	bool "python-m2crypto"
	select BR2_PACKAGE_OPENSSL
	select BR2_PACKAGE_PYTHON_PYEXPAT if BR2_PACKAGE_PYTHON # runtime
	select BR2_PACKAGE_PYTHON3_PYEXPAT if BR2_PACKAGE_PYTHON3 # runtime
	select BR2_PACKAGE_PYTHON_SSL if BR2_PACKAGE_PYTHON # runtime
	select BR2_PACKAGE_PYTHON3_SSL if BR2_PACKAGE_PYTHON3 # runtime
	select BR2_PACKAGE_PYTHON_TYPING if BR2_PACKAGE_PYTHON # runtime
	help
	  M2Crypto: A Python crypto and SSL toolkit.

	  https://gitlab.com/m2crypto/m2crypto
```

## buildroot/package/python-matplotlib/Config.in
```kconfig
config BR2_PACKAGE_PYTHON_MATPLOTLIB
	bool "python-matplotlib"
	depends on BR2_INSTALL_LIBSTDCPP
	depends on BR2_PACKAGE_PYTHON3
	depends on BR2_PACKAGE_PYTHON_NUMPY_ARCH_SUPPORTS
	depends on BR2_TOOLCHAIN_USES_GLIBC || BR2_TOOLCHAIN_USES_MUSL # python-numpy
	select BR2_PACKAGE_FREETYPE # runtime
	select BR2_PACKAGE_LIBPNG # runtime
	select BR2_PACKAGE_PYTHON_CYCLER
	select BR2_PACKAGE_PYTHON_SETUPTOOLS # runtime
	select BR2_PACKAGE_PYTHON_DATEUTIL # runtime
	select BR2_PACKAGE_PYTHON_KIWISOLVER # runtime
	select BR2_PACKAGE_PYTHON_NUMPY # runtime
	select BR2_PACKAGE_PYTHON_PYPARSING # runtime
	select BR2_PACKAGE_PYTHON3_ZLIB # runtime
	select BR2_PACKAGE_ZLIB # runtime
	help
	  Matplotlib strives to produce publication quality 2D
	  graphics for interactive graphing, scientific publishing,
	  user interface development and web application servers
	  targeting multiple user interfaces and hardcopy output
	  formats.

	  https://matplotlib.org/

if BR2_PACKAGE_PYTHON_MATPLOTLIB

config BR2_PACKAGE_PYTHON_MATPLOTLIB_QT
	bool "qt display"
	depends on BR2_PACKAGE_QT5 # python-pyqt5
	select BR2_PACKAGE_PYTHON_PYQT5
	select BR2_PACKAGE_QT5BASE_FONTCONFIG
	select BR2_PACKAGE_QT5BASE_WIDGETS

endif

comment "python-matplotlib needs a toolchain w/ C++"
	depends on !BR2_INSTALL_LIBSTDCPP

comment "python-matplotlib needs glibc or musl"
	depends on !(BR2_TOOLCHAIN_USES_GLIBC || BR2_TOOLCHAIN_USES_MUSL)
```

## buildroot/package/python-mbstrdecoder/Config.in
```kconfig
config BR2_PACKAGE_PYTHON_MBSTRDECODER
	bool "python-mbstrdecoder"
	depends on BR2_PACKAGE_PYTHON3
	select BR2_PACKAGE_PYTHON_CHARDET # runtime
	help
	  multi-byte character string decoder.

	  https://github.com/thombashi/mbstrdecoder
```

## buildroot/package/python-mwclient/Config.in
```kconfig
config BR2_PACKAGE_PYTHON_MWCLIENT
	bool "python-mwclient"
	select BR2_PACKAGE_PYTHON_REQUESTS_OAUTHLIB # runtime
	select BR2_PACKAGE_PYTHON_SIX # runtime
	help
	  Python client library to interface with the MediaWiki API

	  https://github.com/mwclient/mwclient
```

## buildroot/package/python-networkx/Config.in
```kconfig
config BR2_PACKAGE_PYTHON_NETWORKX
	bool "python-networkx"
	depends on BR2_PACKAGE_PYTHON3
	select BR2_PACKAGE_PYTHON_DECORATOR # runtime
	help
	  A Python package for the creation, manipulation,
	  and study of the structure, dynamics, and
	  functions of complex networks.

	  https://pypi.python.org/pypi/networkx
```

## buildroot/package/python-nfc/Config.in
```kconfig
config BR2_PACKAGE_PYTHON_NFC
	bool "python-nfc"
	depends on BR2_PACKAGE_PYTHON
	depends on BR2_TOOLCHAIN_HAS_THREADS # libusb
	depends on BR2_TOOLCHAIN_GCC_AT_LEAST_4_9 # libusb
	select BR2_PACKAGE_LIBUSB
	select BR2_PACKAGE_LIBUSB_COMPAT
	help
	  Python module for near field communication.

	  https://launchpad.net/nfcpy

comment "python-nfc needs a toolchain w/ threads, gcc >= 4.9"
	depends on BR2_PACKAGE_PYTHON
	depends on !BR2_TOOLCHAIN_HAS_THREADS || \
		!BR2_TOOLCHAIN_GCC_AT_LEAST_4_9
```

## buildroot/package/python-opcua-asyncio/Config.in
```kconfig
config BR2_PACKAGE_PYTHON_OPCUA_ASYNCIO
	bool "python-opcua-asyncio"
	depends on BR2_PACKAGE_PYTHON3
	select BR2_PACKAGE_PYTHON_AIOFILES # runtime
	select BR2_PACKAGE_PYTHON_CRYPTOGRAPHY # runtime
	select BR2_PACKAGE_PYTHON_DATEUTIL # runtime
	select BR2_PACKAGE_PYTHON_LXML # runtime
	select BR2_PACKAGE_PYTHON_PYTZ # runtime
	help
	  opcua-asyncio is an asyncio-based asynchronous
	  OPC UA client based on python-opcua, removing
	  hacks for support of python < 3.6.

	  https://github.com/FreeOpcUa/opcua-asyncio
```

## buildroot/package/python-packaging/Config.in
```kconfig
config BR2_PACKAGE_PYTHON_PACKAGING
	bool "python-packaging"
	select BR2_PACKAGE_PYTHON_PYPARSING # runtime
	select BR2_PACKAGE_PYTHON_SIX # runtime
	help
	  Core utilities for Python packages.

	  https://github.com/pypa/packaging
```
