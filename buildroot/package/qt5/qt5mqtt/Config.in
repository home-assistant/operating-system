## buildroot/package/sentry-native/Config.in
```kconfig
config BR2_PACKAGE_SENTRY_NATIVE
	bool "sentry-native"
	depends on BR2_INSTALL_LIBSTDCPP # google-breakpad
	depends on BR2_TOOLCHAIN_GCC_AT_LEAST_4_8 # google-breakpad
	depends on BR2_USE_WCHAR # google-breakpad
	depends on BR2_TOOLCHAIN_HAS_THREADS # google-breakpad
	# google-breakpad is restricted to glibc or uClibc, but
	# sentry-native needs <execinfo.h>, so it restricts further to
	# just glibc.
	depends on BR2_TOOLCHAIN_USES_GLIBC
	depends on BR2_PACKAGE_GOOGLE_BREAKPAD_ARCH_SUPPORTS # google-breakpad
	depends on BR2_PACKAGE_HOST_GOOGLE_BREAKPAD_ARCH_SUPPORTS # google-breakpad
	select BR2_PACKAGE_GOOGLE_BREAKPAD
	select BR2_PACKAGE_LIBCURL
	help
	  The Sentry Native SDK is an error and crash
	  reporting client for native applications,
	  optimized for C and C++.

	  https://github.com/getsentry/sentry-native

comment "sentry-native needs a glibc toolchain with w/ wchar, thread, C++, gcc >= 4.8"
	depends on BR2_PACKAGE_GOOGLE_BREAKPAD_ARCH_SUPPORTS
	depends on BR2_PACKAGE_HOST_GOOGLE_BREAKPAD_ARCH_SUPPORTS
	depends on !BR2_INSTALL_LIBSTDCPP || !BR2_USE_WCHAR || \
		!BR2_TOOLCHAIN_HAS_THREADS || \
		!BR2_TOOLCHAIN_USES_GLIBC || \
		!BR2_TOOLCHAIN_GCC_AT_LEAST_4_8
```

## buildroot/package/slirp/Config.in
```kconfig
config BR2_PACKAGE_SLIRP
	bool "slirp"
	depends on BR2_USE_MMU # libglib2
	depends on BR2_USE_WCHAR # libglib2
	depends on BR2_TOOLCHAIN_HAS_THREADS # libglib2
	select BR2_PACKAGE_LIBGLIB2
	help
	  libslirp is a user-mode networking library used by virtual
	  machines, containers or various tools.

	  https://gitlab.freedesktop.org/slirp/libslirp/

	  NOTE:
	  This package has some history of a unique kind:
	    - originally developped as 'slirp' by Danny Gasparovski, and
	      seemingly abandonned (developper /disapeared/)
	    - then re-maintained at sourceforge by "Kelly", up to some
	      time around 2009: http://slirp.sourceforge.net/
	    - during that period, QEMU (Fabrice BELLARD) forked the code
	      and included it in QEMU
	    - and it was imported from this breed by the Spice project
	      around May 2009 which archived it in 2012
	    - So we switched to
	      https://gitlab.freedesktop.org/slirp/libslirp

comment "slirp needs a toolchain w/ wchar, threads"
	depends on BR2_USE_MMU
	depends on !BR2_USE_WCHAR || !BR2_TOOLCHAIN_HAS_THREADS
```

## buildroot/package/spandsp/Config.in
```kconfig
config BR2_PACKAGE_SPANDSP
	bool "spandsp"
	select BR2_PACKAGE_TIFF
	select BR2_PACKAGE_TIFF_JPEG
	help
	  Spandsp is a library of many DSP functions for telephony.
	  These range from simple modules, such as DTMF detection, to
	  a complete software FAX machine.

	  https://github.com/freeswitch/spandsp
```

## buildroot/package/ssdp-responder/Config.in
```kconfig
config BR2_PACKAGE_SSDP_RESPONDER
	bool "ssdp-responder"
	depends on BR2_USE_MMU
	help
	  Simple Service Discovery Protocol daemon (SSDP) for networked
	  Linux and UNIX devices. Useful in any setup, big or small, but
	  targeted more at embedded systems that need to announce
	  themselves to Windows systems.

	  ssdpd is a stand-alone UNIX, no external dependencies but the
	  standard C library.  It has a built-in web server for serving
	  the UPnP XML description which Windows use to present the
	  icon, by default an InternetGatewayDevice is announced.

	  Also included is ssdp-scan, a tool similar to mdns-scan, which
	  continuously scans for SSDP capable hosts on the network.
	  Take care only to use for debugging since it scans the network
	  quite aggressively.

	  https://github.com/troglobit/ssdp-responder/
```

## buildroot/package/sslh/Config.in
```kconfig
config BR2_PACKAGE_SSLH
	bool "sslh"
	depends on BR2_USE_MMU # fork()
	select BR2_PACKAGE_LIBCONFIG if BR2_PACKAGE_SYSTEMD
	help
	  Applicative protocol multiplexer

	  http://www.rutschle.net/tech/sslh.shtml
```

## buildroot/package/stress-ng/Config.in
```kconfig
config BR2_PACKAGE_STRESS_NG
	bool "stress-ng"
	depends on BR2_USE_MMU # fork()
	# perf.c needs PERF_COUNT_HW_REF_CPU_CYCLES
	depends on BR2_TOOLCHAIN_HEADERS_AT_LEAST_3_3
	# fenv.h lacks FE_INVALID, FE_OVERFLOW & FE_UNDERFLOW on nios2 and ARC
	depends on !BR2_nios2
	depends on !BR2_arc
	help
	  stress-ng will stress test a computer system in various
	  selectable ways. It was designed to exercise various physical
	  subsystems of a computer as well as the various operating
	  system kernel interfaces.

	  http://kernel.ubuntu.com/~cking/stress-ng/

comment "stress-ng needs a toolchain w/ headers >= 3.3"
	depends on !BR2_nios2 && !BR2_arc
	depends on BR2_USE_MMU
	depends on !BR2_TOOLCHAIN_HEADERS_AT_LEAST_3_3
```

## buildroot/package/sunxi-mali-mainline-driver/Config.in
```kconfig
comment "sunxi-mali-mainline-driver needs a Linux kernel to be built"
	depends on BR2_PACKAGE_SUNXI_MALI_MAINLINE
	depends on !BR2_LINUX_KERNEL

config BR2_PACKAGE_SUNXI_MALI_MAINLINE_DRIVER
	bool "sunxi-mali-mainline-driver"
	default y
	depends on BR2_PACKAGE_SUNXI_MALI_MAINLINE # runtime
	depends on BR2_LINUX_KERNEL
	select BR2_LINUX_NEEDS_MODULES # not using kernel-module infra
	help
	  This package builds and installs the Linux kernel driver for
	  the Mali GPU on Allwinner platforms, compatible with recent
	  Linux kernels (>= 4.4). Note that it should be installed
	  together with the corresponding userspace OpenGL libraries,
	  which are provided as binaries only at:
	  https://github.com/bootlin/mali-blobs

	  sunxi-mali-mainline-driver requires a Linux kernel >= 4.4
	  with the following options enabled:

	  - CONFIG_CMA
	  - CONFIG_DMA_CMA

	  starting from Linux Kernel >= 4.20 following options must be
	  enabled:
	  - CONFIG_DRM_FBDEV_LEAK_PHYS_SMEM

	  https://github.com/mripard/sunxi-mali/blob/master/README.md
```
