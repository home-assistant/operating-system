## buildroot/package/qt5/qt5mqtt/Config.in
```kconfig
config BR2_PACKAGE_QT5MQTT
	bool "qt5mqtt"
	help
	  Qt is a cross-platform application and UI framework for
	  developers using C++.

	  The Qt MQTT module provides a standard compliant
	  implementation of the MQTT protocol specification. It
	  enables applications to act as telemetry displays and
	  devices to publish telemetry data.  The supported versions
	  are MQTT 3.1, MQTT 3.1.1, and MQTT 5.0.

	  https://doc.qt.io/QtMQTT/index.html
```

## buildroot/package/qt5/qt5quicktimeline/Config.in
```kconfig
config BR2_PACKAGE_QT5QUICKTIMELINE
	bool "qt5quicktimeline"
	depends on BR2_PACKAGE_QT5_JSCORE_AVAILABLE # qt5declarative
	select BR2_PACKAGE_QT5DECLARATIVE
	select BR2_PACKAGE_QT5DECLARATIVE_QUICK
	help
	  Qt is a cross-platform application and UI framework for
	  developers using C++.

	  This package corresponds to the qt5quicktimeline module.

	  https://doc.qt.io/qt-5/qtquicktimeline-index.html
```

## buildroot/package/qt5/qt5remoteobjects/Config.in
```kconfig
config BR2_PACKAGE_QT5REMOTEOBJECTS
	bool "qt5remoteobjects"
	select BR2_PACKAGE_QT5BASE
	select BR2_PACKAGE_QT5BASE_NETWORK
	help
	  Qt is a cross-platform application and UI framework for
	  developers using C++.

	  Qt Remote Objects (QtRO) is an Inter-Process
	  Communication (IPC) module developed for Qt. This
	  module extends Qt's existing functionalities to enable
	  information exchange between processes or computers,
	  easily.

	  https://doc.qt.io/qt-5/qtremoteobjects-index.html
```

## buildroot/package/qt5/qt5sensors/Config.in
```kconfig
config BR2_PACKAGE_QT5SENSORS
	bool "qt5sensors"
	help
	  Qt is a cross-platform application and UI framework for
	  developers using C++.

	  The Qt Sensors API provides access to sensor hardware
	  via QML and C++ interfaces.

	  http://doc.qt.io/qt-5/qtsensors-index.html
```

## buildroot/package/quickjs/Config.in
```kconfig
config BR2_PACKAGE_QUICKJS
	bool "quickjs"
	depends on !BR2_nios2 # fenv.h lacks FE_{DOWN,UP}WARD on nios2
	depends on !BR2_STATIC_LIBS
	# No way to check for fenv support.
	depends on !BR2_TOOLCHAIN_USES_UCLIBC
	depends on BR2_TOOLCHAIN_GCC_AT_LEAST_4_9 # C11/stdatomic.h
	depends on BR2_HOST_GCC_AT_LEAST_4_9 # C11/stdatomic.h
	depends on BR2_USE_MMU # fork()
	help
	  QuickJS is a small and embeddable Javascript engine.
	  It supports the ES2020 specification including modules,
	  asynchronous generators, proxies and BigInt.

	  https://bellard.org/quickjs/

comment "quickjs needs a glibc or musl toolchain w/ gcc >= 4.9, host gcc >= 4.9, dynamic library"
	depends on !BR2_nios2
	depends on BR2_USE_MMU
	depends on BR2_STATIC_LIBS || BR2_TOOLCHAIN_USES_UCLIBC || \
		!BR2_TOOLCHAIN_GCC_AT_LEAST_4_9 || !BR2_HOST_GCC_AT_LEAST_4_9
```

## buildroot/package/raspberrypi-usbboot/Config.in.host
```kconfig
config BR2_PACKAGE_HOST_RASPBERRYPI_USBBOOT
	bool "host raspberrypi-usbboot"
	depends on BR2_arm
	depends on BR2_HOST_GCC_AT_LEAST_4_9 # host-libusb
	help
	  This package builds and install the "rpiboot" tool for the
	  host machine. This tool allows to boot the Broadcom BCM
	  processor used in the RaspberryPi to boot over USB, and have
	  it expose a USB mass storage device in order to reflash the
	  built-in storage of the RaspberryPi (useful for the eMMC
	  built into the Compute module).

	  https://github.com/raspberrypi/usbboot

comment "host raspberrypi-usbboot needs a toolchain w/ host gcc >= 4.9"
	depends on BR2_arm
	depends on !BR2_HOST_GCC_AT_LEAST_4_9
```

## buildroot/package/rcw-smarc-sal28/Config.in
```kconfig
config BR2_PACKAGE_RCW_SMARC_SAL28
	bool "rcw-smarc-sal28"
	help
	  The reset configuration word for the SMARC-sAL28 board. All
	  available RCWs are copied into the images output directory.
	  Additionally, you have to choose one default RCW which is
	  used for booting the board.

if BR2_PACKAGE_RCW_SMARC_SAL28
config BR2_PACKAGE_RCW_SMARC_SAL28_BUILD_UPDATE_SCRIPT
	bool "Build RCW u-boot update script"
	select BR2_PACKAGE_HOST_UBOOT_TOOLS
	help
	  Build the RCW updater script which can be used in the
	  bootloader to change the installed RCW during runtime. The
	  update script is called update-rcw.img and will be copied
	  to the output directory.

config BR2_PACKAGE_RCW_SMARC_SAL28_BOOT_VARIANT
	string "RCW variant for booting"
	default "3-11_q"
	help
	  The suffix of the RCW filename without the ".bin" part.
	  E.g.  setting this to "3-11_q" will use "sl28-3-11_q.bin".
endif
```

## buildroot/package/re2/Config.in
```kconfig
config BR2_PACKAGE_RE2
	bool "re2"
	depends on BR2_INSTALL_LIBSTDCPP
	depends on BR2_TOOLCHAIN_GCC_AT_LEAST_4_8 # needs C++11
	depends on BR2_TOOLCHAIN_HAS_THREADS
	help
	  RE2 is a fast, safe, thread-friendly alternative
	  to backtracking regular expression engines like
	  those used in PCRE, Perl, and Python.
	  It is a C++ library.

	  https://github.com/google/re2

comment "re2 needs a toolchain w/ C++, threads, gcc >= 4.8"
	depends on !BR2_INSTALL_LIBSTDCPP || \
		!BR2_TOOLCHAIN_HAS_THREADS || \
		!BR2_TOOLCHAIN_GCC_AT_LEAST_4_8
```

## buildroot/package/readline/Config.in
```kconfig
config BR2_PACKAGE_READLINE
	bool "readline"
	select BR2_PACKAGE_NCURSES
	help
	  The GNU Readline library provides a set of functions for use
	  by applications that allow users to edit command lines
	  as they are typed in.

	  https://tiswww.case.edu/php/chet/readline/rltop.html

config BR2_PACKAGE_READLINE_BRACKETED_PASTE
	bool "Enable bracketed paste"
	depends on BR2_PACKAGE_READLINE
	help
	  Enable the "bracketed paste" feature in libreadline.

	  Bracketed paste is helpful for interactive sessions when
	  one wants to prevent pasted text from being interpreted
	  as typed-in commands. However, it also causes control
	  characters to show up in the raw output of a (telnet)
	  session. This can cause issues and throw off pattern
	  matching if the session output is being captured for
	  automated processing.

	  For further information on this feature and whether you
	  may want it, see:
	      https://cirw.in/blog/bracketed-paste
```

## buildroot/package/redir/Config.in
```kconfig
config BR2_PACKAGE_REDIR
	bool "redir"
	depends on BR2_USE_MMU # fork()
	help
	  This is a TCP port redirector for UNIX.

	  https://github.com/troglobit/redir
```

## buildroot/package/redis/Config.in
```kconfig
config BR2_PACKAGE_REDIS
	bool "redis"
	depends on BR2_USE_MMU # fork()
	depends on !BR2_STATIC_LIBS # dlfcn.h
	depends on BR2_TOOLCHAIN_GCC_AT_LEAST_4_9 # _Atomic keyword
	depends on BR2_TOOLCHAIN_HAS_ATOMIC
	depends on BR2_TOOLCHAIN_HAS_THREADS_NPTL # pthread_setname_np()
	help
	  Redis is an open source (BSD licensed), in-memory data
	  structure store, used as a database, cache and message
	  broker. It supports data structures such as strings,
	  hashes, lists, sets, sorted sets with range queries,
	  bitmaps, hyperloglogs, geospatial indexes with radius
	  queries and streams.

	  http://www.redis.io

comment "redis needs a toolchain w/ gcc>=4.9, dynamic library, nptl"
	depends on BR2_USE_MMU
	depends on BR2_TOOLCHAIN_HAS_ATOMIC
	depends on BR2_STATIC_LIBS || !BR2_TOOLCHAIN_HAS_THREADS_NPTL \
		|| !BR2_TOOLCHAIN_GCC_AT_LEAST_4_9
```

## buildroot/package/refpolicy/Config.in
```kconfig
config BR2_PACKAGE_REFPOLICY
	bool "refpolicy"
	depends on BR2_TOOLCHAIN_HAS_THREADS # libsepol
	# Even though libsepol is not necessary for building, we get
	# the policy version from libsepol, so we select it, and treat
	# it like a runtime dependency.
	select BR2_PACKAGE_LIBSEPOL
	help
	  The SELinux Reference Policy project (refpolicy) is a
	  complete SELinux policy that can be used as the system
	  policy for a variety of systems and used as the basis for
	  creating other policies. Reference Policy was originally
	  based on the NSA example policy, but aims to accomplish many
	  additional goals.

	  The current refpolicy does not fully support Buildroot and
	  needs modifications to work with the default system file
	  layout. These changes should be added as patches to the
	  refpolicy that modify a single SELinux policy.

	  The refpolicy works for the most part in permissive
	  mode. Only the basic set of utilities are enabled in the
	  example policy config and some of the pathing in the
	  policies is not correct.  Individual policies would need to
	  be tweaked to get everything functioning properly.

	  https://github.com/TresysTechnology/refpolicy

if BR2_PACKAGE_REFPOLICY

choice
	prompt "Refpolicy version"
	default BR2_PACKAGE_REFPOLICY_UPSTREAM_VERSION

config BR2_PACKAGE_REFPOLICY_UPSTREAM_VERSION
	bool "Upstream version"
	help
	  Use the refpolicy as provided by Buildroot.

config BR2_PACKAGE_REFPOLICY_CUSTOM_GIT
	bool "Custom git repository"
	help
	  Allows to get the refpolicy from a custom git repository.

	  The custom refpolicy must define the full policy explicitly,
	  and must be a fork of the original refpolicy, to have the
	  same build system.  When this is selected, only the custom
	  policy definition are taken into account and all the modules
	  of the policy are built into the binary policy.

endchoice

if BR2_PACKAGE_REFPOLICY_CUSTOM_GIT

config BR2_PACKAGE_REFPOLICY_CUSTOM_REPO_URL
	string "URL of custom repository"

config BR2_PACKAGE_REFPOLICY_CUSTOM_REPO_VERSION
	string "Custom repository version"
	help
	  Revision to use in the typical format used by Git.
	  E.g. a sha id, tag, branch...

endif

choice
	prompt "SELinux default state"
	default BR2_PACKAGE_REFPOLICY_POLICY_STATE_PERMISSIVE

config BR2_PACKAGE_REFPOLICY_POLICY_STATE_ENFORCING
	bool "Enforcing"
	help
	  SELinux security policy is enforced

config BR2_PACKAGE_REFPOLICY_POLICY_STATE_PERMISSIVE
	bool "Permissive"
	help
	  SELinux prints warnings instead of enforcing

config BR2_PACKAGE_REFPOLICY_POLICY_STATE_DISABLED
	bool "Disabled"
	help
	  No SELinux policy is loaded
endchoice

config BR2_PACKAGE_REFPOLICY_POLICY_STATE
	string
	default "permissive" if BR2_PACKAGE_REFPOLICY_POLICY_STATE_PERMISSIVE
	default "enforcing" if BR2_PACKAGE_REFPOLICY_POLICY_STATE_ENFORCING
	default "disabled" if BR2_PACKAGE_REFPOLICY_POLICY_STATE_DISABLED

if BR2_PACKAGE_REFPOLICY_UPSTREAM_VERSION

config BR2_REFPOLICY_EXTRA_MODULES_DIRS
	string "Extra modules directories"
	help
	  Specify a space-separated list of directories containing
	  SELinux modules that will be built into the SELinux
	  policy. The modules will be automatically enabled in the
	  policy.

	  Each of those directories must contain the SELinux policy
	  .fc, .if and .te files directly at the top-level, with no
	  sub-directories. Also, you cannot have several modules with
	  the same name in different directories.

config BR2_REFPOLICY_EXTRA_MODULES
	string "Extra modules to enable"
	help
	  List of extra SELinux modules to enable in the refpolicy.

endif

endif

comment "refpolicy needs a toolchain w/ threads"
	depends on !BR2_TOOLCHAIN_HAS_THREADS
```

## buildroot/package/resiprocate/Config.in
```kconfig
comment "resiprocate needs a toolchain w/ C++, threads, wchar"
	depends on BR2_USE_MMU
	depends on !BR2_INSTALL_LIBSTDCPP || !BR2_TOOLCHAIN_HAS_THREADS || !BR2_USE_WCHAR

config BR2_PACKAGE_RESIPROCATE
	bool "resiprocate"
	depends on BR2_INSTALL_LIBSTDCPP
	depends on BR2_TOOLCHAIN_HAS_THREADS
	depends on BR2_USE_WCHAR
	depends on BR2_USE_MMU # fork()
	select BR2_PACKAGE_C_ARES
	help
	  reSIProcate is a framework that aims to fully implement the
	  SIP protocol in first class C++. It is intended for use in
	  other applications, such as the repro SIP proxy.

	  By default this package provides the core libraries: librutil
	  (utilities), libresip (SIP stack/RFC compliant message
	  parsing) and libdum (SIP Dialog Usage Manager, a state
	  machine for SIP dialogs).

	  https://www.resiprocate.org/

if BR2_PACKAGE_RESIPROCATE

config BR2_PACKAGE_RESIPROCATE_DTLS_SUPPORT
	bool "DTLS support"
	select BR2_PACKAGE_OPENSSL
	help
	  Enable DTLS support (requires OpenSSL)

config BR2_PACKAGE_RESIPROCATE_REND
	bool "resiprocate-rend"
	select BR2_PACKAGE_BOOST
	select BR2_PACKAGE_BOOST_SYSTEM
	select BR2_PACKAGE_OPENSSL
	select BR2_PACKAGE_POPT
	help
	  Rend is tool that is was created specifically to load test
	  gtSIP based presence servers.

config BR2_PACKAGE_RESIPROCATE_APPS
	bool "resiprocate-apps"
	select BR2_PACKAGE_PCRE
	help
	  Build apps clicktocall and sipdial

endif # BR2_PACKAGE_RESIPROCATE
```

## buildroot/package/rng-tools/Config.in
```kconfig
config BR2_PACKAGE_RNG_TOOLS
	bool "rng-tools"
	# pthread_setaffinity_np
	depends on BR2_TOOLCHAIN_HAS_THREADS_NPTL
	select BR2_PACKAGE_ARGP_STANDALONE if BR2_TOOLCHAIN_USES_UCLIBC || BR2_TOOLCHAIN_USES_MUSL
	select BR2_PACKAGE_LIBSYSFS
	select BR2_PACKAGE_OPENSSL
	help
	  Daemon to use hardware random number generators.

	  http://sourceforge.net/projects/gkernel/

if BR2_PACKAGE_RNG_TOOLS

config BR2_PACKAGE_RNG_TOOLS_JITTERENTROPY_LIBRARY
	bool "Jitterentropy Library support"
	default y
	select BR2_PACKAGE_JITTERENTROPY_LIBRARY
	help
	  Enable Jitterentropy Library support.

	  The Jitter RNG provides a noise source using the CPU
	  execution timing jitter. It does not depend on any
	  system resource other than a high-resolution time stamp.

config BR2_PACKAGE_RNG_TOOLS_NISTBEACON
	bool "NIST Entropy Beacon support"
	select BR2_PACKAGE_JANSSON
	select BR2_PACKAGE_LIBCURL
	select BR2_PACKAGE_LIBXML2
	help
	  Enable NIST Entropy Beacon support.

	  Entropy gathered from the NIST network entropy beacon. Note
	  that this entropy source is disabled by default as it should
	  never be used for cryptographic purposes, or any use case in
	  which random data should be known only by a single entity.

endif

comment "rng-tools needs a toolchain w/ NPTL"
	depends on !BR2_TOOLCHAIN_HAS_THREADS_NPTL
```

## buildroot/package/s390-tools/Config.in
```kconfig
comment "s390-tools needs a glibc toolchain w/ C++, wchar, dynamic library"
	depends on BR2_s390x
	depends on !BR2_TOOLCHAIN_USES_GLIBC || !BR2_INSTALL_LIBSTDCPP

config BR2_PACKAGE_S390_TOOLS
	bool "s390-tools"
	depends on BR2_s390x
	depends on BR2_INSTALL_LIBSTDCPP
	depends on BR2_TOOLCHAIN_USES_GLIBC
	select BR2_PACKAGE_ZLIB
	help
	  Tools for use with the s390 Linux kernel and device drivers.

	  https://github.com/ibm-s390-tools/s390-tools
```

## buildroot/package/screenfetch/Config.in
```kconfig
config BR2_PACKAGE_SCREENFETCH
	bool "screenfetch"
	depends on BR2_USE_MMU # bash
	depends on BR2_PACKAGE_BUSYBOX_SHOW_OTHERS # bash
	select BR2_PACKAGE_BASH # runtime dependency
	help
	  screenFetch is a bash script to display distro info.

	  https://github.com/KittyKatt/screenFetch
```

## buildroot/package/sdl_mixer/Config.in
```kconfig
config BR2_PACKAGE_SDL_MIXER
	bool "SDL_mixer"
	depends on BR2_PACKAGE_SDL
	help
	  SDL_mixer is a sample multi-channel audio mixer library.
	  It supports any number of simultaneously playing channels of
	  16 bit stereo audio, plus a single channel of music, mixed
	  by the popular MikMod MOD, Timidity MIDI, Ogg Vorbis, and
	  SMPEG MP3 libraries.

	  http://www.libsdl.org/projects/SDL_mixer/

if BR2_PACKAGE_SDL_MIXER

config BR2_PACKAGE_SDL_MIXER_MIDI_TIMIDITY
	bool "MIDI support with built-in Timidity synth"
	help
	  Support MIDI audio using the built-in synth based on Timidity.
	  You will need MIDI instruments installed in the filesystem.

endif
```

## buildroot/package/sentry-cli/Config.in.host
```kconfig
config BR2_PACKAGE_HOST_SENTRY_CLI
	bool "host sentry-cli"
	depends on BR2_PACKAGE_HOST_RUSTC_ARCH_SUPPORTS
	select BR2_PACKAGE_HOST_RUSTC
	help
	  Official Sentry command line interface

	  For managing debug information files and source maps.

	  https://docs.sentry.io/cli/
```
