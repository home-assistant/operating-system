## buildroot/support/testing/tests/core/test_selinux/br2_external/package/selinux-test/Config.in
```kconfig
config BR2_PACKAGE_SELINUX_TEST
	bool "SELinux test package"
	help
	  Test package for SELinux Buildroot helpers.
```

## buildroot/toolchain/toolchain-external/toolchain-external-bootlin/Config.in
```kconfig
config BR2_TOOLCHAIN_EXTERNAL_BOOTLIN
	bool "Bootlin toolchains"
	depends on BR2_TOOLCHAIN_EXTERNAL_BOOTLIN_ARCH_SUPPORTS
	depends on BR2_HOSTARCH = "x86_64"
	help
	  Bootlin toolchains are built using Buildroot for a large
	  number of architectures and C libraries configurations.

	  https://toolchains.bootlin.com
```
