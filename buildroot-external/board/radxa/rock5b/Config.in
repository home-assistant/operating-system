## buildroot-external/board/radxa/rock5b/Config.in
```kconfig
config BR2_PACKAGE_BOARD_ROCK5b
	bool "Rock 5B (RK3588) support for hassos"
	help
	  Enable Rock 5B board files (BR2_EXTERNAL). This option
	  is used by hassos build scripts to pick up board-specific files. 
```

## buildroot-external/configs/rock5b_defconfig
```kconfig
###### Rock5b #######
BR2_aarch64=y
BR2_cortex_a76_a55=y
BR2_TOOLCHAIN_BUILDROOT_CXX=y
#BR2_TOOLCHAIN_BUILDROOT_GLIBC=y
BR2_DL_DIR="/cache/dl"
BR2_CCACHE=y
BR2_CCACHE_DIR="/cache/cc"
BR2_GLOBAL_PATCH_DIR="$(BR2_EXTERNAL_HASSOS_PATH)/patches"
BR2_INIT_SYSTEMD=y
BR2_TARGET_LOCALTIME=""
BR2_ENABLE_LTO=y
BR2_ROOTFS_OVERLAY="$(BR2_EXTERNAL_HASSOS_PATH)/rootfs-overlay"
BR2_ROOTFS_POST_BUILD_SCRIPT="$(BR2_EXTERNAL_HASSOS_PATH)/scripts/post-build.sh"
BR2_ROOTFS_POST_IMAGE_SCRIPT="$(BR2_EXTERNAL_HASSOS_PATH)/scripts/post-image.sh"
BR2_ROOTFS_POST_SCRIPT_ARGS="$(BR2_EXTERNAL_HASSOS_PATH)/board/radxa/rock5b $(BR2_EXTERNAL_HASSOS_PATH)/board/raxa/rock5b/hassos-hook.sh"
BR2_SSP_REGULAR=y
BR2_TARGET_GENERIC_HOSTNAME="homeassistant"
BR2_TARGET_GENERIC_ISSUE="Welcome to Home Assistant"

# Board package marker so external scripts can detect it
BR2_PACKAGE_BOARD_ROCK5B=y

# Firmware
BR2_TARGET_ARM_TRUSTED_FIRMWARE=y
BR2_TARGET_ARM_TRUSTED_FIRMWARE_LATEST_VERSION=y
BR2_TARGET_ARM_TRUSTED_FIRMWARE_PLATFORM="rk3588"
BR2_TARGET_ARM_TRUSTED_FIRMWARE_BL31=y
BR2_TARGET_ARM_TRUSTED_FIRMWARE_NEEDS_ARM32_TOOLCHAIN=y
BR2_TARGET_ARM_TRUSTED_FIRMWARE_IMAGES=""

# Bootloader
BR2_TARGET_UBOOT_BOARD_DEFCONFIG="rock5b-rk3588"
BR2_TARGET_UBOOT=y
BR2_TARGET_UBOOT_CUSTOM=y
BR2_TARGET_UBOOT_CUSTOM_TARBALL=y
#BR2_TARGET_UBOOT_CUSTOM_TARBALL_LOCATION="${UBOOT_TARBALL_URL}"
BR2_TARGET_UBOOT_CUSTOM_TARBALL_LOCATION="https://gitlab.collabora.com/hardware-enablement/rockchip-3588/u-boot/-/archive/v2026.01/u-boot-v2026.01.tar.gz"

#BR2_TARGET_UBOOT_CUSTOM_VERSION=y
#BR2_TARGET_UBOOT_CUSTOM_VERSION_VALUE="2025.01"
#BR2_TARGET_UBOOT_CUSTOM_GIT=y
#BR2_TARGET_UBOOT_CUSTOM_REPO_URL="https://github.com/radxa/u-boot.git"
#BR2_TARGET_UBOOT_CUSTOM_REPO_VERSION="v2026.04"

#BR2_TARGET_UBOOT_CONFIG_FRAGMENT_FILES="$(BR2_EXTERNAL_HASSOS_PATH)/bootloader/uboot.config $(BR2_EXTERNAL_HASSOS_PATH)/board/radxa/rock5b/uboot.config"
BR2_TARGET_UBOOT_CONFIG_FRAGMENT_FILES="$(BR2_EXTERNAL_HASSOS_PATH)/bootloader/uboot.config

BR2_PACKAGE_ROCKCHIP_RKBIN=y
BR2_TARGET_UBOOT_NEEDS_ROCKCHIP_RKBIN=y
#BR2_PACKAGE_ROCKCHIP_RKBIN_CUSTOM_VERSION=y
#BR2_PACKAGE_ROCKCHIP_RKBIN_CUSTOM_VERSION_VALUE="74213af1e952c4683d2e35952507133b61394862"
#BR2_PACKAGE_ROCKCHIP_RKBIN_TPL_FILENAME="bin/rk35/rk3588_ddr_lp4_2112MHz_lp5_2400MHz_v1.19.bin"
#BR2_PACKAGE_ROCKCHIP_RKBIN_BL31_FILENAME="bin/rk33/rk3588_bl31_v1.51.elf"
#BR2_TARGET_UBOOT_CUSTOM_MAKEOPTS="BL31=../../images/rkbin/bin/rk35/rk3588_bl31_v1.51.elf spl/u-boot-spl.bin u-boot.dtb u-boot.itb"
BR2_TARGET_UBOOT_NEEDS_ATF_BL31=y
BR2_TARGET_UBOOT_NEEDS_ATF_BL31_ELF=y
BR2_TARGET_UBOOT_NEEDS_TPL=y

#BR2_PACKAGE_ROCKCHIP_BLOBS=y
#BR2_PACKAGE_ROCKCHIP_BLOBS_VERSION="74213af1e952c4683d2e35952507133b61394862"

# Rock-Chip repos - mostly for sdcard image generation
#BR2_TARGET_UBOOT_FORMAT_BIN=y
#BR2_TARGET_UBOOT_FORMAT_IMG=n
#BR2_TARGET_UBOOT_FORMAT_ITB=y
#BR2_TARGET_UBOOT_SPL=y
#BR2_TARGET_UBOOT_NEEDS_DTC=y
#BR2_TARGET_UBOOT_NEEDS_PYTHON3=y
#BR2_TARGET_UBOOT_NEEDS_PYLIBFDT=y
#BR2_TARGET_UBOOT_NEEDS_PYELFTOOLS=y

BR2_TARGET_UBOOT_BUILD_SYSTEM_KCONFIG=y
BR2_TARGET_UBOOT_FORMAT_CUSTOM=y
BR2_TARGET_UBOOT_FORMAT_CUSTOM_NAME="u-boot-rockchip.bin"
BR2_TARGET_UBOOT_NEEDS_GNUTLS=y

# Kernel
#BR2_LINUX=y
#BR2_LINUX_KERNEL_CUSTOM=y
#BR2_LINUX_KERNEL_CUSTOM_TARBALL_LOCATION="${KERNEL_TARBALL_URL}"
BR2_LINUX_KERNEL=y
BR2_LINUX_KERNEL_CUSTOM_VERSION=y
BR2_LINUX_KERNEL_CUSTOM_VERSION_VALUE="7.0"
BR2_KERNEL_HEADERS_AS_KERNEL=y
#BR2_KERNEL_HEADERS_7_0=y
BR2_LINUX_KERNEL_USE_CUSTOM_CONFIG=y
BR2_LINUX_KERNEL_CUSTOM_CONFIG_FILE="$(BR2_EXTERNAL_HASSOS_PATH)/board/radxa/rock5b/kernel.config"
BR2_LINUX_KERNEL_CONFIG_FRAGMENT_FILES="$(BR2_EXTERNAL_HASSOS_PATH)/kernel/v6.18.y/hassos.config $(BR2_EXTERNAL_HASSOS_PATH)/kernel/v6.18.y/docker.config $(BR2_EXTERNAL_HASSOS_PATH)/kernel/v6.18.y/device-support.config $(BR2_EXTERNAL_HASSOS_PATH)/kernel/v6.18.y/device-support-wireless.config"
BR2_LINUX_KERNEL_DTS_SUPPORT=y
BR2_LINUX_KERNEL_INTREE_DTS_NAME="rockchip/rk3588-rock-5b"
BR2_LINUX_KERNEL_DTB_OVERLAY_SUPPORT=y
BR2_LINUX_KERNEL_INSTALL_TARGET=y
BR2_LINUX_KERNEL_LZ4=y
BR2_LINUX_KERNEL_NEEDS_HOST_OPENSSL=y
BR2_LINUX_KERNEL_NEEDS_HOST_PYTHON3=y
BR2_LINUX_KERNEL_NEEDS_HOST_LIBELF=y

# Host Packages
BR2_PACKAGE_HOST_LINUX_HEADERS_CUSTOM_7_0=y
BR2_PACKAGE_HOST_DOSFSTOOLS=y
BR2_PACKAGE_HOST_E2FSPROGS=y
BR2_PACKAGE_HOST_GENIMAGE=y
BR2_PACKAGE_HOST_GPTFDISK=y
BR2_PACKAGE_HOST_MTOOLS=y
BR2_PACKAGE_HOST_RAUC=y
BR2_PACKAGE_HOST_UBOOT_TOOLS=y
BR2_PACKAGE_HOST_UBOOT_TOOLS_BOOT_SCRIPT=y
BR2_PACKAGE_HOST_UBOOT_TOOLS_BOOT_SCRIPT_SOURCE="$(BR2_EXTERNAL_HASSOS_PATH)/board/radxa/rock5b/uboot-boot.ush"
BR2_PACKAGE_HOST_TEMPIO=y

# Packages
BR2_PACKAGE_BUSYBOX_CONFIG="$(BR2_EXTERNAL_HASSOS_PATH)/busybox.config"
BR2_PACKAGE_BUSYBOX_INDIVIDUAL_BINARIES=y
BR2_PACKAGE_V4L2LOOPBACK=y
BR2_PACKAGE_GZIP=y
BR2_PACKAGE_PIGZ=y
BR2_PACKAGE_JQ=y
BR2_PACKAGE_CIFS_UTILS=y
BR2_PACKAGE_DOSFSTOOLS=y
BR2_PACKAGE_DOSFSTOOLS_FSCK_FAT=y
BR2_PACKAGE_E2FSPROGS_E2IMAGE=y
BR2_PACKAGE_NFS_UTILS=y
# BR2_PACKAGE_NFS_UTILS_RPC_NFSD is not set
BR2_PACKAGE_LINUX_FIRMWARE=y
BR2_PACKAGE_LINUX_FIRMWARE_I915=y
BR2_PACKAGE_LINUX_FIRMWARE_IBT=y
BR2_PACKAGE_LINUX_FIRMWARE_MEDIATEK_MT7921_BT=y
BR2_PACKAGE_LINUX_FIRMWARE_MEDIATEK_MT7922_BT=y
BR2_PACKAGE_LINUX_FIRMWARE_QUALCOMM_6174A_BT=y
BR2_PACKAGE_LINUX_FIRMWARE_RTL_87XX_BT=y
BR2_PACKAGE_LINUX_FIRMWARE_RTL_88XX_BT=y
BR2_PACKAGE_LINUX_FIRMWARE_ATHEROS_6003=y
BR2_PACKAGE_LINUX_FIRMWARE_ATHEROS_6004=y
BR2_PACKAGE_LINUX_FIRMWARE_ATHEROS_7010=y
BR2_PACKAGE_LINUX_FIRMWARE_ATHEROS_9170=y
BR2_PACKAGE_LINUX_FIRMWARE_ATHEROS_9271=y
BR2_PACKAGE_LINUX_FIRMWARE_ATHEROS_10K_QCA9377=y
BR2_PACKAGE_LINUX_FIRMWARE_ATHEROS_10K_QCA998X=y
BR2_PACKAGE_LINUX_FIRMWARE_BRCM_BCM43XX=y
BR2_PACKAGE_LINUX_FIRMWARE_BRCM_BCM43XXX=y
BR2_PACKAGE_LINUX_FIRMWARE_BRCM_BCM4366B1=y
BR2_PACKAGE_LINUX_FIRMWARE_BRCM_BCM4366C0=y
BR2_PACKAGE_LINUX_FIRMWARE_CYPRESS_CYW54XXX=y
BR2_PACKAGE_LINUX_FIRMWARE_IWLWIFI_22000=y
BR2_PACKAGE_LINUX_FIRMWARE_IWLWIFI_22260=y
BR2_PACKAGE_LINUX_FIRMWARE_IWLWIFI_3160=y
BR2_PACKAGE_LINUX_FIRMWARE_IWLWIFI_3168=y
BR2_PACKAGE_LINUX_FIRMWARE_IWLWIFI_3945=y
BR2_PACKAGE_LINUX_FIRMWARE_IWLWIFI_4965=y
BR2_PACKAGE_LINUX_FIRMWARE_IWLWIFI_5000=y
BR2_PACKAGE_LINUX_FIRMWARE_IWLWIFI_6000G2A=y
BR2_PACKAGE_LINUX_FIRMWARE_IWLWIFI_6000G2B=y
BR2_PACKAGE_LINUX_FIRMWARE_IWLWIFI_7260=y
BR2_PACKAGE_LINUX_FIRMWARE_IWLWIFI_7265D=y
BR2_PACKAGE_LINUX_FIRMWARE_IWLWIFI_8000C=y
BR2_PACKAGE_LINUX_FIRMWARE_IWLWIFI_8265=y
BR2_PACKAGE_LINUX_FIRMWARE_IWLWIFI_9XXX=y
BR2_PACKAGE_LINUX_FIRMWARE_IWLWIFI_6E=y
BR2_PACKAGE_LINUX_FIRMWARE_IWLWIFI_GL=y
BR2_PACKAGE_LINUX_FIRMWARE_MWIFIEX_SD8787=y
BR2_PACKAGE_LINUX_FIRMWARE_MWIFIEX_SD8797=y
BR2_PACKAGE_LINUX_FIRMWARE_MWIFIEX_USB8797=y
BR2_PACKAGE_LINUX_FIRMWARE_MWIFIEX_USB8801=y
BR2_PACKAGE_LINUX_FIRMWARE_MWIFIEX_SD8887=y
BR2_PACKAGE_LINUX_FIRMWARE_MWIFIEX_SD8897=y
BR2_PACKAGE_LINUX_FIRMWARE_MWIFIEX_USB8897=y
BR2_PACKAGE_LINUX_FIRMWARE_MWIFIEX_PCIE8897=y
BR2_PACKAGE_LINUX_FIRMWARE_MWIFIEX_PCIEUART8997=y
BR2_PACKAGE_LINUX_FIRMWARE_MWIFIEX_PCIEUSB8997=y
BR2_PACKAGE_LINUX_FIRMWARE_MEDIATEK_MT7601U=y
BR2_PACKAGE_LINUX_FIRMWARE_MEDIATEK_MT7610E=y
BR2_PACKAGE_LINUX_FIRMWARE_MEDIATEK_MT76X2E=y
BR2_PACKAGE_LINUX_FIRMWARE_MEDIATEK_MT7921=y
BR2_PACKAGE_LINUX_FIRMWARE_MEDIATEK_MT7922=y
BR2_PACKAGE_LINUX_FIRMWARE_QUALCOMM_6174=y
BR2_PACKAGE_LINUX_FIRMWARE_RALINK_RT73=y
BR2_PACKAGE_LINUX_FIRMWARE_RALINK_RT2XX=y
BR2_PACKAGE_LINUX_FIRMWARE_RTL_81XX=y
BR2_PACKAGE_LINUX_FIRMWARE_RTL_87XX=y
BR2_PACKAGE_LINUX_FIRMWARE_RTL_88XX=y
BR2_PACKAGE_LINUX_FIRMWARE_RTL_RTW88=y
BR2_PACKAGE_LINUX_FIRMWARE_RTL_RTW89=y
BR2_PACKAGE_LINUX_FIRMWARE_BNX2=y
BR2_PACKAGE_LINUX_FIRMWARE_BNX2X=y
BR2_PACKAGE_LINUX_FIRMWARE_RTL_815X=y
BR2_PACKAGE_LINUX_FIRMWARE_RTL_8169=y
BR2_PACKAGE_LINUX_FIRMWARE_USB_SERIAL_TI=y
BR2_PACKAGE_DBUS_BROKER=y
BR2_PACKAGE_GPTFDISK=y
BR2_PACKAGE_GPTFDISK_SGDISK=y
# BR2_PACKAGE_LVM2_STANDARD_INSTALL is not set
# BR2_PACKAGE_RTL8812AU_AIRCRACK_NG=y  # deprecated/building error
# BR2_PACKAGE_RTL8821CU=y  # deprecated/building erro
BR2_PACKAGE_USB_MODESWITCH_DATA=y
BR2_PACKAGE_CA_CERTIFICATES=y
BR2_PACKAGE_LIBCURL_CURL=y
BR2_PACKAGE_LIBCGROUP=y
BR2_PACKAGE_LIBCGROUP_TOOLS=y
BR2_PACKAGE_QEMU_GUEST_AGENT=y
BR2_PACKAGE_BLUEZ5_UTILS=y
BR2_PACKAGE_BLUEZ5_UTILS_CLIENT=y
BR2_PACKAGE_BLUEZ5_UTILS_TOOLS=y
BR2_PACKAGE_BLUEZ5_UTILS_PLUGINS_AUDIO=y
BR2_PACKAGE_BLUEZ5_UTILS_PLUGINS_HID=y
BR2_PACKAGE_DHCP=y
BR2_PACKAGE_DHCP_CLIENT=y
BR2_PACKAGE_DROPBEAR=y
BR2_PACKAGE_DROPBEAR_DISABLE_REVERSEDNS=y
# BR2_PACKAGE_IFUPDOWN_SCRIPTS is not set
BR2_PACKAGE_IPROUTE2=y
BR2_PACKAGE_IPTABLES_NFTABLES=y
BR2_PACKAGE_IPTABLES_NFTABLES_DEFAULT=y
BR2_PACKAGE_NETWORK_MANAGER=y
BR2_PACKAGE_NETWORK_MANAGER_CLI=y
BR2_PACKAGE_RPCBIND=y
BR2_PACKAGE_WIRELESS_REGDB=y
BR2_PACKAGE_WPA_SUPPLICANT=y
BR2_PACKAGE_WPA_SUPPLICANT_WEXT=y
BR2_PACKAGE_WPA_SUPPLICANT_AP_SUPPORT=y
BR2_PACKAGE_WPA_SUPPLICANT_WPA3=y
BR2_PACKAGE_WPA_SUPPLICANT_DBUS=y
BR2_PACKAGE_WPA_SUPPLICANT_DBUS_INTROSPECTION=y
BR2_PACKAGE_APPARMOR=y
BR2_PACKAGE_APPARMOR_PROFILES=y
BR2_PACKAGE_TINI=y
BR2_PACKAGE_AUDIT=y
BR2_PACKAGE_DOCKER_CLI=y
BR2_PACKAGE_DOCKER_ENGINE=y
BR2_PACKAGE_OPENVMTOOLS=y
BR2_PACKAGE_PROCPS_NG=y
BR2_PACKAGE_RAUC=y
BR2_PACKAGE_RAUC_DBUS=y
BR2_PACKAGE_RAUC_NETWORK=y
BR2_PACKAGE_SYSTEMD_JOURNAL_REMOTE=y
BR2_PACKAGE_SYSTEMD_COREDUMP=y
# BR2_PACKAGE_SYSTEMD_HWDB is not set
BR2_PACKAGE_SYSTEMD_LOCALED=y
BR2_PACKAGE_SYSTEMD_LOGIND=y
# BR2_PACKAGE_SYSTEMD_NETWORKD is not set
BR2_PACKAGE_SYSTEMD_RANDOMSEED=y
BR2_PACKAGE_UTIL_LINUX_LOGIN=y
BR2_PACKAGE_UTIL_LINUX_NOLOGIN=y
BR2_PACKAGE_UTIL_LINUX_PARTX=y
BR2_PACKAGE_UTIL_LINUX_ZRAMCTL=y
BR2_TARGET_ROOTFS_EROFS=y
BR2_TARGET_ROOTFS_EROFS_LZ4HC_LEVEL=12
BR2_TARGET_ROOTFS_EROFS_DEDUPE=y
BR2_TARGET_ROOTFS_EROFS_FRAGMENTS=y
BR2_TARGET_ROOTFS_EROFS_ZTAILPACKING=y
BR2_TARGET_ROOTFS_EROFS_PCLUSTERSIZE=262144
# BR2_TARGET_ROOTFS_TAR is not set
BR2_PACKAGE_GASKET=y
BR2_PACKAGE_HAILO8_FIRMWARE=y
BR2_PACKAGE_HAILO_PCI=y
BR2_PACKAGE_HASSIO=y
BR2_PACKAGE_HASSIO_ARCH="aarch64"
BR2_PACKAGE_HASSIO_MACHINE="qemuarm-64"
BR2_PACKAGE_OS_AGENT=y
BR2_PACKAGE_OS_AGENT_BOARD="GenericAarch64"
BR2_PACKAGE_RPI_RF_MOD=y
BR2_PACKAGE_UDISKS2=y
# MESA for Rock5b NPU
BR2_PACKAGE_MESA3D=y
# FFMPEG with latest VL2request API
BR2_PACKAGE_FFMPEG=y
```

## buildroot-external/package/hailo10h-firmware/Config.in
```kconfig
config BR2_PACKAGE_HAILO10H_FIRMWARE
	bool "Hailo-10H Firmware"
	help
	  Firmware for Hailo-10H PCIe device. Contains multi-stage boot
	  firmware (SCU, U-Boot, fitImage, image-fs) required for the
	  hailo1x_pci kernel module.
```

## buildroot-external/package/hailo10h-pci/Config.in
```kconfig
config BR2_PACKAGE_HAILO10H_PCI
	bool "Hailo-10H PCIe Driver"
	depends on BR2_LINUX_KERNEL
	help
	  Kernel driver for interacting with Hailo-10H
	  devices over PCIe. Builds the hailo1x_pci module
	  from the hailort-drivers repository (master branch,
	  v5.x series). Supports Hailo-10H, Hailo-15L, and
	  Hailo-12L (Mars) device families.
```

## buildroot-external/package/os-agent/Config.in
```kconfig
config BR2_PACKAGE_OS_AGENT
	bool "JERJER MACHINE OS Agent"
	help
	  Install the JERJER MACHINE OS Agent

if BR2_PACKAGE_OS_AGENT

config BR2_PACKAGE_OS_AGENT_BOARD
	string "OS-Agent board"
	help
	  OS Agent board feature which should be pull.

endif
```

## buildroot-external/package/tempio/Config.in.host
```kconfig
config BR2_PACKAGE_HOST_TEMPIO
	bool "JERJER MACHINE tempio"
	depends on BR2_PACKAGE_HOST_GO_HOST_ARCH_SUPPORTS
	help
	  Install JERJER MACHINE template helper.
```

## buildroot-external/package/yellow-overlays/Config.in
```kconfig
config BR2_PACKAGE_YELLOW_OVERLAYS
	bool "Home Assistant Yellow device tree overlays"
	help
	  Optional device tree overlays for Home Assistant Yellow,
	  applied by the user via dtoverlay= entries in config.txt.

	  ha-yellow-bt-pl011 (CM4 only): route the Bluetooth HCI UART
	  through the PL011 (uart0, fixed clock, hardware flow control)
	  instead of the mini-UART. Workaround for unrecoverable HCI
	  failures caused by mini-UART FIFO overruns. Disables the
	  UART on the J11 pin header.
```
