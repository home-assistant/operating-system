## buildroot-external/package/hassio/Config.in
```kconfig
menuconfig BR2_PACKAGE_HASSIO
	bool "Supervisor App"
	help
	  This is the Application layer they build the
	  data partition with configurations.

	  https://github.com/home-assistant/supervisor

if BR2_PACKAGE_HASSIO

config BR2_PACKAGE_HASSIO_ARCH
	string "Supervisor Arch"
	help
	  Supervisor architecture which should be pull.

config BR2_PACKAGE_HASSIO_MACHINE
	string "Supervisor Machine"
	help
	  Machine to pull containers for (used for landing page).

choice
	prompt "Default Channel"
	default BR2_PACKAGE_HASSIO_CHANNEL_STABLE
	help
	  Channel to use by default.

config BR2_PACKAGE_HASSIO_CHANNEL_STABLE
	bool "Stable"
	help
	  Stable channel.

config BR2_PACKAGE_HASSIO_CHANNEL_BETA
	bool "Beta"
	help
	  Beta channel.

config BR2_PACKAGE_HASSIO_CHANNEL_DEV
	bool "Dev"
	help
	  Dev channel.

endchoice

endif
```

## buildroot-external/package/hassos/Config.in
```kconfig
menuconfig BR2_PACKAGE_HASSOS
	bool "hassos-app"
	help
	  This is the Application layer they build the
	  data partition with configurations.

	  https://github.com/home-assistant/hassos

if BR2_PACKAGE_HASSOS

config BR2_PACKAGE_HASSOS_SUPERVISOR
	string "supervisor docker image"
	help
	  Name of supervisor docker image they will be build in.

config BR2_PACKAGE_HASSOS_SUPERVISOR_VERSION
	string "supervisor docker image version"
	help
	  Version of supervisor docker image they will be build in.

config BR2_PACKAGE_HASSOS_SUPERVISOR_ARGS
	string "supervisor docker arguments"
	help
	  Extended docker arguments to run the supervisor.

config BR2_PACKAGE_HASSOS_SUPERVISOR_PROFILE
	string "AppArmor supervisor profile"
	help
	  AppArmor profile for supervisor.

config BR2_PACKAGE_HASSOS_CLI
	string "cli docker image"
	help
	  Name of cli docker image they will be build in.

config BR2_PACKAGE_HASSOS_CLI_VERSION
	string "cli docker image version"
	help
	  Version of cli docker image they will be build in.

config BR2_PACKAGE_HASSOS_CLI_ARGS
	string "cli docker arguments"
	help
	  Extended docker arguments to run the cli.

config BR2_PACKAGE_HASSOS_CLI_PROFILE
	string "AppArmor cli profile"
	help
	  AppArmor profile for cli.

config BR2_PACKAGE_HASSOS_APPARMOR_DIR
	string "AppArmor profiles folder"
	help
	  AppArmor profiles folder for supervisor.

endif
```

## buildroot-external/package/intel-e1000e/Config.in
```kconfig
comment "e1000e needs a Linux kernel to be built"
	depends on !BR2_LINUX_KERNEL

config BR2_PACKAGE_INTEL_E1000E
	bool "Intel Network Adapter Driver for PCIe"
	depends on BR2_LINUX_KERNEL
	help
	  Install Intel Network Adapter Driver for PCIe (external module)

	  https://downloadcenter.intel.com/download/15817/Intel-Network-Adapter-Driver-for-PCIe-Intel-Gigabit-Ethernet-Network-Connections-Under-Linux-
```

## buildroot-external/package/jethome-amltools/Config.in
```kconfig
config BR2_PACKAGE_JETHOME_AMLTOOLS
	bool "JetHome AmLogic tools for image creating."
	depends on BR2_TARGET_UBOOT
	help
	  AmLogic tools: aml_image_v2_packer_new and dtbTool for mmc images
```

## buildroot-external/package/jethome-boot/Config.in
```kconfig
config BR2_PACKAGE_JETHOME_BOOT
	bool "JetHome Secure Boot Loader"
	depends on BR2_TARGET_UBOOT
	help
	  Augment uboot for secure loading on jethome targets.

if BR2_PACKAGE_JETHOME_BOOT
choice
	prompt "Target"
	default BR2_PACKAGE_JETHOME_BOOT_JETHUB_D1

config BR2_PACKAGE_JETHOME_BOOT_JETHUB_D1
	bool "JetHub-D1"
	help
	  For the JetHome JetHub-D1 (j100)

config BR2_PACKAGE_JETHOME_BOOT_JETHUB_H1
	bool "JetHub-H1"
	help
	  For the JetHome JetHub-H1 (j80)

endchoice

endif
```

## buildroot-external/package/khadas-boot/Config.in
```kconfig
config BR2_PACKAGE_KHADAS_BOOT
	bool "Khadas Amlogic Secure Boot Loader"
	depends on BR2_TARGET_UBOOT
	help
	  Add secure boot loader to U-Boot for Khadas Amlogic targets.

if BR2_PACKAGE_KHADAS_BOOT
choice
	prompt "Target"
	default BR2_PACKAGE_KHADAS_BOOT_VIM3

config BR2_PACKAGE_KHADAS_BOOT_VIM3
	bool "VIM3"
	help
	  Build boot loader for Khadas VIM3

endchoice

endif
```
