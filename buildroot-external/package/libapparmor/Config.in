## buildroot-external/package/libapparmor/Config.in
```kconfig
config BR2_PACKAGE_LIBAPPARMOR
	bool "libapparmor"
	help
	  AppArmor gives you network application security via mandatory 
	  access control for programs, protecting against the exploitation 
	  of software flaws and compromised systems.

	  http://apparmor.net
```

## buildroot-external/package/linux-gadget/Config.in
```kconfig
config BR2_PACKAGE_LINUX_GADGET
	bool "Activate CDC UMS gadget"
	depends on BR2_LINUX_KERNEL
	help
	  Activate linux gadgets for CDC console and UMS

if BR2_PACKAGE_LINUX_GADGET

config BR2_PACKAGE_LINUX_GADGET_GETTY
	bool "CDC-ACM Getty"
	help
	  Activate getty console on OTG port

config BR2_PACKAGE_LINUX_GADGET_UMS
	bool "UMS Gadget"
	help
	  Activate UMS gadget on OTG port
if BR2_PACKAGE_LINUX_GADGET_UMS

config BR2_PACKAGE_LINUX_GADGET_UMS_LUN
	string "UMS LUN"
	default "/dev/mmcblk0"
	help
	  LUN backing file for UMS gadget

endif

endif
```

## buildroot-external/package/lxd-guest-agent/Config.in
```kconfig
config BR2_PACKAGE_LXD_GUEST_AGENT
	bool "LXD Guest Agent"
	depends on BR2_USE_MMU # libglib2
	depends on BR2_USE_WCHAR # libglib2
	depends on BR2_TOOLCHAIN_HAS_THREADS # libglib2
	select BR2_PACKAGE_LIBGLIB2
	select BR2_PACKAGE_ZLIB
	help
	  LXD guest agent for LXD based virtualisations
```

## buildroot-external/package/mingetty/Config.in
```kconfig
config BR2_PACKAGE_MINGETTY
	bool "mingetty"
	help
	  mingetty is a minimal getty for use on virtual consoles and is not
	  suitable for use on serial lines.

	  http://sourceforge.net/projects/mingetty/
```

## buildroot-external/package/pi-bluetooth/Config.in
```kconfig
config BR2_PACKAGE_PI_BLUETOOTH
	bool "Bluetooth scripts for Raspberry Pi"
	depends on BR2_PACKAGE_BLUEZ5_UTILS_CLIENT
	depends on BR2_PACKAGE_BRCMFMAC_SDIO_FIRMWARE_RPI_BT
	select BR2_PACKAGE_BLUEZ5_UTILS_DEPRECATED
	help
	  Install Bluetooth scripts for Raspberry Pi
```

## buildroot-external/package/qemu-guest-agent/Config.in
```kconfig
config BR2_PACKAGE_QEMU_GUEST_AGENT
	bool "QEMU Guest Agent"
	depends on BR2_USE_MMU # libglib2
	depends on BR2_USE_WCHAR # libglib2
	depends on BR2_TOOLCHAIN_HAS_THREADS # libglib2
	select BR2_PACKAGE_LIBGLIB2
	select BR2_PACKAGE_ZLIB
	help
	  QEMU guest agent for qemu based virtualisations
```

## buildroot-external/package/rockchip-blobs/Config.in
```kconfig
config BR2_PACKAGE_ROCKCHIP_BLOBS
	bool "Rockchip loader binaries"
	help
	  Rockchip loader binaries (required by U-Boot)

if BR2_PACKAGE_ROCKCHIP_BLOBS

config BR2_PACKAGE_ROCKCHIP_BLOBS_VERSION
	string "Git hash version of rkbin"

config BR2_PACKAGE_ROCKCHIP_BLOBS_ATF
	string "ARM Trusted Firmware file"
	help
	  ARM Trusted Firmware file

config BR2_PACKAGE_ROCKCHIP_BLOBS_TPL
	string "Rockchip TPL file"
	help
	  Rockchip TPL file

endif
```

## buildroot-external/package/rpi-eeprom/Config.in
```kconfig
config BR2_PACKAGE_RPI_EEPROM
	bool "rpi-eeprom"
	select BR2_PACKAGE_PYTHON3
	select BR2_PACKAGE_VCGENCMD
	help
	  EEPROM bootloader firmware update tool for Raspberry Pi

	  https://github.com/raspberrypi/rpi-eeprom

if BR2_PACKAGE_RPI_EEPROM

choice
	prompt "Target platform"
	default BR2_PACKAGE_RPI_EEPROM_TARGET_ANY
	help
	  Select the target platform for the EEPROM files to be
	  installed. The default is to install all EEPROM files for
	  all Raspberry Pi boards.

config BR2_PACKAGE_RPI_EEPROM_TARGET_ANY
	bool "Any Raspberry Pi"
	help
	  Install all EEPROM files for all Raspberry Pi boards.

config BR2_PACKAGE_RPI_EEPROM_TARGET_RPI4
	bool "Raspberry Pi 4"
	help
	  Install EEPROM files for Raspberry Pi 4 boards only.

config BR2_PACKAGE_RPI_EEPROM_TARGET_RPI5
	bool "Raspberry Pi 5"
	help
	  Install EEPROM files for Raspberry Pi 5 boards only.

endchoice

endif
```

## buildroot-external/package/rpi-rf-mod/Config.in
```kconfig
config BR2_PACKAGE_RPI_RF_MOD
	bool "Support for RPI-RF-MOD/HM-MOD-RPI-PCB GPIO HAT"
	select BR2_PACKAGE_EQ3_CHAR_LOOP
	select BR2_PACKAGE_GENERIC_RAW_UART

if BR2_PACKAGE_RPI_RF_MOD

config BR2_PACKAGE_RPI_RF_MOD_DTS
	bool "Compile Device Tree Overlay"

if BR2_PACKAGE_RPI_RF_MOD_DTS

choice
	prompt "For Target"
	default BR2_PACKAGE_RPI_RF_MOD_DTS_RPI

config BR2_PACKAGE_RPI_RF_MOD_DTS_RPI
	bool "RaspberryPi"
	help
	  For the RaspberryPi

config BR2_PACKAGE_RPI_RF_MOD_DTS_TINKER
	bool "ASUS Tinkerboard"
	help
	  For the ASUS Tinkerboard

config BR2_PACKAGE_RPI_RF_MOD_DTS_ODROID_C4
	bool "ODROID-C4"
	help
	  For the ODROID-C4

config BR2_PACKAGE_RPI_RF_MOD_DTS_ODROID_N2
	bool "ODROID-N2"
	help
	  For the ODROID-N2

config BR2_PACKAGE_RPI_RF_MOD_DTS_ODROID_C2
	bool "ODROID-C2"
	help
	  For the ODROID-C2

config BR2_PACKAGE_RPI_RF_MOD_DTS_YELLOW
	bool "HomeAssistant Yellow"
	help
	  For the HomeAssistant Yellow

endchoice

endif

endif
```

## buildroot-external/package/rtk-hciattach/Config.in
```kconfig
menuconfig BR2_PACKAGE_RTK_HCIATTACH
	bool "Realtek hciattach"
	help
	  Hciattach is used to attach a serial UART to 
	  the Bluetooth stack as HCI transport interface.
```

## buildroot-external/package/rtl-sdr/Config.in
```kconfig
config BR2_PACKAGE_RTL_SDR
	bool "RTL-SDR (Osmocom rtl-sdr)"
	depends on BR2_LINUX_KERNEL
	help
	  Open source driver for RTL2832 based DVB-T receivers including RTL-SDR v4.
	  Installs the library and utilities for SDR applications.
```

## buildroot-external/package/rtl8812au/Config.in
```kconfig
comment "RTL8812AU needs a Linux kernel to be built"
	depends on !BR2_LINUX_KERNEL

config BR2_PACKAGE_RTL8812AU
	bool "Realtek RTL8812AU Wi-Fi driver"
	depends on BR2_LINUX_KERNEL
	help
          Install Realtek RTL8812AU Wi-Fi driver as a kernel module.

          https://github.com/gnab/rtl8812au/
```

## buildroot-external/package/rtl8821cu/Config.in
```kconfig
config BR2_PACKAGE_RTL8821CU
	tristate "Realtek 8821cu USB WiFi"
	depends on BR2_LINUX_KERNEL
	---help---
	  Driver for RTL8821CU USB WiFi adapters (no firmware needed).
```

## buildroot-external/package/rtl8822cs/Config.in
```kconfig
comment "RTL8822CS needs a Linux kernel to be built"
	depends on !BR2_LINUX_KERNEL

config BR2_PACKAGE_RTL8822CS
	bool "Realtek RTL8822CS SDIO Wi-Fi driver"
	depends on BR2_LINUX_KERNEL
	help
          Install Realtek RTL8822CS Wi-Fi driver as a kernel module.

          https://github.com/jethome-ru/rtl88x2cs/
```

## buildroot-external/package/rtl88x2bu/Config.in
```kconfig
config BR2_PACKAGE_RTL88X2BU
	tristate "Realtek 88x2 USB WiFi"
	depends on BR2_LINUX_KERNEL
	---help---
	  Driver for RTL88X2BU USB WiFi adapters (no firmware needed).
```

## buildroot-external/package/rx8130-rtc/Config.in
```kconfig
config BR2_PACKAGE_RX8130_RTC
	bool "Support for Epson RX8130CE real time clock"
```

## buildroot-external/package/supervisor/Config.in
```kconfig
menuconfig BR2_PACKAGE_SUPERVISOR
	bool "Supervisor App"
	help
	  This is the Application layer they build the
	  data partition with configurations.

	  https://github.com/home-assistant/supervisor

if BR2_PACKAGE_SUPERVISOR

config BR2_PACKAGE_SUPERVISOR_ARCH
	string "Supervisor Arch"
	help
	  Supervisor architecture which should be pull.

endif
```

## buildroot-external/package/udisks2/Config.in
```kconfig
config BR2_PACKAGE_UDISKS2
	bool "udisks2"
	depends on BR2_ENABLE_LOCALE # parted
	depends on BR2_PACKAGE_HAS_UDEV
	depends on BR2_USE_MMU # lvm2
	depends on BR2_USE_WCHAR # dbus-glib -> glib2
	depends on !BR2_TOOLCHAIN_USES_UCLIBC # polkit, lvm2
	select BR2_PACKAGE_DBUS
	select BR2_PACKAGE_DBUS_GLIB
	select BR2_PACKAGE_LIBATASMART
	select BR2_PACKAGE_LIBBLOCKDEV
	select BR2_PACKAGE_LIBBLOCKDEV_CRYPTO
	select BR2_PACKAGE_LIBBLOCKDEV_FS
	select BR2_PACKAGE_LIBBLOCKDEV_LOOP
	select BR2_PACKAGE_LIBBLOCKDEV_MDRAID
	select BR2_PACKAGE_LIBBLOCKDEV_NVME
	select BR2_PACKAGE_LIBBLOCKDEV_PART
	select BR2_PACKAGE_LIBBLOCKDEV_SWAP
	select BR2_PACKAGE_LIBGUDEV
	select BR2_PACKAGE_PARTED
	help
	  The udisks2 project provides

	   o A storage daemon that implements well-defined D-Bus
	     interfaces that can be used to query and manipulate
	     storage devices.

	   o a command-line tool, udisksctl(1), that can be used to
	     query and use the daemon

          https://github.com/storaged-project/udisks

if BR2_PACKAGE_UDISKS2

config BR2_PACKAGE_UDISKS2_LVM2
	bool "lvm2 support"
	# The lvm app library can't compile against musl
	depends on BR2_TOOLCHAIN_USES_GLIBC
	depends on !BR2_STATIC_LIBS
	select BR2_PACKAGE_LVM2
	select BR2_PACKAGE_LVM2_APP_LIBRARY
	help
	  Enable LVM2 support

comment "lvm2 support needs a glibc toolchain"
	depends on !BR2_TOOLCHAIN_USES_GLIBC

endif

comment "udisks2 needs udev /dev management"
	depends on BR2_USE_MMU
	depends on !BR2_PACKAGE_HAS_UDEV

comment "udisks2 needs a glibc or musl toolchain with locale, C++, wchar, dynamic library, NPTL, gcc >= 4.9"
	depends on BR2_USE_MMU
	depends on BR2_PACKAGE_SPIDERMONKEY_ARCH_SUPPORTS
	depends on !BR2_ENABLE_LOCALE || BR2_TOOLCHAIN_USES_UCLIBC || \
		!BR2_INSTALL_LIBSTDCPP || \
		BR2_STATIC_LIBS || \
		!BR2_TOOLCHAIN_HAS_THREADS_NPTL || \
		!BR2_HOST_GCC_AT_LEAST_4_9 || \
		!BR2_TOOLCHAIN_GCC_AT_LEAST_4_9 || \
		!BR2_USE_WCHAR
```

## buildroot-external/package/vcgencmd/Config.in
```kconfig
config BR2_PACKAGE_VCGENCMD
	bool "vcgencmd"
	help
	  Command line utility that can get various pieces of
	  information from the VideoCore GPU on the Raspberry Pi.
```

## buildroot-external/package/xe-guest-utilities/Config.in
```kconfig
config BR2_PACKAGE_XE_GUEST_UTILITIES
	bool "Xen guest utilities"
	depends on BR2_PACKAGE_HOST_GO_TARGET_ARCH_SUPPORTS
	depends on BR2_PACKAGE_HOST_GO_TARGET_CGO_LINKING_SUPPORTS
	depends on BR2_TOOLCHAIN_HAS_THREADS
	help
	  Xen guest utilities for UNIX-like operating systems.
```

## buildroot/board/chromebook/elm/kernel.its
```
/dts-v1/;

/ {
	description = "Chrome OS kernel image with FDT";
	#address-cells = <1>;

	images {
		kernel-1 {
			data = /incbin/("Image");
			type = "kernel_noload";
			arch = "arm64";
			os = "linux";
			compression = "none";
			load = <0>;
			entry = <0>;
		};

		fdt-1 {
			description = "mt8173-elm.dtb";
			data = /incbin/("mt8173-elm.dtb");
			type = "flat_dt";
			arch = "arm64";
			compression = "none";

			hash-1 {
				algo = "sha1";
			};
		};
	};

	configurations {
		default = "conf-1";
		conf-1 {
			kernel = "kernel-1";
			fdt = "fdt-1";
		};
	};
};
```

## buildroot/configs/arm_foundationv8_defconfig
```kconfig
BR2_aarch64=y
# Linux headers same as kernel, a 5.9 series
BR2_PACKAGE_HOST_LINUX_HEADERS_CUSTOM_5_9=y
BR2_TARGET_GENERIC_GETTY_PORT="ttyAMA0"
BR2_LINUX_KERNEL=y
BR2_LINUX_KERNEL_CUSTOM_VERSION=y
BR2_LINUX_KERNEL_CUSTOM_VERSION_VALUE="5.9.11"
BR2_LINUX_KERNEL_USE_ARCH_DEFAULT_CONFIG=y
BR2_LINUX_KERNEL_DTS_SUPPORT=y
BR2_LINUX_KERNEL_INTREE_DTS_NAME="arm/foundation-v8-gicv3-psci"
BR2_LINUX_KERNEL_NEEDS_HOST_OPENSSL=y
BR2_TARGET_ROOTFS_EXT2=y
# BR2_TARGET_ROOTFS_TAR is not set
BR2_TARGET_BOOT_WRAPPER_AARCH64=y
BR2_TARGET_BOOT_WRAPPER_AARCH64_DTS="arm/foundation-v8-gicv3-psci"
BR2_TARGET_BOOT_WRAPPER_AARCH64_BOOTARGS="root=/dev/vda consolelog=9 console=ttyAMA0 rw"
BR2_TARGET_BOOT_WRAPPER_AARCH64_PSCI=y
BR2_TARGET_BOOT_WRAPPER_AARCH64_GICV3=y
```

## buildroot/configs/bananapi_m1_plus_defconfig
```kconfig
BR2_arm=y
BR2_cortex_a7=y
BR2_ARM_FPU_NEON_VFPV4=y
BR2_GLOBAL_PATCH_DIR="board/sinovoip/m1-plus/patches"
BR2_PACKAGE_HOST_LINUX_HEADERS_CUSTOM_5_10=y
BR2_TARGET_GENERIC_HOSTNAME="bananapi"
BR2_TARGET_GENERIC_ISSUE="Welcome to Banana Pi!"
BR2_ROOTFS_DEVICE_CREATION_DYNAMIC_MDEV=y
BR2_TARGET_GENERIC_GETTY_PORT="ttyS0"
BR2_ROOTFS_OVERLAY="board/sinovoip/m1-plus/rootfs_overlay"
BR2_ROOTFS_POST_BUILD_SCRIPT="board/sinovoip/m1-plus/post-build.sh"
BR2_ROOTFS_POST_IMAGE_SCRIPT="support/scripts/genimage.sh"
BR2_ROOTFS_POST_SCRIPT_ARGS="-c board/sinovoip/m1-plus/genimage.cfg"
BR2_LINUX_KERNEL=y
BR2_LINUX_KERNEL_CUSTOM_VERSION=y
BR2_LINUX_KERNEL_CUSTOM_VERSION_VALUE="5.10.3"
BR2_LINUX_KERNEL_DEFCONFIG="sunxi"
BR2_LINUX_KERNEL_CONFIG_FRAGMENT_FILES="board/sinovoip/m1-plus/linux-wifi.fragment"
BR2_LINUX_KERNEL_DTS_SUPPORT=y
BR2_LINUX_KERNEL_INTREE_DTS_NAME="sun7i-a20-bananapi-m1-plus"
BR2_LINUX_KERNEL_NEEDS_HOST_OPENSSL=y
BR2_PACKAGE_LINUX_FIRMWARE=y
BR2_PACKAGE_LINUX_FIRMWARE_BRCM_BCM43XXX=y
BR2_PACKAGE_IW=y
BR2_PACKAGE_WPA_SUPPLICANT=y
BR2_PACKAGE_WPA_SUPPLICANT_CLI=y
BR2_PACKAGE_WPA_SUPPLICANT_PASSPHRASE=y
BR2_TARGET_ROOTFS_EXT2=y
BR2_TARGET_ROOTFS_EXT2_4=y
# BR2_TARGET_ROOTFS_TAR is not set
BR2_TARGET_UBOOT=y
BR2_TARGET_UBOOT_BUILD_SYSTEM_KCONFIG=y
BR2_TARGET_UBOOT_CUSTOM_VERSION=y
BR2_TARGET_UBOOT_CUSTOM_VERSION_VALUE="2019.10"
BR2_TARGET_UBOOT_BOARD_DEFCONFIG="bananapi_m1_plus"
BR2_TARGET_UBOOT_NEEDS_DTC=y
BR2_TARGET_UBOOT_NEEDS_PYLIBFDT=y
BR2_TARGET_UBOOT_SPL=y
BR2_TARGET_UBOOT_SPL_NAME="u-boot-sunxi-with-spl.bin"
BR2_PACKAGE_HOST_DOSFSTOOLS=y
BR2_PACKAGE_HOST_GENIMAGE=y
BR2_PACKAGE_HOST_MTOOLS=y
BR2_PACKAGE_HOST_UBOOT_TOOLS=y
BR2_PACKAGE_HOST_UBOOT_TOOLS_BOOT_SCRIPT=y
BR2_PACKAGE_HOST_UBOOT_TOOLS_BOOT_SCRIPT_SOURCE="board/sinovoip/m1-plus/boot.cmd"
```

## buildroot/configs/chromebook_elm_defconfig
```kconfig
# Architecture
BR2_aarch64=y
BR2_cortex_a72_a53=y

# Patches
BR2_GLOBAL_PATCH_DIR="board/chromebook/elm/patches/"

# Filesystem
BR2_TARGET_ROOTFS_EXT2=y
BR2_TARGET_ROOTFS_EXT2_4=y

# Linux headers same as kernel (5.9 series)
BR2_PACKAGE_HOST_LINUX_HEADERS_CUSTOM_5_9=y

# Kernel
BR2_LINUX_KERNEL=y
BR2_LINUX_KERNEL_CUSTOM_VERSION=y
BR2_LINUX_KERNEL_CUSTOM_VERSION_VALUE="5.9"

# Build Kernel with a Custom config.
BR2_LINUX_KERNEL_USE_CUSTOM_CONFIG=y
BR2_LINUX_KERNEL_CUSTOM_CONFIG_FILE="board/chromebook/elm/linux.config"

# DTS support
BR2_LINUX_KERNEL_DTS_SUPPORT=y
BR2_LINUX_KERNEL_INTREE_DTS_NAME="mediatek/mt8173-elm"

# Package Firmware for WiFi chip.
BR2_PACKAGE_LINUX_FIRMWARE=y
BR2_PACKAGE_LINUX_FIRMWARE_MWIFIEX_SD8797=y

# Scripts to generate final images.
BR2_ROOTFS_POST_BUILD_SCRIPT="board/chromebook/elm/sign.sh"
BR2_ROOTFS_POST_IMAGE_SCRIPT="board/chromebook/mksd.sh"

# Supporting host tools to build / sign FIT Image.
BR2_PACKAGE_HOST_PARTED=y
BR2_PACKAGE_HOST_UBOOT_TOOLS=y
BR2_PACKAGE_HOST_UBOOT_TOOLS_FIT_SUPPORT=y
BR2_PACKAGE_HOST_VBOOT_UTILS=y
```

## buildroot/configs/ci20_defconfig
```kconfig
# architecture
BR2_mipsel=y
BR2_mips_xburst=y
# BR2_MIPS_SOFT_FLOAT is not set
BR2_KERNEL_HEADERS_AS_KERNEL=y
BR2_PACKAGE_HOST_LINUX_HEADERS_CUSTOM_5_4=y

# system
BR2_TARGET_GENERIC_GETTY_PORT="ttyS4"
BR2_TARGET_ROOTFS_EXT2=y
BR2_TARGET_ROOTFS_EXT2_4=y
BR2_ROOTFS_POST_IMAGE_SCRIPT="support/scripts/genimage.sh"
BR2_ROOTFS_POST_SCRIPT_ARGS="-c board/ci20/genimage.cfg"

# kernel
BR2_LINUX_KERNEL=y
BR2_LINUX_KERNEL_CUSTOM_VERSION=y
BR2_LINUX_KERNEL_CUSTOM_VERSION_VALUE="5.4.58"
BR2_LINUX_KERNEL_DEFCONFIG="ci20"
BR2_LINUX_KERNEL_INSTALL_TARGET=y

# u-boot
BR2_TARGET_UBOOT=y
BR2_TARGET_UBOOT_BUILD_SYSTEM_KCONFIG=y
BR2_TARGET_UBOOT_CUSTOM_VERSION=y
BR2_TARGET_UBOOT_CUSTOM_VERSION_VALUE="2020.07"
BR2_TARGET_UBOOT_BOARD_DEFCONFIG="ci20_mmc"
BR2_TARGET_UBOOT_FORMAT_IMG=y
BR2_TARGET_UBOOT_SPL=y
BR2_TARGET_UBOOT_SPL_NAME="spl/u-boot-spl.bin"
BR2_PACKAGE_HOST_UBOOT_TOOLS=y
BR2_PACKAGE_HOST_UBOOT_TOOLS_ENVIMAGE=y
BR2_PACKAGE_HOST_UBOOT_TOOLS_ENVIMAGE_SOURCE="board/ci20/uboot-env.txt"
BR2_PACKAGE_HOST_UBOOT_TOOLS_ENVIMAGE_SIZE="32768"

# host
BR2_PACKAGE_HOST_GENIMAGE=y
```
